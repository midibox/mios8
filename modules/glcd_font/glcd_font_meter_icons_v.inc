;; converted with '$MIOS_BIN_PATH/convpix.pl glcd_font_meter_icons_h.xpm -icons 28 -height 32'
;; FONT_ENTRY manually added

GLCD_FONT_METER_ICONS_V
	FONT_ENTRY 8, 4, 0, 8	; with/height/X0 offset/char offset

	da b'0000000000000000'
	da b'0000000000000000'
	da b'0000000000000000'
	da b'0000000000000000'
	da b'0000000000000000'
	da b'0000000000000000'
	da b'0000000000000000'
	da b'0000000000000000'
	da b'0000000000000000'
	da b'0000000000000000'
	da b'0000000000000000'
	da b'0000000000000000'
	da b'0100000000000000'
	da b'0100000001000000'
	da b'0100000001000000'
	da b'0000000001000000'
	da b'0000000000000000'
	da b'0000000000000000'
	da b'0000000000000000'
	da b'0000000000000000'
	da b'0000000000000000'
	da b'0000000000000000'
	da b'0000000000000000'
	da b'0000000000000000'
	da b'0000000000000000'
	da b'0000000000000000'
	da b'0000000000000000'
	da b'0000000000000000'
	da b'0110000000000000'
	da b'0110000001100000'
	da b'0110000001100000'
	da b'0000000001100000'
	da b'0000000000000000'
	da b'0000000000000000'
	da b'0000000000000000'
	da b'0000000000000000'
	da b'0000000000000000'
	da b'0000000000000000'
	da b'0000000000000000'
	da b'0000000000000000'
	da b'0000000000000000'
	da b'0000000000000000'
	da b'0000000000000000'
	da b'0000000000000000'
	da b'0110100000000000'
	da b'0110100001101000'
	da b'0110100001101000'
	da b'0000000001101000'
	da b'0000000000000000'
	da b'0000000000000000'
	da b'0000000000000000'
	da b'0000000000000000'
	da b'0000000000000000'
	da b'0000000000000000'
	da b'0000000000000000'
	da b'0000000000000000'
	da b'0000000000000000'
	da b'0000000000000000'
	da b'0000000000000000'
	da b'0000000000000000'
	da b'0110101000000000'
	da b'0110101001101010'
	da b'0110101001101010'
	da b'0000000001101010'
	da b'0000000000000000'
	da b'0000000000000000'
	da b'0000000000000000'
	da b'0000000000000000'
	da b'0000000000000000'
	da b'0000000000000000'
	da b'0000000000000000'
	da b'0000000000000000'
	da b'1000000000000000'
	da b'1000000010000000'
	da b'1000000010000000'
	da b'0000000010000000'
	da b'0110101000000000'
	da b'0110101001101010'
	da b'0110101001101010'
	da b'0000000001101010'
	da b'0000000000000000'
	da b'0000000000000000'
	da b'0000000000000000'
	da b'0000000000000000'
	da b'0000000000000000'
	da b'0000000000000000'
	da b'0000000000000000'
	da b'0000000000000000'
	da b'1010000000000000'
	da b'1010000010100000'
	da b'1010000010100000'
	da b'0000000010100000'
	da b'0110101000000000'
	da b'0110101001101010'
	da b'0110101001101010'
	da b'0000000001101010'
	da b'0000000000000000'
	da b'0000000000000000'
	da b'0000000000000000'
	da b'0000000000000000'
	da b'0000000000000000'
	da b'0000000000000000'
	da b'0000000000000000'
	da b'0000000000000000'
	da b'1010100000000000'
	da b'1010100010101000'
	da b'1010100010101000'
	da b'0000000010101000'
	da b'0110101000000000'
	da b'0110101001101010'
	da b'0110101001101010'
	da b'0000000001101010'
	da b'0000000000000000'
	da b'0000000000000000'
	da b'0000000000000000'
	da b'0000000000000000'
	da b'0000000000000000'
	da b'0000000000000000'
	da b'0000000000000000'
	da b'0000000000000000'
	da b'1010101000000000'
	da b'1010101010101010'
	da b'1010101010101010'
	da b'0000000010101010'
	da b'0110101000000000'
	da b'0110101001101010'
	da b'0110101001101010'
	da b'0000000001101010'
	da b'0000000000000000'
	da b'0000000000000000'
	da b'0000000000000000'
	da b'0000000000000000'
	da b'1000000000000000'
	da b'1000000010000000'
	da b'1000000010000000'
	da b'0000000010000000'
	da b'1010101000000000'
	da b'1010101010101010'
	da b'1010101010101010'
	da b'0000000010101010'
	da b'0110101000000000'
	da b'0110101001101010'
	da b'0110101001101010'
	da b'0000000001101010'
	da b'0000000000000000'
	da b'0000000000000000'
	da b'0000000000000000'
	da b'0000000000000000'
	da b'1010000000000000'
	da b'1010000010100000'
	da b'1010000010100000'
	da b'0000000010100000'
	da b'1010101000000000'
	da b'1010101010101010'
	da b'1010101010101010'
	da b'0000000010101010'
	da b'0110101000000000'
	da b'0110101001101010'
	da b'0110101001101010'
	da b'0000000001101010'
	da b'0000000000000000'
	da b'0000000000000000'
	da b'0000000000000000'
	da b'0000000000000000'
	da b'1010100000000000'
	da b'1010100010101000'
	da b'1010100010101000'
	da b'0000000010101000'
	da b'1010101000000000'
	da b'1010101010101010'
	da b'1010101010101010'
	da b'0000000010101010'
	da b'0110101000000000'
	da b'0110101001101010'
	da b'0110101001101010'
	da b'0000000001101010'
	da b'0000000000000000'
	da b'0000000000000000'
	da b'0000000000000000'
	da b'0000000000000000'
	da b'1010101000000000'
	da b'1010101010101010'
	da b'1010101010101010'
	da b'0000000010101010'
	da b'1010101000000000'
	da b'1010101010101010'
	da b'1010101010101010'
	da b'0000000010101010'
	da b'0110101000000000'
	da b'0110101001101010'
	da b'0110101001101010'
	da b'0000000001101010'
	da b'1000000000000000'
	da b'1000000010000000'
	da b'1000000010000000'
	da b'0000000010000000'
	da b'1010101000000000'
	da b'1010101010101010'
	da b'1010101010101010'
	da b'0000000010101010'
	da b'1010101000000000'
	da b'1010101010101010'
	da b'1010101010101010'
	da b'0000000010101010'
	da b'0110101000000000'
	da b'0110101001101010'
	da b'0110101001101010'
	da b'0000000001101010'
	da b'1010000000000000'
	da b'1010000010100000'
	da b'1010000010100000'
	da b'0000000010100000'
	da b'1010101000000000'
	da b'1010101010101010'
	da b'1010101010101010'
	da b'0000000010101010'
	da b'1010101000000000'
	da b'1010101010101010'
	da b'1010101010101010'
	da b'0000000010101010'
	da b'0110101000000000'
	da b'0110101001101010'
	da b'0110101001101010'
	da b'0000000001101010'
	da b'0000000000000000'
	da b'0000011000000000'
	da b'0000000000000110'
	da b'0000000000000000'
	da b'0000000000000000'
	da b'0000000000000000'
	da b'0000000000000000'
	da b'0000000000000000'
	da b'0000000000000000'
	da b'0000000000000000'
	da b'0000000000000000'
	da b'0000000000000000'
	da b'0100000000000000'
	da b'0100000001000000'
	da b'0100000001000000'
	da b'0000000001000000'
	da b'0000000000000000'
	da b'0000011000000000'
	da b'0000000000000110'
	da b'0000000000000000'
	da b'0000000000000000'
	da b'0000000000000000'
	da b'0000000000000000'
	da b'0000000000000000'
	da b'0000000000000000'
	da b'0000000000000000'
	da b'0000000000000000'
	da b'0000000000000000'
	da b'0110000000000000'
	da b'0110000001100000'
	da b'0110000001100000'
	da b'0000000001100000'
	da b'0000000000000000'
	da b'0000011000000000'
	da b'0000000000000110'
	da b'0000000000000000'
	da b'0000000000000000'
	da b'0000000000000000'
	da b'0000000000000000'
	da b'0000000000000000'
	da b'0000000000000000'
	da b'0000000000000000'
	da b'0000000000000000'
	da b'0000000000000000'
	da b'0110100000000000'
	da b'0110100001101000'
	da b'0110100001101000'
	da b'0000000001101000'
	da b'0000000000000000'
	da b'0000011000000000'
	da b'0000000000000110'
	da b'0000000000000000'
	da b'0000000000000000'
	da b'0000000000000000'
	da b'0000000000000000'
	da b'0000000000000000'
	da b'0000000000000000'
	da b'0000000000000000'
	da b'0000000000000000'
	da b'0000000000000000'
	da b'0110101000000000'
	da b'0110101001101010'
	da b'0110101001101010'
	da b'0000000001101010'
	da b'0000000000000000'
	da b'0000011000000000'
	da b'0000000000000110'
	da b'0000000000000000'
	da b'0000000000000000'
	da b'0000000000000000'
	da b'0000000000000000'
	da b'0000000000000000'
	da b'1000000000000000'
	da b'1000000010000000'
	da b'1000000010000000'
	da b'0000000010000000'
	da b'0110101000000000'
	da b'0110101001101010'
	da b'0110101001101010'
	da b'0000000001101010'
	da b'0000000000000000'
	da b'0000011000000000'
	da b'0000000000000110'
	da b'0000000000000000'
	da b'0000000000000000'
	da b'0000000000000000'
	da b'0000000000000000'
	da b'0000000000000000'
	da b'1010000000000000'
	da b'1010000010100000'
	da b'1010000010100000'
	da b'0000000010100000'
	da b'0110101000000000'
	da b'0110101001101010'
	da b'0110101001101010'
	da b'0000000001101010'
	da b'0000000000000000'
	da b'0000011000000000'
	da b'0000000000000110'
	da b'0000000000000000'
	da b'0000000000000000'
	da b'0000000000000000'
	da b'0000000000000000'
	da b'0000000000000000'
	da b'1010100000000000'
	da b'1010100010101000'
	da b'1010100010101000'
	da b'0000000010101000'
	da b'0110101000000000'
	da b'0110101001101010'
	da b'0110101001101010'
	da b'0000000001101010'
	da b'0000000000000000'
	da b'0000011000000000'
	da b'0000000000000110'
	da b'0000000000000000'
	da b'0000000000000000'
	da b'0000000000000000'
	da b'0000000000000000'
	da b'0000000000000000'
	da b'1010101000000000'
	da b'1010101010101010'
	da b'1010101010101010'
	da b'0000000010101010'
	da b'0110101000000000'
	da b'0110101001101010'
	da b'0110101001101010'
	da b'0000000001101010'
	da b'0000000000000000'
	da b'0000011000000000'
	da b'0000000000000110'
	da b'0000000000000000'
	da b'1000000000000000'
	da b'1000000010000000'
	da b'1000000010000000'
	da b'0000000010000000'
	da b'1010101000000000'
	da b'1010101010101010'
	da b'1010101010101010'
	da b'0000000010101010'
	da b'0110101000000000'
	da b'0110101001101010'
	da b'0110101001101010'
	da b'0000000001101010'
	da b'0000000000000000'
	da b'0000011000000000'
	da b'0000000000000110'
	da b'0000000000000000'
	da b'1010000000000000'
	da b'1010000010100000'
	da b'1010000010100000'
	da b'0000000010100000'
	da b'1010101000000000'
	da b'1010101010101010'
	da b'1010101010101010'
	da b'0000000010101010'
	da b'0110101000000000'
	da b'0110101001101010'
	da b'0110101001101010'
	da b'0000000001101010'
	da b'0000000000000000'
	da b'0000011000000000'
	da b'0000000000000110'
	da b'0000000000000000'
	da b'1010100000000000'
	da b'1010100010101000'
	da b'1010100010101000'
	da b'0000000010101000'
	da b'1010101000000000'
	da b'1010101010101010'
	da b'1010101010101010'
	da b'0000000010101010'
	da b'0110101000000000'
	da b'0110101001101010'
	da b'0110101001101010'
	da b'0000000001101010'
	da b'0000000000000000'
	da b'0000011000000000'
	da b'0000000000000110'
	da b'0000000000000000'
	da b'1010101000000000'
	da b'1010101010101010'
	da b'1010101010101010'
	da b'0000000010101010'
	da b'1010101000000000'
	da b'1010101010101010'
	da b'1010101010101010'
	da b'0000000010101010'
	da b'0110101000000000'
	da b'0110101001101010'
	da b'0110101001101010'
	da b'0000000001101010'
	da b'1000000000000000'
	da b'1000011010000000'
	da b'1000000010000110'
	da b'0000000010000000'
	da b'1010101000000000'
	da b'1010101010101010'
	da b'1010101010101010'
	da b'0000000010101010'
	da b'1010101000000000'
	da b'1010101010101010'
	da b'1010101010101010'
	da b'0000000010101010'
	da b'0110101000000000'
	da b'0110101001101010'
	da b'0110101001101010'
	da b'0000000001101010'
	da b'1010000000000000'
	da b'1010011010100000'
	da b'1010000010100110'
	da b'0000000010100000'
	da b'1010101000000000'
	da b'1010101010101010'
	da b'1010101010101010'
	da b'0000000010101010'
	da b'1010101000000000'
	da b'1010101010101010'
	da b'1010101010101010'
	da b'0000000010101010'
	da b'0110101000000000'
	da b'0110101001101010'
	da b'0110101001101010'
	da b'0000000001101010'


