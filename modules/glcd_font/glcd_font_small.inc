; $Id$

;; converted with '$MIOS_BIN_PATH/convpix.pl glcd_font_small.xpm'
;; FONT_ENTRY manually added

GLCD_FONT_SMALL
	FONT_ENTRY 4, 1, 0, 4	; width/height/X0 offset/char offset

	da b'1000000010000000'
	da b'0000000010000000'
	da b'1100000011000000'
	da b'0000000011000000'
	da b'1110000011100000'
	da b'0000000011100000'
	da b'1111000011110000'
	da b'0000000011110000'
	da b'1111100011111000'
	da b'0000000011111000'
	da b'1111110011111100'
	da b'0000000011111100'
	da b'1111111011111110'
	da b'0000000011111110'
	da b'1111111111111111'
	da b'0000000011111111'
	da b'0011110000011000'
	da b'0000000001111110'
	da b'0011110001111110'
	da b'0000000000011000'
	da b'0000000000000000'
	da b'0000000000000000'
	da b'0000000000000000'
	da b'0000000000000000'
	da b'0000000000000000'
	da b'0000000000000000'
	da b'0000000000000000'
	da b'0000000000000000'
	da b'0000000000000000'
	da b'0000000000000000'
	da b'0000000000000000'
	da b'0000000000000000'


	da b'0000000000000000'
	da b'0000000000000000'
	da b'0000000000000000'
	da b'0000000000000000'
	da b'0000000000000000'
	da b'0000000000000000'
	da b'0000000000000000'
	da b'0000000000000000'
	da b'0000000000000000'
	da b'0000000000000000'
	da b'0000000000000000'
	da b'0000000000000000'
	da b'0000000000000000'
	da b'0000000000000000'
	da b'0000000000000000'
	da b'0000000000000000'
	da b'0000000000000000'
	da b'0000000000000000'
	da b'0000000000000000'
	da b'0000000000000000'
	da b'0000000000000000'
	da b'0000000000000000'
	da b'0000000000000000'
	da b'0000000000000000'
	da b'0000000000000000'
	da b'0000000000000000'
	da b'0000000000000000'
	da b'0000000000000000'
	da b'0000000000000000'
	da b'0000000000000000'
	da b'0000000000000000'
	da b'0000000000000000'


	da b'0000000000000000'
	da b'0000000000000000'
	da b'0101111100000000'
	da b'0000000000000000'
	da b'0000000000000011'
	da b'0000000000000011'
	da b'0001010000111110'
	da b'0000000000111110'
	da b'1111111101000110'
	da b'0000000000110001'
	da b'0000100000110010'
	da b'0000000000100110'
	da b'0100100100110110'
	da b'1010000001110110'
	da b'0000001100000100'
	da b'0000000000000000'
	da b'0010001000011100'
	da b'0000000001000001'
	da b'0010001001000001'
	da b'0000000000011100'
	da b'0001110000110110'
	da b'0000000000110110'
	da b'0001110000001000'
	da b'0000000000001000'
	da b'0100000010000000'
	da b'0000000000000000'
	da b'0000100000001000'
	da b'0000000000001000'
	da b'0000000001000000'
	da b'0000000000000000'
	da b'0001110001110000'
	da b'0000000000000111'


	da b'0100000101111111'
	da b'0000000001111111'
	da b'0111111101000010'
	da b'0000000001000000'
	da b'0100100101111001'
	da b'0000000001001111'
	da b'0100100101001001'
	da b'0000000001111111'
	da b'0000100000001111'
	da b'0000000001111110'
	da b'0100100101001111'
	da b'0000000001111001'
	da b'0100100101111111'
	da b'0000000001111001'
	da b'0000000100000001'
	da b'0000000001111111'
	da b'0100100101111111'
	da b'0000000001111111'
	da b'0100100101001111'
	da b'0000000001111111'
	da b'0001010000000000'
	da b'0000000000000000'
	da b'0001010000100000'
	da b'0000000000000000'
	da b'0001010000001000'
	da b'0000000000100010'
	da b'0001010000010100'
	da b'0000000000010100'
	da b'0001010000100010'
	da b'0000000000001000'
	da b'0101110100000001'
	da b'0000000000000111'


	da b'0100110100111110'
	da b'0000000000101111'
	da b'0000100101111110'
	da b'0000000001111110'
	da b'0100100101111111'
	da b'0000000000110110'
	da b'0100000100111110'
	da b'0000000001000001'
	da b'0100000101111111'
	da b'0000000000111110'
	da b'0100100101111111'
	da b'0000000001000001'
	da b'0000100101111111'
	da b'0000000000000001'
	da b'0100100100111110'
	da b'0000000000111001'
	da b'0000100001111111'
	da b'0000000001111111'
	da b'0111111101000001'
	da b'0000000001000001'
	da b'0100000100100000'
	da b'0000000000111111'
	da b'0001100001111111'
	da b'0000000001100111'
	da b'0100000001111111'
	da b'0000000001000000'
	da b'0000110001111111'
	da b'0000000001111111'
	da b'0011100001111111'
	da b'0000000001111111'
	da b'0100000100111110'
	da b'0000000000111110'


	da b'0000100101111111'
	da b'0000000000000110'
	da b'0100000100111110'
	da b'0000000001111110'
	da b'0000100101111111'
	da b'0000000001110110'
	da b'0100100101000110'
	da b'0000000000110001'
	da b'0111111100000001'
	da b'0000000000000001'
	da b'0100000000111111'
	da b'0000000000111111'
	da b'0111000000011111'
	da b'0000000000011111'
	da b'0011000001111111'
	da b'0000000001111111'
	da b'0001110001110111'
	da b'0000000001110111'
	da b'0111100000000111'
	da b'0000000000000111'
	da b'0100100101110001'
	da b'0000000001000111'
	da b'0100000101111111'
	da b'0000000001000001'
	da b'0001110000000011'
	da b'0000000001100000'
	da b'0100000101000001'
	da b'0000000001111111'
	da b'0000000100000010'
	da b'0000000000000010'
	da b'1000000010000000'
	da b'0000000010000000'


	da b'0000001000000001'
	da b'0000000000000000'
	da b'0101010001110100'
	da b'0000000001111100'
	da b'0100010001111111'
	da b'0000000000111000'
	da b'0100010000111000'
	da b'0000000001000100'
	da b'0100010000111000'
	da b'0000000001111111'
	da b'0101010001111100'
	da b'0000000001011100'
	da b'0000100101111110'
	da b'0000000000000010'
	da b'1001010001011000'
	da b'0000000001111100'
	da b'0000100001111111'
	da b'0000000001110000'
	da b'0111101001001000'
	da b'0000000001000000'
	da b'1000000001000000'
	da b'0000000001111010'
	da b'0001000001111110'
	da b'0000000001101000'
	da b'0111111101000001'
	da b'0000000001000000'
	da b'0001110001111000'
	da b'0000000001111000'
	da b'0000010001111100'
	da b'0000000001111000'
	da b'0100010000111000'
	da b'0000000000111000'


	da b'0010010011111000'
	da b'0000000000011000'
	da b'0010010000011000'
	da b'0000000011111000'
	da b'0000010001111000'
	da b'0000000000000100'
	da b'0101010001001000'
	da b'0000000000100100'
	da b'0100010000111111'
	da b'0000000000100000'
	da b'0100000001111100'
	da b'0000000001111100'
	da b'0110000000011100'
	da b'0000000000011100'
	da b'0111000000111100'
	da b'0000000000111100'
	da b'0011100001101100'
	da b'0000000001101100'
	da b'1001000010001100'
	da b'0000000001111100'
	da b'0101010001100100'
	da b'0000000001001100'
	da b'0101010100101010'
	da b'0000000001000001'
	da b'0111111100000000'
	da b'0000000000000000'
	da b'0101010101000001'
	da b'0000000000101010'
	da b'0000000100000010'
	da b'0000000100000010'
	da b'0000000000000000'
	da b'0000000000000000'


