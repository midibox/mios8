SPACE_FONT
MIOS_FONT
	FONT_ENTRY 6, 1, 0, 6	; width/height/X0 offset/char offset

	db 0x00,0x00,0x00,0x00,0x00,0x00		;Graphic Character 0
	db 0xFF,0xFF,0xFF,0xFF,0xFF,0xFF		;Graphic Character 1
    db 0xE0,0xF0,0xF8,0xFC,0xFC,0xFE		; Left side of base complete (Character 2)
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    db 0x00,0x00,0x00,0x00,0x00,0x00		;User defined character 31
    db 0x00,0x00,0x00,0x00,0x00,0x00		;32 -   - 20        
	db 0x00,0x00,0x4F,0x00,0x00,0x00		;33 - ! - 21
	db 0x00,0x07,0x00,0x07,0x00,0x00		;34 - " - 22
	db 0x14,0x7F,0x14,0x7F,0x14,0x00		;35 - # - 23
	db 0x24,0x2A,0x7F,0x2A,0x12,0x00		;36 - $ - 24
	db 0x23,0x13,0x08,0x64,0x62,0x00		;37 - % - 25
	db 0x36,0x49,0x55,0x22,0x50,0x00		;38 - & - 26
	db 0x00,0x05,0x03,0x00,0x00,0x00		;39 - ; - 27
	db 0x1C,0x22,0x41,0x00,0x00,0x00		;40 - ( - 28
	db 0x00,0x00,0x41,0x22,0x1C,0x00		;41 - ) - 29
	db 0x14,0x08,0x3E,0x08,0x14,0x00		;42 - * - 2A
	db 0x08,0x08,0x3E,0x08,0x08,0x00		;43 - + - 2B
	db 0x00,0x50,0x30,0x00,0x00,0x00		;44 - , - 2C
	db 0x08,0x08,0x08,0x08,0x08,0x00		;45 - - - 2D
	db 0x00,0x60,0x60,0x00,0x00,0x00		;46 - . - 2E
	db 0x20,0x10,0x08,0x04,0x02,0x00		;47 - / - 2F
	db 0x3E,0x51,0x49,0x45,0x3E,0x00		;48 - 0 - 30
	db 0x00,0x42,0x7F,0x40,0x00,0x00		;49 - 1 - 31
	db 0x42,0x61,0x51,0x49,0x46,0x00		;50 - 2 - 32
	db 0x21,0x41,0x45,0x4B,0x31,0x00		;51 - 3 - 33
	db 0x18,0x14,0x12,0x7F,0x10,0x00		;52 - 4 - 34
	db 0x27,0x45,0x45,0x45,0x39,0x00		;53 - 5 - 35
	db 0x3C,0x4A,0x49,0x49,0x30,0x00		;54 - 6 - 36
	db 0x01,0x71,0x09,0x05,0x03,0x00		;55 - 7 - 37
	db 0x36,0x49,0x49,0x49,0x36,0x00		;56 - 8 - 38
	db 0x06,0x49,0x49,0x49,0x3E,0x00		;57 - 9 - 39
	db 0x00,0x36,0x36,0x00,0x00,0x00		;58 - : - 3A
	db 0x00,0x56,0x36,0x00,0x00,0x00		;59 - ; - 3B
	db 0x08,0x14,0x22,0x41,0x00,0x00		;60 - < - 3C
	db 0x14,0x14,0x14,0x14,0x14,0x00		;61 - = - 3D
	db 0x00,0x41,0x22,0x14,0x08,0x00		;62 - > - 3E
	db 0x02,0x01,0x51,0x09,0x06,0x00		;63 - ? - 3F
	db 0x32,0x49,0x79,0x41,0x3E,0x00		;64 - @ - 40
	db 0x7E,0x11,0x11,0x11,0x7E,0x00		;65 - A - 41
	db 0x7F,0x49,0x49,0x49,0x36,0x00		;66 - B - 42
	db 0x3E,0x41,0x41,0x41,0x22,0x00		;67 - C - 43
	db 0x7F,0x41,0x41,0x22,0x1C,0x00		;68 - D - 44
	db 0x7F,0x49,0x49,0x49,0x41,0x00		;69 - E - 45
	db 0x7F,0x09,0x09,0x09,0x01,0x00		;70 - F - 46
	db 0x3E,0x41,0x49,0x49,0x7A,0x00		;71 - G - 47
	db 0x7F,0x08,0x08,0x08,0x7F,0x00		;72 - H - 48
	db 0x00,0x41,0x7F,0x41,0x00,0x00		;73 - I - 49
	db 0x20,0x40,0x41,0x3F,0x01,0x00		;74 - J - 4A
	db 0x7F,0x08,0x14,0x22,0x41,0x00		;75 - K - 4B
	db 0x7F,0x40,0x40,0x40,0x40,0x00		;76 - L - 4C
	db 0x7F,0x02,0x0C,0x02,0x7F,0x00		;77 - M - 4D
	db 0x7F,0x04,0x08,0x10,0x7F,0x00		;78 - N - 4E
	db 0x3E,0x41,0x41,0x41,0x3E,0x00		;79 - O - 4F
	db 0x7F,0x09,0x09,0x09,0x06,0x00		;80 - P - 50
	db 0x3E,0x41,0x51,0x21,0x5E,0x00		;81 - Q - 51
	db 0x7F,0x09,0x19,0x29,0x46,0x00		;82 - R - 52
	db 0x46,0x49,0x49,0x49,0x31,0x00		;83 - S - 53
	db 0x01,0x01,0x7F,0x01,0x01,0x00		;84 - T - 54
	db 0x3F,0x40,0x40,0x40,0x3F,0x00		;85 - U - 55
	db 0x1F,0x20,0x40,0x20,0x1F,0x00		;86 - V - 56
	db 0x3F,0x40,0x38,0x40,0x3F,0x00		;87 - W - 57
	db 0x63,0x14,0x08,0x14,0x63,0x00		;88 - X - 58
	db 0x07,0x08,0x70,0x08,0x07,0x00		;89 - Y - 59
	db 0x61,0x51,0x49,0x45,0x43,0x00		;90 - Z - 5A
	db 0x7F,0x41,0x41,0x00,0x00,0x00		;91 - [ - 5B
	db 0x02,0x04,0x08,0x10,0x20,0x00		;92 - \ - 5C
	db 0x00,0x00,0x41,0x41,0x7F,0x00		;93 - ] - 5D
	db 0x04,0x02,0x01,0x02,0x04,0x00		;94 - ^ - 5E
	db 0x40,0x40,0x40,0x40,0x40,0x00		;95 - _ - 5F
	db 0x00,0x01,0x02,0x04,0x00,0x00		;96 - ` - 60
	db 0x20,0x54,0x54,0x54,0x78,0x00		;97 - a - 61
	db 0x7F,0x48,0x44,0x44,0x38,0x00		;98 - b - 62
	db 0x38,0x44,0x44,0x44,0x20,0x00		;99 - c - 63
	db 0x38,0x44,0x44,0x48,0x7F,0x00		;100  d - 64
	db 0x38,0x54,0x54,0x54,0x18,0x00		;101  e - 65
	db 0x08,0x7E,0x09,0x01,0x02,0x00		;102  f - 66
	db 0x0C,0x52,0x52,0x52,0x3E,0x00		;103  g - 67
	db 0x7F,0x08,0x04,0x04,0x78,0x00		;104  h - 68
	db 0x00,0x44,0x7D,0x40,0x00,0x00		;105  i - 69
	db 0x00,0x20,0x40,0x44,0x3D,0x00		;106  j - 6A
	db 0x7F,0x10,0x28,0x44,0x00,0x00		;107  k - 6B
	db 0x00,0x41,0x7F,0x40,0x00,0x00		;108  l - 6C
	db 0x7C,0x04,0x18,0x04,0x78,0x00		;109  m - 6D
	db 0x7C,0x08,0x04,0x04,0x78,0x00		;110  n - 6E
	db 0x38,0x44,0x44,0x44,0x38,0x00		;111  o - 6F
	db 0x7C,0x14,0x14,0x14,0x08,0x00		;112  p - 70
	db 0x08,0x14,0x14,0x18,0x7C,0x00		;113  q - 71
	db 0x7C,0x08,0x04,0x04,0x08,0x00		;114  r - 72
	db 0x48,0x54,0x54,0x54,0x20,0x00		;115  s - 73
	db 0x04,0x3F,0x44,0x40,0x20,0x00		;116  t - 74
	db 0x3C,0x40,0x40,0x20,0x7C,0x00		;117  u - 75
	db 0x1C,0x20,0x40,0x20,0x1C,0x00		;118  v - 76
	db 0x3C,0x40,0x30,0x40,0x3C,0x00		;119  w - 77
	db 0x44,0x28,0x10,0x28,0x44,0x00		;120  x - 78
	db 0x0C,0x50,0x50,0x50,0x3C,0x00		;121  y - 79
	db 0x44,0x64,0x54,0x4C,0x44,0x00		;122  z - 7A
	db 0x08,0x36,0x41,0x00,0x00,0x00		;123  { -  7B
	db 0x00,0x00,0x7F,0x00,0x00,0x00		;124  | - 7C
	db 0x00,0x00,0x41,0x36,0x08,0x00		;125  } - 7D
	db 0x00,0x08,0x04,0x08,0x04,0x00 		;126  ~ - 7E     
	
	

