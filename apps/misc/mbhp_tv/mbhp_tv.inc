;; converted with 'convpix_8x8 mbhp_tv.xpm'

	da b'0000000000000000'
	da b'0000000000000000'
	da b'0000000000000000'
	da b'0000000000000000'
	da b'0000000000000000'
	da b'0000000000000000'
	da b'0000000000000000'
	da b'0000000000000000'


	da b'0000000000000000'
	da b'0000000000000000'
	da b'0000000000000000'
	da b'0000000000000000'
	da b'0000000000000000'
	da b'0000000000000000'
	da b'0000000000000000'
	da b'0000000000000000'


	da b'0000000000000000'
	da b'0000000000000000'
	da b'0000000000000000'
	da b'0000000000000000'
	da b'0000000000000000'
	da b'0000000000000000'
	da b'0000000000000000'
	da b'0000000000000000'


	da b'0000000000000000'
	da b'0000000000000000'
	da b'0000000000000000'
	da b'0000000000000000'
	da b'0000000000000000'
	da b'0000000000000000'
	da b'0000000000000000'
	da b'0000000000000000'


	da b'0000000000000000'
	da b'0000000000000000'
	da b'0000000000000000'
	da b'0000000000000000'
	da b'0000000000000000'
	da b'0000000000000000'
	da b'0000000000000000'
	da b'0000000000000000'


	da b'0000000000000000'
	da b'0000000000000000'
	da b'0000000000000000'
	da b'0000000000000000'
	da b'0000000000000000'
	da b'0000000000000000'
	da b'0000000000000000'
	da b'0000000000000000'


	da b'0000000000000000'
	da b'0000000000000000'
	da b'0000000000000000'
	da b'0000000000000000'
	da b'0000000000000000'
	da b'0000000000000000'
	da b'0000000000000000'
	da b'0000000000000000'


	da b'0000000000000000'
	da b'0000000000000000'
	da b'0000000000000000'
	da b'0000000000000000'
	da b'0000000000000000'
	da b'0000000000000000'
	da b'0000000000000000'
	da b'0000000000000000'


	da b'0000000000000000'
	da b'0000000000000000'
	da b'0000000000000000'
	da b'0000000000000000'
	da b'0000000000000000'
	da b'0000000000000000'
	da b'0000000000000000'
	da b'0000000000000000'


	da b'0000000000000000'
	da b'0000000000000000'
	da b'0000000000000000'
	da b'0000000000000000'
	da b'0000000000000000'
	da b'0000000000000000'
	da b'0000000000000000'
	da b'0000000000000000'


	da b'0000000000000000'
	da b'0000000000000000'
	da b'0000000000000000'
	da b'0000000000000000'
	da b'0000000000000000'
	da b'0000000000000000'
	da b'0000000000000000'
	da b'0000000000000000'


	da b'0011100000000000'
	da b'0011100000000000'
	da b'1111000001111111'
	da b'0000000100011100'
	da b'1111111111000011'
	da b'0000000010000000'
	da b'0000000000000000'
	da b'0000000000000000'


	da b'0011110000000000'
	da b'0111100000000000'
	da b'1111110001111111'
	da b'0000000100011100'
	da b'1111111111000011'
	da b'0000000011100000'
	da b'0000000000000000'
	da b'0000000000000000'


	da b'0011110000000000'
	da b'0111100000000000'
	da b'0011110001110000'
	da b'0000000100011100'
	da b'1000000011000011'
	da b'0000000011100000'
	da b'0000000000000000'
	da b'0000000000000000'


	da b'0011111000000000'
	da b'1111100000000000'
	da b'0000111001110000'
	da b'0000000100011100'
	da b'1000000011000011'
	da b'0000000001110000'
	da b'0000000000000000'
	da b'0000000000000000'


	da b'0011111000000000'
	da b'1111100000000000'
	da b'0000111001110000'
	da b'0000000100011100'
	da b'1000000011000011'
	da b'0000000001110000'
	da b'0000000000000000'
	da b'0000000000000000'


	da b'0011111100000000'
	da b'1111100000000001'
	da b'0000111001110000'
	da b'0000000100011100'
	da b'1000000011000011'
	da b'0000001101110000'
	da b'1001111111111111'
	da b'1000000000001111'


	da b'0011101100000000'
	da b'1011100000000001'
	da b'0000111001110000'
	da b'0000000100011100'
	da b'1000000011000011'
	da b'0000001001110000'
	da b'1000010000010000'
	da b'0000000000000010'


	da b'0011101100000000'
	da b'1011100010000011'
	da b'0001110001110000'
	da b'0000000100011100'
	da b'1000000011000011'
	da b'0000001011100000'
	da b'1000010000010000'
	da b'0000000000000100'


	da b'0011100100000000'
	da b'0011100010000011'
	da b'1111100001111111'
	da b'1111111100011111'
	da b'1111111111000011'
	da b'0000010011100000'
	da b'0000010000100001'
	da b'0000000000000100'


	da b'0011100100000000'
	da b'0011100011000111'
	da b'1111110001111111'
	da b'1111111100011111'
	da b'1111111111000011'
	da b'0000010011000000'
	da b'0000001000100001'
	da b'0000000000001000'


	da b'0011100100000000'
	da b'0011100011000111'
	da b'0000111001110000'
	da b'0000000100011100'
	da b'1000000011000011'
	da b'0000000000000000'
	da b'0000001000100000'
	da b'0000000000001000'


	da b'0011100000000000'
	da b'0011100011000110'
	da b'0000011101110000'
	da b'0000000100011100'
	da b'1000000011000011'
	da b'0000000000000000'
	da b'0000001000100000'
	da b'0000000000010000'


	da b'0011100000000000'
	da b'0011100011101110'
	da b'0000011101110000'
	da b'0000000100011100'
	da b'1000000011000011'
	da b'0000000000000000'
	da b'0000001001000000'
	da b'0000000000010000'


	da b'0011100000000000'
	da b'0011100011101110'
	da b'0000011101110000'
	da b'0000000100011100'
	da b'1000000011000011'
	da b'0000000000000000'
	da b'0000001001000000'
	da b'0000000000100000'


	da b'0011100000000000'
	da b'0011100001111100'
	da b'0000011101110000'
	da b'0000000100011100'
	da b'1000000011000011'
	da b'0000000000000000'
	da b'0000000101000000'
	da b'0000000000100000'


	da b'0011100000000000'
	da b'0011100001111100'
	da b'0000111101110000'
	da b'0000000100011100'
	da b'1000000011000011'
	da b'0000000000000000'
	da b'0000000110000000'
	da b'0000000001000000'


	da b'0011100000000000'
	da b'0011100000111000'
	da b'0011111001110000'
	da b'0000000100011100'
	da b'1000000011000011'
	da b'0000000000000000'
	da b'0000000110000000'
	da b'0000000001000000'


	da b'0011100000000000'
	da b'0011100000111000'
	da b'1111110001111111'
	da b'0000000100011100'
	da b'1000000011000011'
	da b'0000000000000000'
	da b'0000000110000000'
	da b'0000000010000000'


	da b'0011100000000000'
	da b'0011100000111000'
	da b'1111000001111111'
	da b'0000000100011100'
	da b'1000000011000011'
	da b'0000011100000000'
	da b'0000000111110000'
	da b'0000000010000000'


	da b'0000000000000000'
	da b'0000000000000000'
	da b'0000000000000000'
	da b'0000000000000000'
	da b'0000000000000000'
	da b'0000000000000000'
	da b'0000000000000000'
	da b'0000000000000000'


	da b'0000000000000000'
	da b'0000000000000000'
	da b'0000000000000000'
	da b'0000000000000000'
	da b'0000000000000000'
	da b'0000000000000000'
	da b'0000000000000000'
	da b'0000000000000000'


	da b'0000000000000000'
	da b'0000000000000000'
	da b'0000000000000000'
	da b'0000000000000000'
	da b'0000000000000000'
	da b'0000000000000000'
	da b'0000000000000000'
	da b'0000000000000000'


	da b'1111111100000111'
	da b'1111111111111111'
	da b'1111111111111111'
	da b'1111111111111111'
	da b'1111111111111111'
	da b'1111111111111111'
	da b'1111111111111111'
	da b'1111000011111111'


	da b'0000000000000000'
	da b'0000000000000000'
	da b'0000000000000000'
	da b'0000000000000000'
	da b'0000000000000000'
	da b'0000000000000000'
	da b'0000000000000000'
	da b'0000000000000000'


	da b'0000000000000000'
	da b'0000000000000000'
	da b'0000000000000000'
	da b'0000000000000000'
	da b'0000000000000000'
	da b'0000000000000000'
	da b'0000000000000000'
	da b'0000000000000000'


	da b'1111111100111111'
	da b'1111111111111111'
	da b'1111111111111111'
	da b'1111111111111111'
	da b'1111111111111111'
	da b'1111111111111111'
	da b'1111111111111111'
	da b'1000000011111111'


	da b'0000000000000000'
	da b'0000000000000000'
	da b'0000000000000000'
	da b'0000000000000000'
	da b'0000000000000000'
	da b'0000000000000000'
	da b'0000000000000000'
	da b'0000000000000000'


	da b'0000000000000000'
	da b'0000000000000000'
	da b'0000000000000000'
	da b'0000000000000000'
	da b'0000000000000000'
	da b'0000000000000000'
	da b'0000000000000000'
	da b'0000000000000000'


	da b'0000000000000000'
	da b'0000000000000000'
	da b'0000000000000000'
	da b'0000000000000000'
	da b'0000000000000000'
	da b'0000000000000000'
	da b'0000000000000000'
	da b'0000000000000000'


	da b'0000000000000000'
	da b'0000000000000000'
	da b'0000000000000000'
	da b'0000000000000000'
	da b'0000000000000000'
	da b'0000000000000000'
	da b'0000000000000000'
	da b'0000000000000000'


	da b'0000000000000000'
	da b'0000000000000000'
	da b'0000000000000000'
	da b'0000000000000000'
	da b'0000000000000000'
	da b'0000000000000000'
	da b'0000000000000000'
	da b'0000000000000000'


	da b'0000000000000000'
	da b'0000000000000000'
	da b'0000000000000000'
	da b'0000000000000000'
	da b'0000000000000000'
	da b'0000000000000000'
	da b'0000000000000000'
	da b'0000000000000000'


	da b'0000000000000000'
	da b'0000000000000000'
	da b'0000000000000000'
	da b'0000000000000000'
	da b'0000000000000000'
	da b'0000000000000000'
	da b'0000000000000000'
	da b'0000000000000000'


	da b'0000000000000000'
	da b'0000000000000000'
	da b'0000000000000000'
	da b'0000000000000000'
	da b'0000000000000000'
	da b'0000000000000000'
	da b'0000000000000000'
	da b'0000000000000000'


	da b'0000000000000000'
	da b'0000000000000000'
	da b'0000000000000000'
	da b'0000000000000000'
	da b'0000000000000000'
	da b'0000000000000000'
	da b'0000000000000000'
	da b'0000000000000000'


	da b'0001111100000000'
	da b'0000000000000000'
	da b'0000000000000000'
	da b'0100000000000000'
	da b'0000000010000000'
	da b'0010010000100000'
	da b'0001111000111100'
	da b'0000000000000000'


	da b'0001000000000000'
	da b'0000000010000000'
	da b'0000000000000000'
	da b'0100000000000000'
	da b'0000000010000000'
	da b'0110010000110000'
	da b'0010000101000010'
	da b'0000000000000000'


	da b'0001000000000000'
	da b'0100010010001110'
	da b'0010100101001110'
	da b'0100000011000011'
	da b'0001000010110001'
	da b'0110010000110000'
	da b'0010000010000001'
	da b'0000000000000000'


	da b'0001000000000000'
	da b'0100010010010001'
	da b'0011001001010001'
	da b'1100000000100100'
	da b'0001000011001001'
	da b'1010010000101000'
	da b'0001100010000001'
	da b'0000000000000000'


	da b'0001111100000000'
	da b'0010010000010001'
	da b'0010001010010001'
	da b'0100000000100100'
	da b'0001000010001001'
	da b'1010010000101000'
	da b'0000011010000001'
	da b'0000000000000000'


	da b'0001000000000000'
	da b'0010010000010001'
	da b'0010001110011111'
	da b'0100000011100100'
	da b'0010000010001001'
	da b'0010010000100101'
	da b'0000000110000001'
	da b'0000000000000000'


	da b'0001000000000000'
	da b'0010101000010001'
	da b'0010001010010000'
	da b'0100000000000100'
	da b'1010000010001000'
	da b'0010010000100101'
	da b'0010000110000001'
	da b'0000000000000000'


	da b'0001000000000000'
	da b'0001000100010001'
	da b'0010001000010001'
	da b'1100000000100100'
	da b'1010000011001000'
	da b'0010010000100010'
	da b'0010000101000010'
	da b'0000000000000000'


	da b'0001000000000000'
	da b'0001000100001110'
	da b'0010000100001110'
	da b'0100000011000011'
	da b'0100000010110000'
	da b'0010010000100010'
	da b'0001111000111100'
	da b'0000000000000000'


	da b'0000000000000000'
	da b'0000000000000000'
	da b'0000000000000000'
	da b'0000000000000000'
	da b'0100000000000000'
	da b'0000000000000000'
	da b'0000000000000000'
	da b'0000000000000000'


	da b'0000000000000000'
	da b'0000000000000000'
	da b'0000000000000000'
	da b'0000000000000000'
	da b'1000000000000000'
	da b'0000000000000000'
	da b'0000000000000000'
	da b'0000000000000000'


	da b'0000000000000000'
	da b'0000000000000000'
	da b'0000000000000000'
	da b'0000000000000000'
	da b'0000000000000001'
	da b'0000000000000000'
	da b'0000000000000000'
	da b'0000000000000000'


	da b'0000000000000000'
	da b'0000000000000000'
	da b'0000000000000000'
	da b'0000000000000000'
	da b'0000000000000000'
	da b'0000000000000000'
	da b'0000000000000000'
	da b'0000000000000000'


	da b'0000000000000000'
	da b'0000000000000000'
	da b'0000000000000000'
	da b'0000000000000000'
	da b'0000000000000000'
	da b'0000000000000000'
	da b'0000000000000000'
	da b'0000000000000000'


	da b'0000000000000000'
	da b'0000000000000000'
	da b'0000000000000000'
	da b'0000000000000000'
	da b'0000000000000000'
	da b'0000000000000000'
	da b'0000000000000000'
	da b'0000000000000000'


	da b'0000000000000000'
	da b'0000000000000000'
	da b'0000000000000000'
	da b'0000000000000000'
	da b'0000000000000000'
	da b'0000000000000000'
	da b'0000000000000000'
	da b'0000000000000000'


	da b'0000000000000000'
	da b'0000000000000000'
	da b'0000000000000000'
	da b'0000000000000000'
	da b'0000000000000000'
	da b'0000000000000000'
	da b'0000000000000000'
	da b'0000000000000000'


	da b'0000000000000000'
	da b'0000000000000000'
	da b'0000000000000000'
	da b'0000000000000000'
	da b'0000000000000000'
	da b'0000000000000000'
	da b'0000000000000000'
	da b'0000000000000000'


