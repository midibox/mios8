; $Id$
;
; MIDIboxSEQ
; Preset Pattern (included into EEPROM and from seq_bank.inc to initialize pattern
;
; ==========================================================================
;
;  Copyright 1998-2006 Thorsten Klose (tk@midibox.org)
;  Licensed for personal non-commercial use only.
;  All other rights reserved.
; 
; ==========================================================================

  ;;	spare chn   note  vel   vela  dir1  dir2  div   grve  asgn  loop  last  res.  res.  spr4  spr5
  db	0x00, 0x09, 0x24, 0x5f, 0x7f, 0x00, 0x00, 0x03, 0x10, DEFAULT_AUX_LAYER_ASSIGN, 0x00, 0x0f, 0x20, 0x2f, 0x00, 0x00	; Trk1
  db	0x00, 0x09, 0x26, 0x5f, 0x7f, 0x00, 0x00, 0x03, 0x10, DEFAULT_AUX_LAYER_ASSIGN, 0x00, 0x0f, 0x20, 0x2f, 0x00, 0x00	; Trk2
  db	0x00, 0x09, 0x29, 0x5f, 0x7f, 0x00, 0x00, 0x03, 0x10, DEFAULT_AUX_LAYER_ASSIGN, 0x00, 0x0f, 0x20, 0x2f, 0x00, 0x00	; Trk3
  db	0x00, 0x09, 0x2b, 0x5f, 0x7f, 0x00, 0x00, 0x03, 0x10, DEFAULT_AUX_LAYER_ASSIGN, 0x00, 0x0f, 0x20, 0x2f, 0x00, 0x00	; Trk4
  db	0x00, 0x09, 0x2f, 0x5f, 0x7f, 0x00, 0x00, 0x03, 0x10, DEFAULT_AUX_LAYER_ASSIGN, 0x00, 0x0f, 0x20, 0x2f, 0x00, 0x00	; Trk5
  db	0x00, 0x09, 0x27, 0x5f, 0x7f, 0x00, 0x00, 0x03, 0x10, DEFAULT_AUX_LAYER_ASSIGN, 0x00, 0x0f, 0x20, 0x2f, 0x00, 0x00	; Trk6
  db	0x00, 0x09, 0x46, 0x5f, 0x7f, 0x00, 0x00, 0x03, 0x10, DEFAULT_AUX_LAYER_ASSIGN, 0x00, 0x0f, 0x20, 0x2f, 0x00, 0x00	; Trk7
  db	0x00, 0x09, 0x4b, 0x5f, 0x7f, 0x00, 0x00, 0x03, 0x10, DEFAULT_AUX_LAYER_ASSIGN, 0x00, 0x0f, 0x20, 0x2f, 0x00, 0x00	; Trk8
  db	0x00, 0x09, 0x38, 0x5f, 0x7f, 0x00, 0x00, 0x03, 0x10, DEFAULT_AUX_LAYER_ASSIGN, 0x00, 0x0f, 0x20, 0x2f, 0x00, 0x00	; Trk9
  db	0x00, 0x09, 0x31, 0x5f, 0x7f, 0x00, 0x00, 0x03, 0x10, DEFAULT_AUX_LAYER_ASSIGN, 0x00, 0x0f, 0x20, 0x2f, 0x00, 0x00	; Trk10
  db	0x00, 0x09, 0x2e, 0x5f, 0x7f, 0x00, 0x00, 0x03, 0x10, DEFAULT_AUX_LAYER_ASSIGN, 0x00, 0x0f, 0x20, 0x2f, 0x00, 0x00	; Trk11
  db	0x00, 0x09, 0x2a, 0x5f, 0x7f, 0x00, 0x00, 0x03, 0x10, DEFAULT_AUX_LAYER_ASSIGN, 0x00, 0x0f, 0x20, 0x2f, 0x00, 0x00	; Trk12
  db	0x00, 0x09, 0x2c, 0x5f, 0x7f, 0x00, 0x00, 0x03, 0x10, DEFAULT_AUX_LAYER_ASSIGN, 0x00, 0x0f, 0x20, 0x2f, 0x00, 0x00	; Trk13
  db	0x00, 0x09, 0x3c, 0x5f, 0x7f, 0x00, 0x00, 0x03, 0x10, DEFAULT_AUX_LAYER_ASSIGN, 0x00, 0x0f, 0x20, 0x2f, 0x00, 0x00	; Trk14
  db	0x00, 0x09, 0x3d, 0x5f, 0x7f, 0x00, 0x00, 0x03, 0x10, DEFAULT_AUX_LAYER_ASSIGN, 0x00, 0x0f, 0x20, 0x2f, 0x00, 0x00	; Trk15
  db	0x00, 0x09, 0x4c, 0x5f, 0x7f, 0x00, 0x00, 0x03, 0x10, DEFAULT_AUX_LAYER_ASSIGN, 0x00, 0x0f, 0x20, 0x2f, 0x00, 0x00	; Trk16

  ;;    |------------- gate triggers ----------------|  |------------- aux. triggers ----------------|
  db	0x11, 0x11, 0x11, 0x11, 0x11, 0x11, 0x11, 0x11, 0x00, 0x00, 0x00, 0x00, 0x00, 0x00, 0x00, 0x00	; Trk1
  db	0x00, 0x00, 0x00, 0x00, 0x00, 0x00, 0x00, 0x00, 0x00, 0x00, 0x00, 0x00, 0x00, 0x00, 0x00, 0x00	; Trk2
  db	0x00, 0x00, 0x00, 0x00, 0x00, 0x00, 0x00, 0x00, 0x00, 0x00, 0x00, 0x00, 0x00, 0x00, 0x00, 0x00	; Trk3
  db	0x00, 0x00, 0x00, 0x00, 0x00, 0x00, 0x00, 0x00, 0x00, 0x00, 0x00, 0x00, 0x00, 0x00, 0x00, 0x00	; Trk4
  db	0x00, 0x00, 0x00, 0x00, 0x00, 0x00, 0x00, 0x00, 0x00, 0x00, 0x00, 0x00, 0x00, 0x00, 0x00, 0x00	; Trk5
  db	0x00, 0x00, 0x00, 0x00, 0x00, 0x00, 0x00, 0x00, 0x00, 0x00, 0x00, 0x00, 0x00, 0x00, 0x00, 0x00	; Trk6
  db	0x00, 0x00, 0x00, 0x00, 0x00, 0x00, 0x00, 0x00, 0x00, 0x00, 0x00, 0x00, 0x00, 0x00, 0x00, 0x00	; Trk7
  db	0x00, 0x00, 0x00, 0x00, 0x00, 0x00, 0x00, 0x00, 0x00, 0x00, 0x00, 0x00, 0x00, 0x00, 0x00, 0x00	; Trk8
  db	0x00, 0x00, 0x00, 0x00, 0x00, 0x00, 0x00, 0x00, 0x00, 0x00, 0x00, 0x00, 0x00, 0x00, 0x00, 0x00	; Trk9
  db	0x00, 0x00, 0x00, 0x00, 0x00, 0x00, 0x00, 0x00, 0x00, 0x00, 0x00, 0x00, 0x00, 0x00, 0x00, 0x00	; Trk10
  db	0x00, 0x00, 0x00, 0x00, 0x00, 0x00, 0x00, 0x00, 0x00, 0x00, 0x00, 0x00, 0x00, 0x00, 0x00, 0x00	; Trk11
  db	0x00, 0x00, 0x00, 0x00, 0x00, 0x00, 0x00, 0x00, 0x00, 0x00, 0x00, 0x00, 0x00, 0x00, 0x00, 0x00	; Trk12
  db	0x00, 0x00, 0x00, 0x00, 0x00, 0x00, 0x00, 0x00, 0x00, 0x00, 0x00, 0x00, 0x00, 0x00, 0x00, 0x00	; Trk13
  db	0x00, 0x00, 0x00, 0x00, 0x00, 0x00, 0x00, 0x00, 0x00, 0x00, 0x00, 0x00, 0x00, 0x00, 0x00, 0x00	; Trk14
  db	0x00, 0x00, 0x00, 0x00, 0x00, 0x00, 0x00, 0x00, 0x00, 0x00, 0x00, 0x00, 0x00, 0x00, 0x00, 0x00	; Trk15
  db	0x00, 0x00, 0x00, 0x00, 0x00, 0x00, 0x00, 0x00, 0x00, 0x00, 0x00, 0x00, 0x00, 0x00, 0x00, 0x00	; Trk16
