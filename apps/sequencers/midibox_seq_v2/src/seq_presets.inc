; $Id$
;
; MIDIboxSEQ
; Presets (EEPROM content)
;
; ==========================================================================
;
;  Copyright 1998-2006 Thorsten Klose (tk@midibox.org)
;  Licensed for personal non-commercial use only.
;  All other rights reserved.
; 
; ==========================================================================

        ERRORLEVEL      -220    ; suppress "Address exceeds maximum range for this processor."
	;; this is (unfortunately) required for gpasm

	org	0xf00000	; eeprom base address

SEQ_PRESETS_LAYER_A
	de	0x3c, 0x3c, 0x3c, 0x3c, 0x3c, 0x3c, 0x3c, 0x3c, 0x3c, 0x3c, 0x3c, 0x3c, 0x3c, 0x3c, 0x3c, 0x3c
	de	0x3c, 0x3c, 0x3c, 0x3c, 0x3c, 0x3c, 0x3c, 0x3c, 0x3c, 0x3c, 0x3c, 0x3c, 0x3c, 0x3c, 0x3c, 0x3c
	de	0x3c, 0x3c, 0x3c, 0x3c, 0x3c, 0x3c, 0x3c, 0x3c, 0x3c, 0x3c, 0x3c, 0x3c, 0x3c, 0x3c, 0x3c, 0x3c
	de	0x3c, 0x3c, 0x3c, 0x3c, 0x3c, 0x3c, 0x3c, 0x3c, 0x3c, 0x3c, 0x3c, 0x3c, 0x3c, 0x3c, 0x3c, 0x3c

SEQ_PRESETS_LAYER_B
	de	0x7f, 0x7f, 0x7f, 0x7f, 0x7f, 0x7f, 0x7f, 0x7f, 0x7f, 0x7f, 0x7f, 0x7f, 0x7f, 0x7f, 0x7f, 0x7f
	de	0x7f, 0x7f, 0x7f, 0x7f, 0x7f, 0x7f, 0x7f, 0x7f, 0x7f, 0x7f, 0x7f, 0x7f, 0x7f, 0x7f, 0x7f, 0x7f
	de	0x7f, 0x7f, 0x7f, 0x7f, 0x7f, 0x7f, 0x7f, 0x7f, 0x7f, 0x7f, 0x7f, 0x7f, 0x7f, 0x7f, 0x7f, 0x7f
	de	0x7f, 0x7f, 0x7f, 0x7f, 0x7f, 0x7f, 0x7f, 0x7f, 0x7f, 0x7f, 0x7f, 0x7f, 0x7f, 0x7f, 0x7f, 0x7f

SEQ_PRESETS_LAYER_C
	de	0x10, 0x10, 0x10, 0x10, 0x10, 0x10, 0x10, 0x10, 0x10, 0x10, 0x10, 0x10, 0x10, 0x10, 0x10, 0x10
	de	0x10, 0x10, 0x10, 0x10, 0x10, 0x10, 0x10, 0x10, 0x10, 0x10, 0x10, 0x10, 0x10, 0x10, 0x10, 0x10
	de	0x10, 0x10, 0x10, 0x10, 0x10, 0x10, 0x10, 0x10, 0x10, 0x10, 0x10, 0x10, 0x10, 0x10, 0x10, 0x10
	de	0x10, 0x10, 0x10, 0x10, 0x10, 0x10, 0x10, 0x10, 0x10, 0x10, 0x10, 0x10, 0x10, 0x10, 0x10, 0x10

;; ---[ Misc Configuration ]-------------------------------------------------
	;; we are using this macro to simplify the configuration
SEQ_PRESETS_ENTRY	MACRO trk0, trk1, trk2, trk3
	de	((trk0)&0xf) | (((trk1)&0xf) << 4), ((trk2)&0xf) | (((trk3)&0xf) << 4)
	ENDM

SEQ_PRESETS_CFG_Offset
SEQ_PRESETS_CHANNEL	SEQ_PRESETS_ENTRY	0x0, 0x1, 0x2, 0x3
SEQ_PRESETS_EVENT	SEQ_PRESETS_ENTRY	0x9, 0x9, 0x9, 0x9
SEQ_PRESETS_MODE	SEQ_PRESETS_ENTRY	0x1, 0x1, 0x1, 0x1
SEQ_PRESETS_DIRECTION	SEQ_PRESETS_ENTRY	0x0, 0x0, 0x0, 0x0
SEQ_PRESETS_DIVIDER	SEQ_PRESETS_ENTRY	0x0, 0x0, 0x0, 0x0
SEQ_PRESETS_LENGTH	SEQ_PRESETS_ENTRY	0xf, 0xf, 0xf, 0xf
SEQ_PRESETS_ASSIGNS_NV	SEQ_PRESETS_ENTRY	0x4, 0x4, 0x4, 0x4
SEQ_PRESETS_ASSIGNS_L	SEQ_PRESETS_ENTRY	0x2, 0x2, 0x2, 0x2
SEQ_PRESETS_TRANSPOSE_O	SEQ_PRESETS_ENTRY	0x0, 0x0, 0x0, 0x0
SEQ_PRESETS_TRANSPOSE_S	SEQ_PRESETS_ENTRY	0x0, 0x0, 0x0, 0x0
SEQ_PRESETS_GROOVE_VAL	SEQ_PRESETS_ENTRY	0x0, 0x0, 0x0, 0x0
SEQ_PRESETS_GROOVE_FX	SEQ_PRESETS_ENTRY	0x0, 0x0, 0x0, 0x0
SEQ_PRESETS_MUTE0	SEQ_PRESETS_ENTRY	0xe, 0xf, 0xf, 0xf
SEQ_PRESETS_MUTE1	SEQ_PRESETS_ENTRY	0xe, 0xf, 0xf, 0xf
SEQ_PRESETS_MUTE2	SEQ_PRESETS_ENTRY	0xe, 0xf, 0xf, 0xf
SEQ_PRESETS_MUTE3	SEQ_PRESETS_ENTRY	0xe, 0xf, 0xf, 0xf
SEQ_PRESETS_MORPH	SEQ_PRESETS_ENTRY	0x0, 0x0, 0x0, 0x0

	;; fill unused range
	de	0, 0		; 0x44-0x47
	de	0, 0, 0, 0	; 0x48-0x4f
	de	0, 0, 0, 0	; 0x50-0x57
	de	0, 0, 0, 0	; 0x58-0x5f
SEQ_PRESETS_MORPH_PATTERN
	de	0x00, 0x00	; 0x60-0x63

	;; fill unused range
	de	0, 0		; 0x64-0x67
	de	0, 0, 0, 0	; 0x68-0x6f

SEQ_PRESETS_NEXT_PATTERN		de	0x00, 0x00
;; SEQ_PRESETS_REPEAT		de	0x00

	;; fill unused range
	de	0, 0

	;; global settings
SEQ_PRESETS_GLOBALS_Offset
#if 1
SEQ_PRESETS_CFG0			de	(1 << SEQ_CFG0_MERGEROFF), 140
#else
SEQ_PRESETS_CFG0			de	(1 << SEQ_CFG0_MERGEROFF), 0	; (MIDI slave mode)
#endif
;; SEQ_PRESETS_BPM			de	140
SEQ_PRESETS_METRONOME_CHN		de	0x09, DEFAULT_DEVICE_ID
;; SEQ_PRESETS_MIDI_CFG		de	DEFAULT_DEVICE_ID
