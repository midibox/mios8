; $Id$
;
; Configuration Tables for MIOS Application
;
; ==========================================================================
;
;  Copyright 2003 Thorsten Klose (tk@midibox.org)
;  Licensed for personal non-commercial use only.
;  All other rights reserved.
; 
; ==========================================================================

	org	0x3080		; never change the origin!

;; --------------------------------------------------------------------------
;; The MIDI Trigger table maps incoming MIDI events to control elements
;; (pots/faders, encoders, buttons, LEDs, ...)
;; 
;; After the MIOS MIDI processor (MPROC) has received a complete event, it
;; searches in this table for a matching entry and calls USER_MPROC_NotifyFoundEvent
;; with the table index in WREG and the MIDI event in MIOS_PARAMETER[123]
;; 
;; Note also that the MIDI processor stops scanning the table after
;; the first MT_EOT entry
;; 
;; Note2: never change the origin (memory location) of this table!
;; 
;; Optionally this table can also be used to define events, which should be
;; transmitted (Example: see example_ain64_din128_dout128), so that incoming
;; and outgoing events are located at one place
;; 
;; The table *must* contain 256 entries. Unused entries should be filled with
;; MT_EOT.
;; --------------------------------------------------------------------------

	;; MIDI Trigger entry structure
MT_ENTRY MACRO event_0, event_1
	dw	(event_1 << 8) | event_0
	ENDM

MT_EOT	MACRO
	dw	0xffff
	ENDM


MIOS_MPROC_EVENT_TABLE
	;; Bank 1
	MT_ENTRY	0xb0, 0x00
	MT_ENTRY	0xb0, 0x01
	MT_ENTRY	0xb0, 0x02
	MT_ENTRY	0xb0, 0x03
	MT_ENTRY	0xb0, 0x04
	
	;; Bank 2
	MT_ENTRY	0xb0, 0x05
	MT_ENTRY	0xb0, 0x06
	MT_ENTRY	0xb0, 0x07
	MT_ENTRY	0xb0, 0x08
	MT_ENTRY	0xb0, 0x09

	;; Bank 3
	MT_ENTRY	0xb0, 0x0a
	MT_ENTRY	0xb0, 0x0b
	MT_ENTRY	0xb0, 0x0c
	MT_ENTRY	0xb0, 0x0d
	MT_ENTRY	0xb0, 0x0e

	;; Bank 4
	MT_ENTRY	0xb0, 0x0f
	MT_ENTRY	0xb0, 0x10
	MT_ENTRY	0xb0, 0x11
	MT_ENTRY	0xb0, 0x12
	MT_ENTRY	0xb0, 0x13

	;; Bank 5
	MT_ENTRY	0xb0, 0x14
	MT_ENTRY	0xb0, 0x15
	MT_ENTRY	0xb0, 0x16
	MT_ENTRY	0xb0, 0x17
	MT_ENTRY	0xb0, 0x18

	;; Bank 6
	MT_ENTRY	0xb0, 0x19
	MT_ENTRY	0xb0, 0x1a
	MT_ENTRY	0xb0, 0x1b
	MT_ENTRY	0xb0, 0x1c
	MT_ENTRY	0xb0, 0x1d

	;; Bank 7
	MT_ENTRY	0xb0, 0x1e
	MT_ENTRY	0xb0, 0x1f
	MT_ENTRY	0xb0, 0x20
	MT_ENTRY	0xb0, 0x21
	MT_ENTRY	0xb0, 0x22

	;; Bank 8
	MT_ENTRY	0xb0, 0x23
	MT_ENTRY	0xb0, 0x24
	MT_ENTRY	0xb0, 0x25
	MT_ENTRY	0xb0, 0x26
	MT_ENTRY	0xb0, 0x27

	;; Bank 9
	MT_ENTRY	0xb0, 0x28
	MT_ENTRY	0xb0, 0x29
	MT_ENTRY	0xb0, 0x2a
	MT_ENTRY	0xb0, 0x2b
	MT_ENTRY	0xb0, 0x2c

	;; Bank 10
	MT_ENTRY	0xb0, 0x2d
	MT_ENTRY	0xb0, 0x2e
	MT_ENTRY	0xb0, 0x2f
	MT_ENTRY	0xb0, 0x30
	MT_ENTRY	0xb0, 0x31

	;; Bank 11
	MT_ENTRY	0xb0, 0x32
	MT_ENTRY	0xb0, 0x33
	MT_ENTRY	0xb0, 0x34
	MT_ENTRY	0xb0, 0x35
	MT_ENTRY	0xb0, 0x36

	;; Bank 12
	MT_ENTRY	0xb0, 0x37
	MT_ENTRY	0xb0, 0x38
	MT_ENTRY	0xb0, 0x39
	MT_ENTRY	0xb0, 0x3a
	MT_ENTRY	0xb0, 0x3b

	;; Bank 13
	MT_ENTRY	0xb0, 0x3c
	MT_ENTRY	0xb0, 0x3d
	MT_ENTRY	0xb0, 0x3e
	MT_ENTRY	0xb0, 0x3f
	MT_ENTRY	0xb0, 0x40

	;; Bank 14
	MT_ENTRY	0xb0, 0x41
	MT_ENTRY	0xb0, 0x42
	MT_ENTRY	0xb0, 0x43
	MT_ENTRY	0xb0, 0x44
	MT_ENTRY	0xb0, 0x45

	;; Bank 15
	MT_ENTRY	0xb0, 0x46
	MT_ENTRY	0xb0, 0x47
	MT_ENTRY	0xb0, 0x48
	MT_ENTRY	0xb0, 0x49
	MT_ENTRY	0xb0, 0x4a

	;; Bank 16
	MT_ENTRY	0xb0, 0x4b
	MT_ENTRY	0xb0, 0x4c
	MT_ENTRY	0xb0, 0x4d
	MT_ENTRY	0xb0, 0x4e
	MT_ENTRY	0xb0, 0x4f

	;; Bank 17
	MT_ENTRY	0xb0, 0x50
	MT_ENTRY	0xb0, 0x51
	MT_ENTRY	0xb0, 0x52
	MT_ENTRY	0xb0, 0x53
	MT_ENTRY	0xb0, 0x54

	;; Bank 18
	MT_ENTRY	0xb0, 0x55
	MT_ENTRY	0xb0, 0x56
	MT_ENTRY	0xb0, 0x57
	MT_ENTRY	0xb0, 0x58
	MT_ENTRY	0xb0, 0x59

	;; Bank 19
	MT_ENTRY	0xb0, 0x5a
	MT_ENTRY	0xb0, 0x5b
	MT_ENTRY	0xb0, 0x5c
	MT_ENTRY	0xb0, 0x5d
	MT_ENTRY	0xb0, 0x5e

	;; Bank 20
	MT_ENTRY	0xb0, 0x5f
	MT_ENTRY	0xb0, 0x60
	MT_ENTRY	0xb0, 0x61
	MT_ENTRY	0xb0, 0x62
	MT_ENTRY	0xb0, 0x63

	;; Bank 21
	MT_ENTRY	0xb0, 0x64
	MT_ENTRY	0xb0, 0x65
	MT_ENTRY	0xb0, 0x66
	MT_ENTRY	0xb0, 0x67
	MT_ENTRY	0xb0, 0x68

	;; Bank 22
	MT_ENTRY	0xb0, 0x69
	MT_ENTRY	0xb0, 0x6a
	MT_ENTRY	0xb0, 0x6b
	MT_ENTRY	0xb0, 0x6c
	MT_ENTRY	0xb0, 0x6d

	;; Bank 23
	MT_ENTRY	0xb0, 0x6e
	MT_ENTRY	0xb0, 0x6f
	MT_ENTRY	0xb0, 0x70
	MT_ENTRY	0xb0, 0x71
	MT_ENTRY	0xb0, 0x72

	;; Bank 24
	MT_ENTRY	0xb0, 0x73
	MT_ENTRY	0xb0, 0x74
	MT_ENTRY	0xb0, 0x75
	MT_ENTRY	0xb0, 0x76
	MT_ENTRY	0xb0, 0x77

	;; Bank 25
	MT_ENTRY	0xb0, 0x78
	MT_ENTRY	0xb0, 0x79
	MT_ENTRY	0xb0, 0x7a
	MT_ENTRY	0xb0, 0x7b
	MT_ENTRY	0xb0, 0x7c

	;; Bank 26
	MT_ENTRY	0xb0, 0x7d
	MT_ENTRY	0xb0, 0x7e
	MT_ENTRY	0xb0, 0x7f
	MT_ENTRY	0xb1, 0x00
	MT_ENTRY	0xb1, 0x01

	;; Bank 27
	MT_ENTRY	0xb1, 0x02
	MT_ENTRY	0xb1, 0x03
	MT_ENTRY	0xb1, 0x04
	MT_ENTRY	0xb1, 0x05
	MT_ENTRY	0xb1, 0x06

	;; Bank 28
	MT_ENTRY	0xb1, 0x07
	MT_ENTRY	0xb1, 0x08
	MT_ENTRY	0xb1, 0x09
	MT_ENTRY	0xb1, 0x0a
	MT_ENTRY	0xb1, 0x0b

	;; Bank 29
	MT_ENTRY	0xb1, 0x0c
	MT_ENTRY	0xb1, 0x0d
	MT_ENTRY	0xb1, 0x0e
	MT_ENTRY	0xb1, 0x0f
	MT_ENTRY	0xb1, 0x10

	;; Bank 30
	MT_ENTRY	0xb1, 0x11
	MT_ENTRY	0xb1, 0x12
	MT_ENTRY	0xb1, 0x13
	MT_ENTRY	0xb1, 0x14
	MT_ENTRY	0xb1, 0x15

	;; Bank 31
	MT_ENTRY	0xb1, 0x16
	MT_ENTRY	0xb1, 0x17
	MT_ENTRY	0xb1, 0x18
	MT_ENTRY	0xb1, 0x19
	MT_ENTRY	0xb1, 0x1a

	;; Bank 32
	MT_ENTRY	0xb1, 0x1b
	MT_ENTRY	0xb1, 0x1c
	MT_ENTRY	0xb1, 0x1d
	MT_ENTRY	0xb1, 0x1e
	MT_ENTRY	0xb1, 0x1f

	;; Bank 33
	MT_ENTRY	0xb1, 0x20
	MT_ENTRY	0xb1, 0x21
	MT_ENTRY	0xb1, 0x22
	MT_ENTRY	0xb1, 0x23
	MT_ENTRY	0xb1, 0x24

	;; Bank 34
	MT_ENTRY	0xb1, 0x25
	MT_ENTRY	0xb1, 0x26
	MT_ENTRY	0xb1, 0x27
	MT_ENTRY	0xb1, 0x28
	MT_ENTRY	0xb1, 0x29

	;; Bank 35
	MT_ENTRY	0xb1, 0x2a
	MT_ENTRY	0xb1, 0x2b
	MT_ENTRY	0xb1, 0x2c
	MT_ENTRY	0xb1, 0x2d
	MT_ENTRY	0xb1, 0x2e

	;; Bank 36
	MT_ENTRY	0xb1, 0x2f
	MT_ENTRY	0xb1, 0x30
	MT_ENTRY	0xb1, 0x31
	MT_ENTRY	0xb1, 0x32
	MT_ENTRY	0xb1, 0x33

	;; Bank 37
	MT_ENTRY	0xb1, 0x34
	MT_ENTRY	0xb1, 0x35
	MT_ENTRY	0xb1, 0x36
	MT_ENTRY	0xb1, 0x37
	MT_ENTRY	0xb1, 0x38

	;; Bank 38
	MT_ENTRY	0xb1, 0x39
	MT_ENTRY	0xb1, 0x3a
	MT_ENTRY	0xb1, 0x3b
	MT_ENTRY	0xb1, 0x3c
	MT_ENTRY	0xb1, 0x3d

	;; Bank 39
	MT_ENTRY	0xb1, 0x3e
	MT_ENTRY	0xb1, 0x3f
	MT_ENTRY	0xb1, 0x40
	MT_ENTRY	0xb1, 0x41
	MT_ENTRY	0xb1, 0x42

	;; Bank 40
	MT_ENTRY	0xb1, 0x43
	MT_ENTRY	0xb1, 0x44
	MT_ENTRY	0xb1, 0x45
	MT_ENTRY	0xb1, 0x46
	MT_ENTRY	0xb1, 0x47

	;; Bank 41
	MT_ENTRY	0xb1, 0x48
	MT_ENTRY	0xb1, 0x49
	MT_ENTRY	0xb1, 0x4a
	MT_ENTRY	0xb1, 0x4b
	MT_ENTRY	0xb1, 0x4c

	;; Bank 42
	MT_ENTRY	0xb1, 0x4d
	MT_ENTRY	0xb1, 0x4e
	MT_ENTRY	0xb1, 0x4f
	MT_ENTRY	0xb1, 0x50
	MT_ENTRY	0xb1, 0x51

	;; Bank 43
	MT_ENTRY	0xb1, 0x52
	MT_ENTRY	0xb1, 0x53
	MT_ENTRY	0xb1, 0x54
	MT_ENTRY	0xb1, 0x55
	MT_ENTRY	0xb1, 0x56

	;; Bank 44
	MT_ENTRY	0xb1, 0x57
	MT_ENTRY	0xb1, 0x58
	MT_ENTRY	0xb1, 0x59
	MT_ENTRY	0xb1, 0x5a
	MT_ENTRY	0xb1, 0x5b

	;; Bank 45
	MT_ENTRY	0xb1, 0x5c
	MT_ENTRY	0xb1, 0x5d
	MT_ENTRY	0xb1, 0x5e
	MT_ENTRY	0xb1, 0x5f
	MT_ENTRY	0xb1, 0x60

	;; Bank 46
	MT_ENTRY	0xb1, 0x61
	MT_ENTRY	0xb1, 0x62
	MT_ENTRY	0xb1, 0x63
	MT_ENTRY	0xb1, 0x64
	MT_ENTRY	0xb1, 0x65

	;; Bank 47
	MT_ENTRY	0xb1, 0x66
	MT_ENTRY	0xb1, 0x67
	MT_ENTRY	0xb1, 0x68
	MT_ENTRY	0xb1, 0x69
	MT_ENTRY	0xb1, 0x6a

	;; Bank 48
	MT_ENTRY	0xb1, 0x6b
	MT_ENTRY	0xb1, 0x6c
	MT_ENTRY	0xb1, 0x6d
	MT_ENTRY	0xb1, 0x6e
	MT_ENTRY	0xb1, 0x6f

	;; Bank 49
	MT_ENTRY	0xb1, 0x70
	MT_ENTRY	0xb1, 0x71
	MT_ENTRY	0xb1, 0x72
	MT_ENTRY	0xb1, 0x73
	MT_ENTRY	0xb1, 0x74

	;; Bank 50
	MT_ENTRY	0xb1, 0x75
	MT_ENTRY	0xb1, 0x76
	MT_ENTRY	0xb1, 0x77
	MT_ENTRY	0xb1, 0x78
	MT_ENTRY	0xb1, 0x79

	;; Bank 51
	MT_ENTRY	0xb1, 0x7a
	MT_ENTRY	0xb1, 0x7b
	MT_ENTRY	0xb1, 0x7c
	MT_ENTRY	0xb1, 0x7d
	MT_ENTRY	0xb1, 0x7e

	;; UNUSED!
	MT_ENTRY	0xb1, 0x7f



; ==========================================================================

	org	0x3280		; never change the origin!

;; --------------------------------------------------------------------------
;; In this table DIN pins have to be assigned to rotary encoders for the
;; MIOS_ENC driver 
;; 
;; up to 64 entries are provided
;; 
;; The table must be terminated with an ENC_EOT entry. Unused entries should
;; be filled with ENC_EOT
;; 
;; ENC_ENTRY provides following parameters
;;    o first parameter: number of shift register - 1, 2, 3, ... 16
;;    o second parameter: number of pin; since two pins are necessary
;;      for each encoder, an even number is expected: 0, 2, 4 or 6
;;    o the third parameter contains the encoder mode:
;;      either MIOS_ENC_MODE_NON_DETENTED
;;          or MIOS_ENC_MODE_DETENTED
;;
;; Configuration Examples:
;;    ENC_ENTRY  1,  0,  MIOS_ENC_MODE_NON_DETENTED    ; non-detented encoder at pin 0 and 1 of SR 1
;;    ENC_ENTRY  1,  2,  MIOS_ENC_MODE_DETENTED        ; detented encoder at pin 2 and 3 of SR 1
;;    ENC_ENTRY  9,  6,  MIOS_ENC_MODE_NON_DETENTED    ; non-detented encoder at pin 6 and 7 of SR 9
;; --------------------------------------------------------------------------

	;; encoder entry structure
ENC_ENTRY MACRO sr, din_0, mode
	dw	(mode << 8) | (din_0 + 8*(sr-1))
	ENDM	
ENC_EOT	MACRO
	dw	0xffff
	ENDM

MIOS_ENC_PIN_TABLE
	;; encoders 1-16
	;;        SR  Pin  Mode
	ENC_ENTRY  1,  0,  MIOS_ENC_MODE_NON_DETENTED	; non-detented encoder at pin 0 and 1 of SR 1
	ENC_EOT
	ENC_EOT
	ENC_EOT
	ENC_EOT
	ENC_EOT
	ENC_EOT
	ENC_EOT
	ENC_EOT
	ENC_EOT
	ENC_EOT
	ENC_EOT
	ENC_EOT
	ENC_EOT
	ENC_EOT
	ENC_EOT

	;; encoders 17-32
	ENC_EOT
	ENC_EOT
	ENC_EOT
	ENC_EOT
	ENC_EOT
	ENC_EOT
	ENC_EOT
	ENC_EOT
	ENC_EOT
	ENC_EOT
	ENC_EOT
	ENC_EOT
	ENC_EOT
	ENC_EOT
	ENC_EOT
	ENC_EOT

	;; encoders 33-48
	ENC_EOT
	ENC_EOT
	ENC_EOT
	ENC_EOT
	ENC_EOT
	ENC_EOT
	ENC_EOT
	ENC_EOT
	ENC_EOT
	ENC_EOT
	ENC_EOT
	ENC_EOT
	ENC_EOT
	ENC_EOT
	ENC_EOT
	ENC_EOT

	;; encoders 49-64
	ENC_EOT
	ENC_EOT
	ENC_EOT
	ENC_EOT
	ENC_EOT
	ENC_EOT
	ENC_EOT
	ENC_EOT
	ENC_EOT
	ENC_EOT
	ENC_EOT
	ENC_EOT
	ENC_EOT
	ENC_EOT
	ENC_EOT
	ENC_EOT

	org	0x3300		; never change the origin!
