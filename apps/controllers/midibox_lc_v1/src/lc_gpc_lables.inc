; $Id$
;
; MIDIbox LC General Purpose Controller Lables
;
; ==========================================================================
;
;  Copyright 1998-2003 Thorsten Klose (tk@midibox.org)
;  Licensed for personal non-commercial use only.
;  All other rights reserved.
; 
; ==========================================================================

;; --------------------------------------------------------------------------
;;  Enter the lables for all 128 GPC entries here
;; --------------------------------------------------------------------------
LC_GPC_LABLES
	;; entry 0x00-0x0f
	;;      <------>
	db	"CC#001"
	db	"CC#002"
	db	"CC#003"
	db	"CC#004"
	db	"CC#005"
	db	"CC#006"
	db	"CC#007"
	db	"CC#008"
	db	"CC#009"	
	db	"CC#010"
	db	"CC#011"
	db	"CC#012"
	db	"CC#013"
	db	"CC#014"
	db	"CC#015"
	db	"CC#016"

	;; entry 0x10-0x1f
	;;      <------>
	db	"CC#017"
	db	"CC#018"
	db	"CC#019"
	db	"CC#020"
	db	"CC#021"
	db	"CC#022"
	db	"CC#023"
	db	"CC#024"
	db	"CC#025"
	db	"CC#026"
	db	"CC#027"
	db	"CC#028"
	db	"CC#029"
	db	"CC#030"
	db	"CC#031"
	db	"CC#032"

	;; entry 0x20-0x2f
	;;      <------>
	db	"CC#033"
	db	"CC#034"
	db	"CC#035"
	db	"CC#036"
	db	"CC#037"
	db	"CC#038"
	db	"CC#039"
	db	"CC#040"
	db	"CC#041"
	db	"CC#042"
	db	"CC#043"
	db	"CC#044"
	db	"CC#045"
	db	"CC#046"
	db	"CC#047"
	db	"CC#048"

	;; entry 0x30-0x3f
	;;      <------>
	db	"CC#049"
	db	"CC#050"
	db	"CC#051"
	db	"CC#052"
	db	"CC#053"
	db	"CC#054"
	db	"CC#055"
	db	"CC#056"
	db	"CC#057"
	db	"CC#058"
	db	"CC#059"
	db	"CC#060"
	db	"CC#061"
	db	"CC#062"
	db	"CC#063"
	db	"CC#064"

	;; entry 0x40-0x4f
	;;      <------>
	db	"CC#065"
	db	"CC#066"
	db	"CC#067"
	db	"CC#068"
	db	"CC#069"
	db	"CC#070"
	db	"CC#071"
	db	"CC#072"
	db	"CC#073"
	db	"CC#074"
	db	"CC#075"
	db	"CC#076"
	db	"CC#077"
	db	"CC#078"
	db	"CC#079"
	db	"CC#080"

	;; entry 0x50-0x5f
	;;      <------>
	db	"CC#081"
	db	"CC#082"
	db	"CC#083"
	db	"CC#084"
	db	"CC#085"
	db	"CC#086"
	db	"CC#087"
	db	"CC#088"
	db	"CC#089"
	db	"CC#090"
	db	"CC#091"
	db	"CC#092"
	db	"CC#093"
	db	"CC#094"
	db	"CC#095"
	db	"CC#096"

	;; entry 0x60-0x6f
	;;      <------>
	db	"CC#097"
	db	"CC#098"
	db	"CC#099"
	db	"CC#100"
	db	"CC#101"
	db	"CC#102"
	db	"CC#103"
	db	"CC#104"
	db	"CC#105"
	db	"CC#106"
	db	"CC#107"
	db	"CC#108"
	db	"CC#109"
	db	"CC#110"
	db	"CC#111"
	db	"CC#112"

	;; entry 0x70-0x7f
	;;      <------>
	db	"CC#113"
	db	"CC#114"
	db	"CC#115"
	db	"CC#116"
	db	"CC#117"
	db	"CC#118"
	db	"CC#119"
	db	"CC#120"
	db	"CC#121"
	db	"CC#122"
	db	"CC#123"
	db	"CC#124"
	db	"CC#125"
	db	"CC#126"
	db	"CC#127"
	db	"CC#128"
