; $Id: glcd_font_knob_icons.inc 83 2008-02-04 01:07:03Z tk $

;; converted with '$MIOS_BIN_PATH/convpix.pl glcd_font_knob_icons.xpm -icons 12 -height 24'
;; FONT_ENTRY manually added
GLCD_FONT_KNOB_ICONS
	FONT_ENTRY 28, 3, 2, 32	; width/height/X0 offset/char offset

	da b'0000000000000000'
	da b'0000000000000000'
	da b'0000000000000000'
	da b'0000000000000000'
	da b'1000000000000000'
	da b'0001000001100000'
	da b'0000100000010000'
	da b'0000100000001000'
	da b'0000100000001000'
	da b'0001000000010000'
	da b'1000000001100000'
	da b'0000000000000000'
	da b'0000000000000000'
	da b'0000000000000000'
	da b'0000000000000000'
	da b'0000000000000000'
	da b'0000000000000000'
	da b'0000000000000000'
	da b'0000000000000000'
	da b'0000000000000000'
	da b'1100000100111110'
	da b'0000000000000000'
	da b'0000000000000000'
	da b'0000000000000000'
	da b'0000000000000000'
	da b'0000000000000000'
	da b'1100000100000000'
	da b'0111110011111110'
	da b'0000000000000000'
	da b'0000000000000000'
	da b'0000000000000000'
	da b'0000000000000000'
	da b'0000000000000000'
	da b'0000000000000000'
	da b'0000000000000000'
	da b'0000000000000000'
	da b'0000000000000000'
	da b'0000010000000011'
	da b'0000100000000100'
	da b'0001100000011000'
	da b'0001100000011000'
	da b'0000110000011100'
	da b'0000011100001111'
	da b'0000000000000001'
	da b'0000000000000000'
	da b'0000000000000000'
	da b'0000000000000000'
	da b'0000000000000000'
	da b'0000000000000000'
	da b'0000000000000000'
	da b'0000000000000000'
	da b'0000000000000000'
	da b'1000000000000000'
	da b'0001000001100000'
	da b'0000100000010000'
	da b'0000100000001000'
	da b'0000100000001000'
	da b'0001000000010000'
	da b'1000000001100000'
	da b'0000000000000000'
	da b'0000000000000000'
	da b'0000000000000000'
	da b'0000000000000000'
	da b'0000000000000000'
	da b'0000000000000000'
	da b'0000000000000000'
	da b'0000000000000000'
	da b'0000000000000000'
	da b'1100000100111110'
	da b'0000000000000000'
	da b'0110000010000000'
	da b'0000100000010000'
	da b'0000000000000000'
	da b'0000000000000000'
	da b'1100000100000000'
	da b'0111110011111110'
	da b'0000000000000000'
	da b'0000000000000000'
	da b'0000000000000000'
	da b'0000000000000000'
	da b'0000000000000000'
	da b'0000000000000000'
	da b'0000000000000000'
	da b'0000000000000000'
	da b'0000000000000000'
	da b'0000010100000011'
	da b'0000100000000100'
	da b'0001100000011000'
	da b'0001100000011000'
	da b'0000110000011100'
	da b'0000011100001111'
	da b'0000000000000001'
	da b'0000000000000000'
	da b'0000000000000000'
	da b'0000000000000000'
	da b'0000000000000000'
	da b'0000000000000000'
	da b'0000000000000000'
	da b'0000000000000000'
	da b'0000000000000000'
	da b'1000000000000000'
	da b'0001000001100000'
	da b'0000100000010000'
	da b'0000100000001000'
	da b'0000100000001000'
	da b'0001000000010000'
	da b'1000000001100000'
	da b'0000000000000000'
	da b'0000000000000000'
	da b'0000000000000000'
	da b'0000000000000000'
	da b'0000000000000000'
	da b'0000000000000000'
	da b'0000000000000000'
	da b'0000000000000000'
	da b'0000000000000000'
	da b'1110000100111110'
	da b'0001000000100000'
	da b'0001000000010000'
	da b'0000100000001000'
	da b'0000000000000000'
	da b'0000000000000000'
	da b'1100000100000000'
	da b'0111110011111110'
	da b'0000000000000000'
	da b'0000000000000000'
	da b'0000000000000000'
	da b'0000000000000000'
	da b'0000000000000000'
	da b'0000000000000000'
	da b'0000000000000000'
	da b'0000000000000000'
	da b'0000000000000000'
	da b'0000010000000011'
	da b'0000100000000100'
	da b'0001100000011000'
	da b'0001100000011000'
	da b'0000110000011100'
	da b'0000011100001111'
	da b'0000000000000001'
	da b'0000000000000000'
	da b'0000000000000000'
	da b'0000000000000000'
	da b'0000000000000000'
	da b'0000000000000000'
	da b'0000000000000000'
	da b'0000000000000000'
	da b'0000000000000000'
	da b'1000000000000000'
	da b'0001000001100000'
	da b'0000100000010000'
	da b'0000100000001000'
	da b'0000100000001000'
	da b'0001000000010000'
	da b'1000000001100000'
	da b'0000000000000000'
	da b'0000000000000000'
	da b'0000000000000000'
	da b'0000000000000000'
	da b'0000000000000000'
	da b'0000000000000000'
	da b'0000000000000000'
	da b'0000000000000000'
	da b'0000000000000000'
	da b'1100010100111110'
	da b'0000010000000100'
	da b'0000100000001000'
	da b'0000100000001000'
	da b'0000000000000000'
	da b'0000000000000000'
	da b'1100000100000000'
	da b'0111110011111110'
	da b'0000000000000000'
	da b'0000000000000000'
	da b'0000000000000000'
	da b'0000000000000000'
	da b'0000000000000000'
	da b'0000000000000000'
	da b'0000000000000000'
	da b'0000000000000000'
	da b'0000000000000000'
	da b'0000010000000011'
	da b'0000100000000100'
	da b'0001100000011000'
	da b'0001100000011000'
	da b'0000110000011100'
	da b'0000011100001111'
	da b'0000000000000001'
	da b'0000000000000000'
	da b'0000000000000000'
	da b'0000000000000000'
	da b'0000000000000000'
	da b'0000000000000000'
	da b'0000000000000000'
	da b'0000000000000000'
	da b'0000000000000000'
	da b'1000000000000000'
	da b'0001000011100000'
	da b'0000100000010000'
	da b'0000100000001000'
	da b'0000100000001000'
	da b'0001000000010000'
	da b'1000000001100000'
	da b'0000000000000000'
	da b'0000000000000000'
	da b'0000000000000000'
	da b'0000000000000000'
	da b'0000000000000000'
	da b'0000000000000000'
	da b'0000000000000000'
	da b'0000000000000000'
	da b'0000000000000000'
	da b'1100000100111110'
	da b'0000000100000000'
	da b'0000001000000010'
	da b'0000100000000100'
	da b'0000000000000000'
	da b'0000000000000000'
	da b'1100000100000000'
	da b'0111110011111110'
	da b'0000000000000000'
	da b'0000000000000000'
	da b'0000000000000000'
	da b'0000000000000000'
	da b'0000000000000000'
	da b'0000000000000000'
	da b'0000000000000000'
	da b'0000000000000000'
	da b'0000000000000000'
	da b'0000010000000011'
	da b'0000100000000100'
	da b'0001100000011000'
	da b'0001100000011000'
	da b'0000110000011100'
	da b'0000011100001111'
	da b'0000000000000001'
	da b'0000000000000000'
	da b'0000000000000000'
	da b'0000000000000000'
	da b'0000000000000000'
	da b'0000000000000000'
	da b'0000000000000000'
	da b'0000000000000000'
	da b'0000000000000000'
	da b'1000000000000000'
	da b'0001000001100000'
	da b'1100100000110000'
	da b'0000100000001000'
	da b'0000100000001000'
	da b'0001000000010000'
	da b'1000000001100000'
	da b'0000000000000000'
	da b'0000000000000000'
	da b'0000000000000000'
	da b'0000000000000000'
	da b'0000000000000000'
	da b'0000000000000000'
	da b'0000000000000000'
	da b'0000000000000000'
	da b'0000000000000000'
	da b'1100000100111110'
	da b'0000000000000000'
	da b'0000000000000000'
	da b'0000110000000011'
	da b'0000000000000000'
	da b'0000000000000000'
	da b'1100000100000000'
	da b'0111110011111110'
	da b'0000000000000000'
	da b'0000000000000000'
	da b'0000000000000000'
	da b'0000000000000000'
	da b'0000000000000000'
	da b'0000000000000000'
	da b'0000000000000000'
	da b'0000000000000000'
	da b'0000000000000000'
	da b'0000010000000011'
	da b'0000100000000100'
	da b'0001100000011000'
	da b'0001100000011000'
	da b'0000110000011100'
	da b'0000011100001111'
	da b'0000000000000001'
	da b'0000000000000000'
	da b'0000000000000000'
	da b'0000000000000000'
	da b'0000000000000000'
	da b'0000000000000000'
	da b'0000000000000000'
	da b'0000000000000000'
	da b'0000000000000000'
	da b'1000000000000000'
	da b'0001000001100000'
	da b'0000100000010000'
	da b'1111100000001000'
	da b'0000100000001000'
	da b'0001000000010000'
	da b'1000000001100000'
	da b'0000000000000000'
	da b'0000000000000000'
	da b'0000000000000000'
	da b'0000000000000000'
	da b'0000000000000000'
	da b'0000000000000000'
	da b'0000000000000000'
	da b'0000000000000000'
	da b'0000000000000000'
	da b'1100000100111110'
	da b'0000000000000000'
	da b'0000000000000000'
	da b'0000111100000000'
	da b'0000000000000000'
	da b'0000000000000000'
	da b'1100000100000000'
	da b'0111110011111110'
	da b'0000000000000000'
	da b'0000000000000000'
	da b'0000000000000000'
	da b'0000000000000000'
	da b'0000000000000000'
	da b'0000000000000000'
	da b'0000000000000000'
	da b'0000000000000000'
	da b'0000000000000000'
	da b'0000010000000011'
	da b'0000100000000100'
	da b'0001100000011000'
	da b'0001100000011000'
	da b'0000110000011100'
	da b'0000011100001111'
	da b'0000000000000001'
	da b'0000000000000000'
	da b'0000000000000000'
	da b'0000000000000000'
	da b'0000000000000000'
	da b'0000000000000000'
	da b'0000000000000000'
	da b'0000000000000000'
	da b'0000000000000000'
	da b'1000000000000000'
	da b'0001000001100000'
	da b'0000100000010000'
	da b'0000100000001000'
	da b'1100100000001000'
	da b'0001000000110000'
	da b'1000000001100000'
	da b'0000000000000000'
	da b'0000000000000000'
	da b'0000000000000000'
	da b'0000000000000000'
	da b'0000000000000000'
	da b'0000000000000000'
	da b'0000000000000000'
	da b'0000000000000000'
	da b'0000000000000000'
	da b'1100000100111110'
	da b'0000000000000000'
	da b'0000000000000000'
	da b'0000110000000000'
	da b'0000000000000011'
	da b'0000000000000000'
	da b'1100000100000000'
	da b'0111110011111110'
	da b'0000000000000000'
	da b'0000000000000000'
	da b'0000000000000000'
	da b'0000000000000000'
	da b'0000000000000000'
	da b'0000000000000000'
	da b'0000000000000000'
	da b'0000000000000000'
	da b'0000000000000000'
	da b'0000010000000011'
	da b'0000100000000100'
	da b'0001100000011000'
	da b'0001100000011000'
	da b'0000110000011100'
	da b'0000011100001111'
	da b'0000000000000001'
	da b'0000000000000000'
	da b'0000000000000000'
	da b'0000000000000000'
	da b'0000000000000000'
	da b'0000000000000000'
	da b'0000000000000000'
	da b'0000000000000000'
	da b'0000000000000000'
	da b'1000000000000000'
	da b'0001000001100000'
	da b'0000100000010000'
	da b'0000100000001000'
	da b'0000100000001000'
	da b'0001000000010000'
	da b'1000000011100000'
	da b'0000000000000000'
	da b'0000000000000000'
	da b'0000000000000000'
	da b'0000000000000000'
	da b'0000000000000000'
	da b'0000000000000000'
	da b'0000000000000000'
	da b'0000000000000000'
	da b'0000000000000000'
	da b'1100000100111110'
	da b'0000000000000000'
	da b'0000000000000000'
	da b'0000100000000000'
	da b'0000001000000100'
	da b'0000000100000010'
	da b'1100000100000000'
	da b'0111110011111110'
	da b'0000000000000000'
	da b'0000000000000000'
	da b'0000000000000000'
	da b'0000000000000000'
	da b'0000000000000000'
	da b'0000000000000000'
	da b'0000000000000000'
	da b'0000000000000000'
	da b'0000000000000000'
	da b'0000010000000011'
	da b'0000100000000100'
	da b'0001100000011000'
	da b'0001100000011000'
	da b'0000110000011100'
	da b'0000011100001111'
	da b'0000000000000001'
	da b'0000000000000000'
	da b'0000000000000000'
	da b'0000000000000000'
	da b'0000000000000000'
	da b'0000000000000000'
	da b'0000000000000000'
	da b'0000000000000000'
	da b'0000000000000000'
	da b'1000000000000000'
	da b'0001000001100000'
	da b'0000100000010000'
	da b'0000100000001000'
	da b'0000100000001000'
	da b'0001000000010000'
	da b'1000000001100000'
	da b'0000000000000000'
	da b'0000000000000000'
	da b'0000000000000000'
	da b'0000000000000000'
	da b'0000000000000000'
	da b'0000000000000000'
	da b'0000000000000000'
	da b'0000000000000000'
	da b'0000000000000000'
	da b'1100000100111110'
	da b'0000000000000000'
	da b'0000000000000000'
	da b'0000100000000000'
	da b'0000100000001000'
	da b'0000010000000100'
	da b'1100010100000100'
	da b'0111110011111110'
	da b'0000000000000000'
	da b'0000000000000000'
	da b'0000000000000000'
	da b'0000000000000000'
	da b'0000000000000000'
	da b'0000000000000000'
	da b'0000000000000000'
	da b'0000000000000000'
	da b'0000000000000000'
	da b'0000010000000011'
	da b'0000100000000100'
	da b'0001100000011000'
	da b'0001100000011000'
	da b'0000110000011100'
	da b'0000011100001111'
	da b'0000000000000001'
	da b'0000000000000000'
	da b'0000000000000000'
	da b'0000000000000000'
	da b'0000000000000000'
	da b'0000000000000000'
	da b'0000000000000000'
	da b'0000000000000000'
	da b'0000000000000000'
	da b'1000000000000000'
	da b'0001000001100000'
	da b'0000100000010000'
	da b'0000100000001000'
	da b'0000100000001000'
	da b'0001000000010000'
	da b'1000000001100000'
	da b'0000000000000000'
	da b'0000000000000000'
	da b'0000000000000000'
	da b'0000000000000000'
	da b'0000000000000000'
	da b'0000000000000000'
	da b'0000000000000000'
	da b'0000000000000000'
	da b'0000000000000000'
	da b'1100000100111110'
	da b'0000000000000000'
	da b'0000000000000000'
	da b'0000100000000000'
	da b'0001000000001000'
	da b'0010000000010000'
	da b'1100000100100000'
	da b'0111110011111110'
	da b'0000000000000000'
	da b'0000000000000000'
	da b'0000000000000000'
	da b'0000000000000000'
	da b'0000000000000000'
	da b'0000000000000000'
	da b'0000000000000000'
	da b'0000000000000000'
	da b'0000000000000000'
	da b'0000010000000011'
	da b'0000100000000100'
	da b'0001100000011000'
	da b'0001100000011000'
	da b'0000110000011100'
	da b'0000011100001111'
	da b'0000000000000001'
	da b'0000000000000000'
	da b'0000000000000000'
	da b'0000000000000000'
	da b'0000000000000000'
	da b'0000000000000000'
	da b'0000000000000000'
	da b'0000000000000000'
	da b'0000000000000000'
	da b'1000000000000000'
	da b'0001000001100000'
	da b'0000100000010000'
	da b'0000100000001000'
	da b'0000100000001000'
	da b'0001000000010000'
	da b'1000000001100000'
	da b'0000000000000000'
	da b'0000000000000000'
	da b'0000000000000000'
	da b'0000000000000000'
	da b'0000000000000000'
	da b'0000000000000000'
	da b'0000000000000000'
	da b'0000000000000000'
	da b'0000000000000000'
	da b'1100000100111110'
	da b'0000000000000000'
	da b'0000000000000000'
	da b'0000100000000000'
	da b'0110000000010000'
	da b'0000000010000000'
	da b'1100000100000000'
	da b'0111110011111110'
	da b'0000000000000000'
	da b'0000000000000000'
	da b'0000000000000000'
	da b'0000000000000000'
	da b'0000000000000000'
	da b'0000000000000000'
	da b'0000000000000000'
	da b'0000000000000000'
	da b'0000000000000000'
	da b'0000010000000011'
	da b'0000100000000100'
	da b'0001100000011000'
	da b'0001100000011000'
	da b'0000110100011100'
	da b'0000011100001111'
	da b'0000000000000001'
	da b'0000000000000000'
	da b'0000000000000000'
	da b'0000000000000000'
	da b'0000000000000000'


