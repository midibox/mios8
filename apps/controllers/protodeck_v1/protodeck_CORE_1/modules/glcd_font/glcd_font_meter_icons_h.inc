;; converted with '$MIOS_BIN_PATH/convpix.pl glcd_font_meter_icons_h.xpm -icons 1 -height 8'
;; FONT_ENTRY manually added

GLCD_FONT_METER_ICONS_H
	FONT_ENTRY 28, 1, 0, 32	; width/height/X0 offset/char offset

	da b'0000000001111110'
	da b'0000000000000000'
	da b'0000000000000000'
	da b'0000000000000000'
	da b'0000000000000000'
	da b'0000000000000000'
	da b'0000000000000000'
	da b'0000000000000000'
	da b'0000000000000000'
	da b'0000000000000000'
	da b'0000000000000000'
	da b'0000000000000000'
	da b'0000000000000000'
	da b'0000000000000000'
	da b'0000000000000000'
	da b'0000000000000000'
	da b'0111111001111110'
	da b'0000000000000000'
	da b'0000000000000000'
	da b'0000000000000000'
	da b'0000000000000000'
	da b'0000000000000000'
	da b'0000000000000000'
	da b'0000000000000000'
	da b'0000000000000000'
	da b'0000000000000000'
	da b'0000000000000000'
	da b'0000000000000000'
	da b'0000000000000000'
	da b'0000000000000000'
	da b'0000000000000000'
	da b'0000000000000000'
	da b'0111111001111110'
	da b'0111111000000000'
	da b'0000000000000000'
	da b'0000000000000000'
	da b'0000000000000000'
	da b'0000000000000000'
	da b'0000000000000000'
	da b'0000000000000000'
	da b'0000000000000000'
	da b'0000000000000000'
	da b'0000000000000000'
	da b'0000000000000000'
	da b'0000000000000000'
	da b'0000000000000000'
	da b'0000000000000000'
	da b'0000000000000000'
	da b'0111111001111110'
	da b'0111111000000000'
	da b'0111111000000000'
	da b'0000000000000000'
	da b'0000000000000000'
	da b'0000000000000000'
	da b'0000000000000000'
	da b'0000000000000000'
	da b'0000000000000000'
	da b'0000000000000000'
	da b'0000000000000000'
	da b'0000000000000000'
	da b'0000000000000000'
	da b'0000000000000000'
	da b'0000000000000000'
	da b'0000000000000000'
	da b'0111111001111110'
	da b'0111111000000000'
	da b'0111111000000000'
	da b'0111111000000000'
	da b'0000000000000000'
	da b'0000000000000000'
	da b'0000000000000000'
	da b'0000000000000000'
	da b'0000000000000000'
	da b'0000000000000000'
	da b'0000000000000000'
	da b'0000000000000000'
	da b'0000000000000000'
	da b'0000000000000000'
	da b'0000000000000000'
	da b'0000000000000000'
	da b'0111111001111110'
	da b'0111111000000000'
	da b'0111111000000000'
	da b'0111111000000000'
	da b'0111111000000000'
	da b'0000000000000000'
	da b'0000000000000000'
	da b'0000000000000000'
	da b'0000000000000000'
	da b'0000000000000000'
	da b'0000000000000000'
	da b'0000000000000000'
	da b'0000000000000000'
	da b'0000000000000000'
	da b'0000000000000000'
	da b'0000000000000000'
	da b'0111111001111110'
	da b'0111111000000000'
	da b'0111111000000000'
	da b'0111111000000000'
	da b'0111111000000000'
	da b'0111111000000000'
	da b'0000000000000000'
	da b'0000000000000000'
	da b'0000000000000000'
	da b'0000000000000000'
	da b'0000000000000000'
	da b'0000000000000000'
	da b'0000000000000000'
	da b'0000000000000000'
	da b'0000000000000000'
	da b'0000000000000000'
	da b'0111111001111110'
	da b'0111111000000000'
	da b'0111111000000000'
	da b'0111111000000000'
	da b'0111111000000000'
	da b'0111111000000000'
	da b'0111111000000000'
	da b'0000000000000000'
	da b'0000000000000000'
	da b'0000000000000000'
	da b'0000000000000000'
	da b'0000000000000000'
	da b'0000000000000000'
	da b'0000000000000000'
	da b'0000000000000000'
	da b'0000000000000000'
	da b'0111111001111110'
	da b'0111111000000000'
	da b'0111111000000000'
	da b'0111111000000000'
	da b'0111111000000000'
	da b'0111111000000000'
	da b'0111111000000000'
	da b'0111111000000000'
	da b'0000000000000000'
	da b'0000000000000000'
	da b'0000000000000000'
	da b'0000000000000000'
	da b'0000000000000000'
	da b'0000000000000000'
	da b'0000000000000000'
	da b'0000000000000000'
	da b'0111111001111110'
	da b'0111111000000000'
	da b'0111111000000000'
	da b'0111111000000000'
	da b'0111111000000000'
	da b'0111111000000000'
	da b'0111111000000000'
	da b'0111111000000000'
	da b'0111111000000000'
	da b'0000000000000000'
	da b'0000000000000000'
	da b'0000000000000000'
	da b'0000000000000000'
	da b'0000000000000000'
	da b'0000000000000000'
	da b'0000000000000000'
	da b'0111111001111110'
	da b'0111111000000000'
	da b'0111111000000000'
	da b'0111111000000000'
	da b'0111111000000000'
	da b'0111111000000000'
	da b'0111111000000000'
	da b'0111111000000000'
	da b'0111111000000000'
	da b'0111111000000000'
	da b'0000000000000000'
	da b'0000000000000000'
	da b'0000000000000000'
	da b'0000000000000000'
	da b'0000000000000000'
	da b'0000000000000000'
	da b'0111111001111110'
	da b'0111111000000000'
	da b'0111111000000000'
	da b'0111111000000000'
	da b'0111111000000000'
	da b'0111111000000000'
	da b'0111111000000000'
	da b'0111111000000000'
	da b'0111111000000000'
	da b'0111111000000000'
	da b'0111111000000000'
	da b'0000000000000000'
	da b'0000000000000000'
	da b'0000000000000000'
	da b'0000000000000000'
	da b'0000000000000000'
	da b'0111111001111110'
	da b'0111111000000000'
	da b'0111111000000000'
	da b'0111111000000000'
	da b'0111111000000000'
	da b'0111111000000000'
	da b'0111111000000000'
	da b'0111111000000000'
	da b'0111111000000000'
	da b'0111111000000000'
	da b'0111111000000000'
	da b'0111111000000000'
	da b'0000000000000000'
	da b'0000000000000000'
	da b'0000000000000000'
	da b'0000000000000000'
	da b'0111111001111110'
	da b'0111111000000000'
	da b'0111111000000000'
	da b'0111111000000000'
	da b'0111111000000000'
	da b'0111111000000000'
	da b'0111111000000000'
	da b'0111111000000000'
	da b'0111111000000000'
	da b'0111111000000000'
	da b'0111111000000000'
	da b'0111111000000000'
	da b'0111111000000000'
	da b'0000000000000000'
	da b'0000000000000000'
	da b'0000000000000000'
	da b'0000000001111110'
	da b'0000000000000000'
	da b'0000000000000000'
	da b'0000000000000000'
	da b'0000000000000000'
	da b'0000000000000000'
	da b'0000000000000000'
	da b'0000000000000000'
	da b'0000000000000000'
	da b'0000000000000000'
	da b'0000000000000000'
	da b'0000000000000000'
	da b'0000000000000000'
	da b'0001100000000000'
	da b'0000000000000000'
	da b'0000000000000000'
	da b'0111111001111110'
	da b'0000000000000000'
	da b'0000000000000000'
	da b'0000000000000000'
	da b'0000000000000000'
	da b'0000000000000000'
	da b'0000000000000000'
	da b'0000000000000000'
	da b'0000000000000000'
	da b'0000000000000000'
	da b'0000000000000000'
	da b'0000000000000000'
	da b'0000000000000000'
	da b'0001100000000000'
	da b'0000000000000000'
	da b'0000000000000000'
	da b'0111111001111110'
	da b'0111111000000000'
	da b'0000000000000000'
	da b'0000000000000000'
	da b'0000000000000000'
	da b'0000000000000000'
	da b'0000000000000000'
	da b'0000000000000000'
	da b'0000000000000000'
	da b'0000000000000000'
	da b'0000000000000000'
	da b'0000000000000000'
	da b'0000000000000000'
	da b'0001100000000000'
	da b'0000000000000000'
	da b'0000000000000000'
	da b'0111111001111110'
	da b'0111111000000000'
	da b'0111111000000000'
	da b'0000000000000000'
	da b'0000000000000000'
	da b'0000000000000000'
	da b'0000000000000000'
	da b'0000000000000000'
	da b'0000000000000000'
	da b'0000000000000000'
	da b'0000000000000000'
	da b'0000000000000000'
	da b'0000000000000000'
	da b'0001100000000000'
	da b'0000000000000000'
	da b'0000000000000000'
	da b'0111111001111110'
	da b'0111111000000000'
	da b'0111111000000000'
	da b'0111111000000000'
	da b'0000000000000000'
	da b'0000000000000000'
	da b'0000000000000000'
	da b'0000000000000000'
	da b'0000000000000000'
	da b'0000000000000000'
	da b'0000000000000000'
	da b'0000000000000000'
	da b'0000000000000000'
	da b'0001100000000000'
	da b'0000000000000000'
	da b'0000000000000000'
	da b'0111111001111110'
	da b'0111111000000000'
	da b'0111111000000000'
	da b'0111111000000000'
	da b'0111111000000000'
	da b'0000000000000000'
	da b'0000000000000000'
	da b'0000000000000000'
	da b'0000000000000000'
	da b'0000000000000000'
	da b'0000000000000000'
	da b'0000000000000000'
	da b'0000000000000000'
	da b'0001100000000000'
	da b'0000000000000000'
	da b'0000000000000000'
	da b'0111111001111110'
	da b'0111111000000000'
	da b'0111111000000000'
	da b'0111111000000000'
	da b'0111111000000000'
	da b'0111111000000000'
	da b'0000000000000000'
	da b'0000000000000000'
	da b'0000000000000000'
	da b'0000000000000000'
	da b'0000000000000000'
	da b'0000000000000000'
	da b'0000000000000000'
	da b'0001100000000000'
	da b'0000000000000000'
	da b'0000000000000000'
	da b'0111111001111110'
	da b'0111111000000000'
	da b'0111111000000000'
	da b'0111111000000000'
	da b'0111111000000000'
	da b'0111111000000000'
	da b'0111111000000000'
	da b'0000000000000000'
	da b'0000000000000000'
	da b'0000000000000000'
	da b'0000000000000000'
	da b'0000000000000000'
	da b'0000000000000000'
	da b'0001100000000000'
	da b'0000000000000000'
	da b'0000000000000000'
	da b'0111111001111110'
	da b'0111111000000000'
	da b'0111111000000000'
	da b'0111111000000000'
	da b'0111111000000000'
	da b'0111111000000000'
	da b'0111111000000000'
	da b'0111111000000000'
	da b'0000000000000000'
	da b'0000000000000000'
	da b'0000000000000000'
	da b'0000000000000000'
	da b'0000000000000000'
	da b'0001100000000000'
	da b'0000000000000000'
	da b'0000000000000000'
	da b'0111111001111110'
	da b'0111111000000000'
	da b'0111111000000000'
	da b'0111111000000000'
	da b'0111111000000000'
	da b'0111111000000000'
	da b'0111111000000000'
	da b'0111111000000000'
	da b'0111111000000000'
	da b'0000000000000000'
	da b'0000000000000000'
	da b'0000000000000000'
	da b'0000000000000000'
	da b'0001100000000000'
	da b'0000000000000000'
	da b'0000000000000000'
	da b'0111111001111110'
	da b'0111111000000000'
	da b'0111111000000000'
	da b'0111111000000000'
	da b'0111111000000000'
	da b'0111111000000000'
	da b'0111111000000000'
	da b'0111111000000000'
	da b'0111111000000000'
	da b'0111111000000000'
	da b'0000000000000000'
	da b'0000000000000000'
	da b'0000000000000000'
	da b'0001100000000000'
	da b'0000000000000000'
	da b'0000000000000000'
	da b'0111111001111110'
	da b'0111111000000000'
	da b'0111111000000000'
	da b'0111111000000000'
	da b'0111111000000000'
	da b'0111111000000000'
	da b'0111111000000000'
	da b'0111111000000000'
	da b'0111111000000000'
	da b'0111111000000000'
	da b'0111111000000000'
	da b'0000000000000000'
	da b'0000000000000000'
	da b'0001100000000000'
	da b'0000000000000000'
	da b'0000000000000000'
	da b'0111111001111110'
	da b'0111111000000000'
	da b'0111111000000000'
	da b'0111111000000000'
	da b'0111111000000000'
	da b'0111111000000000'
	da b'0111111000000000'
	da b'0111111000000000'
	da b'0111111000000000'
	da b'0111111000000000'
	da b'0111111000000000'
	da b'0111111000000000'
	da b'0000000000000000'
	da b'0001100000000000'
	da b'0000000000000000'
	da b'0000000000000000'
	da b'0111111001111110'
	da b'0111111000000000'
	da b'0111111000000000'
	da b'0111111000000000'
	da b'0111111000000000'
	da b'0111111000000000'
	da b'0111111000000000'
	da b'0111111000000000'
	da b'0111111000000000'
	da b'0111111000000000'
	da b'0111111000000000'
	da b'0111111000000000'
	da b'0111111000000000'
	da b'0001100000000000'
	da b'0000000000000000'
	da b'0000000000000000'


