; $Id$
;
; MIDIO128
; Presets (EEPROM/Flash Content)
;
; ==========================================================================
;
;  Copyright 1998-2003 Thorsten Klose (tk@midibox.org)
;  Licensed for personal non-commercial use only.
;  All other rights reserved.
; 
; ==========================================================================

        ERRORLEVEL      -220    ; suppress "Address exceeds maximum range for this processor."
	;; this is (unfortunately) required for gpasm


; ==========================================================================
;  Data structure:
;                      Bank Offset       Internal Addr.   
;   +---------------+  0x5ff
;   | Reserved      |
;   +---------------+  0x500             -
;   | Configuration |
;   +---------------+  0x400             0x00 (EEPROM)
;   | Outgoing Evt  |
;   +---------------+  0x100             0x7900 (FLASH)
;   | Incoming Evt  |
;   +---------------+  0x000             0x7800 (FLASH)
;

; ==========================================================================

	org	0x07800		; MIDI I/O events stored at the end of internal flash

;; This macro generates a MIDI IN entry
;; Parameters: event_0, event_1
;; normaly we need 8 bits for every event byte, but since we are only able to 
;; embedd 7-bit events within a SysEx stream, the MSB is masked out. 
;; However, the MSB (bit 8) is 1 for every MIDI event (0x80-0xff), therefore 
;; this doesn't hurt. Simmlar approach for event_1: the MSB is 0 for every MIDI 
;; event (0x00-0x7f), so we can get rid of it.

MIDIO_IN_ENTRY MACRO event_0, event_1
	db	(event_0)&0x7f, (event_1)&0x7f
	ENDM

;; the same for outgoing MIDI events, but here all three bytes of the "on" and
;; three bytes of the "off" event are stored in the SysEx structure
MIDIO_OUT_ENTRY MACRO event_on_0, event_on_1, event_on_2, event_off_0, event_off_1, event_off_2
	db	(event_on_0)&0x7f, (event_on_1)&0x7f, (event_on_2)&0x7f, (event_off_0)&0x7f, (event_off_1)&0x7f, (event_off_2)&0x7f
	ENDM

;; ---[ Incoming MIDI events which are assigned to the LEDs ]----------------
MIDIO_Presets
MIDIO_Presets_FLASH_Lower
MIDIO_Presets_OffsetIn
	MIDIO_IN_ENTRY	0x90, 0x30		; Pin 1
	MIDIO_IN_ENTRY	0x90, 0x31		; Pin 2
	MIDIO_IN_ENTRY	0x90, 0x32		; Pin 3
	MIDIO_IN_ENTRY	0x90, 0x33		; Pin 4
	MIDIO_IN_ENTRY	0x90, 0x34		; Pin 5
	MIDIO_IN_ENTRY	0x90, 0x35		; Pin 6
	MIDIO_IN_ENTRY	0x90, 0x36		; Pin 7
	MIDIO_IN_ENTRY	0x90, 0x37		; Pin 8
	MIDIO_IN_ENTRY	0x90, 0x38		; Pin 9
	MIDIO_IN_ENTRY	0x90, 0x39		; Pin 10
	MIDIO_IN_ENTRY	0x90, 0x3a		; Pin 11
	MIDIO_IN_ENTRY	0x90, 0x3b		; Pin 12
	MIDIO_IN_ENTRY	0x90, 0x3c		; Pin 13
	MIDIO_IN_ENTRY	0x90, 0x3d		; Pin 14
	MIDIO_IN_ENTRY	0x90, 0x3e		; Pin 15
	MIDIO_IN_ENTRY	0x90, 0x3f		; Pin 16

	MIDIO_IN_ENTRY	0x90, 0x40		; Pin 17
	MIDIO_IN_ENTRY	0x90, 0x41		; Pin 18
	MIDIO_IN_ENTRY	0x90, 0x42		; Pin 19
	MIDIO_IN_ENTRY	0x90, 0x43		; Pin 20
	MIDIO_IN_ENTRY	0x90, 0x44		; Pin 21
	MIDIO_IN_ENTRY	0x90, 0x45		; Pin 22
	MIDIO_IN_ENTRY	0x90, 0x46		; Pin 23
	MIDIO_IN_ENTRY	0x90, 0x47		; Pin 24
	MIDIO_IN_ENTRY	0x90, 0x48		; Pin 25
	MIDIO_IN_ENTRY	0x90, 0x49		; Pin 26
	MIDIO_IN_ENTRY	0x90, 0x4a		; Pin 27
	MIDIO_IN_ENTRY	0x90, 0x4b		; Pin 28
	MIDIO_IN_ENTRY	0x90, 0x4c		; Pin 29
	MIDIO_IN_ENTRY	0x90, 0x4d		; Pin 30
	MIDIO_IN_ENTRY	0x90, 0x4e		; Pin 31
	MIDIO_IN_ENTRY	0x90, 0x4f		; Pin 32
	
	MIDIO_IN_ENTRY	0x90, 0x50		; Pin 33
	MIDIO_IN_ENTRY	0x90, 0x51		; Pin 34
	MIDIO_IN_ENTRY	0x90, 0x52		; Pin 35
	MIDIO_IN_ENTRY	0x90, 0x53		; Pin 36
	MIDIO_IN_ENTRY	0x90, 0x54		; Pin 37
	MIDIO_IN_ENTRY	0x90, 0x55		; Pin 38
	MIDIO_IN_ENTRY	0x90, 0x56		; Pin 39
	MIDIO_IN_ENTRY	0x90, 0x57		; Pin 40
	MIDIO_IN_ENTRY	0x90, 0x58		; Pin 41
	MIDIO_IN_ENTRY	0x90, 0x59		; Pin 42
	MIDIO_IN_ENTRY	0x90, 0x5a		; Pin 43
	MIDIO_IN_ENTRY	0x90, 0x5b		; Pin 44
	MIDIO_IN_ENTRY	0x90, 0x5c		; Pin 45
	MIDIO_IN_ENTRY	0x90, 0x5d		; Pin 46
	MIDIO_IN_ENTRY	0x90, 0x5e		; Pin 47
	MIDIO_IN_ENTRY	0x90, 0x5f		; Pin 48
	
	MIDIO_IN_ENTRY	0x90, 0x60		; Pin 49
	MIDIO_IN_ENTRY	0x90, 0x61		; Pin 50
	MIDIO_IN_ENTRY	0x90, 0x62		; Pin 51
	MIDIO_IN_ENTRY	0x90, 0x63		; Pin 52
	MIDIO_IN_ENTRY	0x90, 0x64		; Pin 53
	MIDIO_IN_ENTRY	0x90, 0x65		; Pin 54
	MIDIO_IN_ENTRY	0x90, 0x66		; Pin 55
	MIDIO_IN_ENTRY	0x90, 0x67		; Pin 56
	MIDIO_IN_ENTRY	0x90, 0x68		; Pin 57 	
	MIDIO_IN_ENTRY	0x90, 0x69		; Pin 58
	MIDIO_IN_ENTRY	0x90, 0x6a		; Pin 59
	MIDIO_IN_ENTRY	0x90, 0x6b		; Pin 60
	MIDIO_IN_ENTRY	0x90, 0x6c		; Pin 61
	MIDIO_IN_ENTRY	0x90, 0x6d		; Pin 62
	MIDIO_IN_ENTRY	0x90, 0x6e		; Pin 63
	MIDIO_IN_ENTRY	0x90, 0x6f		; Pin 64
	
	MIDIO_IN_ENTRY	0xb0, 0x10		; Pin 65
	MIDIO_IN_ENTRY	0xb0, 0x11		; Pin 66
	MIDIO_IN_ENTRY	0xb0, 0x12		; Pin 67
	MIDIO_IN_ENTRY	0xb0, 0x13		; Pin 68
	MIDIO_IN_ENTRY	0xb0, 0x14		; Pin 69
	MIDIO_IN_ENTRY	0xb0, 0x15		; Pin 70
	MIDIO_IN_ENTRY	0xb0, 0x16		; Pin 71
	MIDIO_IN_ENTRY	0xb0, 0x17		; Pin 72
	MIDIO_IN_ENTRY	0xb0, 0x18		; Pin 73
	MIDIO_IN_ENTRY	0xb0, 0x19 		; Pin 74
	MIDIO_IN_ENTRY	0xb0, 0x1a		; Pin 75
	MIDIO_IN_ENTRY	0xb0, 0x1b		; Pin 76
	MIDIO_IN_ENTRY	0xb0, 0x1c		; Pin 77
	MIDIO_IN_ENTRY	0xb0, 0x1d		; Pin 78
	MIDIO_IN_ENTRY	0xb0, 0x1e		; Pin 79
	MIDIO_IN_ENTRY	0xb0, 0x1f		; Pin 80
	
	MIDIO_IN_ENTRY	0xb0, 0x20		; Pin 81
	MIDIO_IN_ENTRY	0xb0, 0x21		; Pin 82
	MIDIO_IN_ENTRY	0xb0, 0x22		; Pin 83
	MIDIO_IN_ENTRY	0xb0, 0x23		; Pin 84
	MIDIO_IN_ENTRY	0xb0, 0x24		; Pin 85
	MIDIO_IN_ENTRY	0xb0, 0x25		; Pin 86
	MIDIO_IN_ENTRY	0xb0, 0x26		; Pin 87
	MIDIO_IN_ENTRY	0xb0, 0x27		; Pin 88
	MIDIO_IN_ENTRY	0xb0, 0x28		; Pin 89
	MIDIO_IN_ENTRY	0xb0, 0x29		; Pin 90
	MIDIO_IN_ENTRY	0xb0, 0x2a		; Pin 91	
	MIDIO_IN_ENTRY	0xb0, 0x2b		; Pin 92
	MIDIO_IN_ENTRY	0xb0, 0x2c		; Pin 93
	MIDIO_IN_ENTRY	0xb0, 0x2d		; Pin 94
	MIDIO_IN_ENTRY	0xb0, 0x2e		; Pin 95
	MIDIO_IN_ENTRY	0xb0, 0x2f		; Pin 96
	
	MIDIO_IN_ENTRY	0xb0, 0x30		; Pin 97
	MIDIO_IN_ENTRY	0xb0, 0x31		; Pin 98
	MIDIO_IN_ENTRY	0xb0, 0x32		; Pin 99
	MIDIO_IN_ENTRY	0xb0, 0x33		; Pin 100
	MIDIO_IN_ENTRY	0xb0, 0x34		; Pin 101
	MIDIO_IN_ENTRY	0xb0, 0x35		; Pin 102
	MIDIO_IN_ENTRY	0xb0, 0x36		; Pin 103 	
	MIDIO_IN_ENTRY	0xb0, 0x37		; Pin 104
	MIDIO_IN_ENTRY	0xb0, 0x38		; Pin 105
	MIDIO_IN_ENTRY	0xb0, 0x39		; Pin 106
	MIDIO_IN_ENTRY	0xb0, 0x3a		; Pin 107
	MIDIO_IN_ENTRY	0xb0, 0x3b		; Pin 108
	MIDIO_IN_ENTRY	0xb0, 0x3c		; Pin 109
	MIDIO_IN_ENTRY	0xb0, 0x3d		; Pin 110
	MIDIO_IN_ENTRY	0xb0, 0x3e		; Pin 111
	MIDIO_IN_ENTRY	0xb0, 0x3f		; Pin 112
	
	MIDIO_IN_ENTRY	0xb0, 0x40		; Pin 113
	MIDIO_IN_ENTRY	0xb0, 0x41		; Pin 114
	MIDIO_IN_ENTRY	0xb0, 0x42		; Pin 115
	MIDIO_IN_ENTRY	0xb0, 0x43		; Pin 116
	MIDIO_IN_ENTRY	0xb0, 0x44		; Pin 117
	MIDIO_IN_ENTRY	0xb0, 0x45		; Pin 118
	MIDIO_IN_ENTRY	0xb0, 0x46		; Pin 119
	MIDIO_IN_ENTRY	0xb0, 0x47		; Pin 120
	MIDIO_IN_ENTRY	0xb0, 0x48		; Pin 121
	MIDIO_IN_ENTRY	0xb0, 0x49		; Pin 122
	MIDIO_IN_ENTRY	0xb0, 0x4a		; Pin 123
	MIDIO_IN_ENTRY	0xb0, 0x4b		; Pin 124
	MIDIO_IN_ENTRY	0xb0, 0x4c		; Pin 125
	MIDIO_IN_ENTRY	0xb0, 0x4d		; Pin 126
	MIDIO_IN_ENTRY	0xb0, 0x4e		; Pin 127
	MIDIO_IN_ENTRY	0xb0, 0x4f		; Pin 128

;; ---[ Outgoing MIDI events which are triggered with the DINs ]----------
MIDIO_Presets_OffsetOut
	MIDIO_OUT_ENTRY	0x90, 0x30, 0x7f,   0x90, 0x30, 0x00		; Pin 1
	MIDIO_OUT_ENTRY	0x90, 0x31, 0x7f,   0x90, 0x31, 0x00		; Pin 2
	MIDIO_OUT_ENTRY	0x90, 0x32, 0x7f,   0x90, 0x32, 0x00		; Pin 3
	MIDIO_OUT_ENTRY	0x90, 0x33, 0x7f,   0x90, 0x33, 0x00		; Pin 4
	MIDIO_OUT_ENTRY	0x90, 0x34, 0x7f,   0x90, 0x34, 0x00		; Pin 5
	MIDIO_OUT_ENTRY	0x90, 0x35, 0x7f,   0x90, 0x35, 0x00		; Pin 6
	MIDIO_OUT_ENTRY	0x90, 0x36, 0x7f,   0x90, 0x36, 0x00		; Pin 7
	MIDIO_OUT_ENTRY	0x90, 0x37, 0x7f,   0x90, 0x37, 0x00		; Pin 8
	MIDIO_OUT_ENTRY	0x90, 0x38, 0x7f,   0x90, 0x38, 0x00		; Pin 9
	MIDIO_OUT_ENTRY	0x90, 0x39, 0x7f,   0x90, 0x39, 0x00		; Pin 10
	MIDIO_OUT_ENTRY	0x90, 0x3a, 0x7f,   0x90, 0x3a, 0x00		; Pin 11
	MIDIO_OUT_ENTRY	0x90, 0x3b, 0x7f,   0x90, 0x3b, 0x00		; Pin 12
	MIDIO_OUT_ENTRY	0x90, 0x3c, 0x7f,   0x90, 0x3c, 0x00		; Pin 13
	MIDIO_OUT_ENTRY	0x90, 0x3d, 0x7f,   0x90, 0x3d, 0x00		; Pin 14
	MIDIO_OUT_ENTRY	0x90, 0x3e, 0x7f,   0x90, 0x3e, 0x00		; Pin 15
	MIDIO_OUT_ENTRY	0x90, 0x3f, 0x7f,   0x90, 0x3f, 0x00		; Pin 16

	MIDIO_OUT_ENTRY	0x90, 0x40, 0x7f,   0x90, 0x40, 0x00		; Pin 17
	MIDIO_OUT_ENTRY	0x90, 0x41, 0x7f,   0x90, 0x41, 0x00		; Pin 18
	MIDIO_OUT_ENTRY	0x90, 0x42, 0x7f,   0x90, 0x42, 0x00		; Pin 19
	MIDIO_OUT_ENTRY	0x90, 0x43, 0x7f,   0x90, 0x43, 0x00		; Pin 20
	MIDIO_OUT_ENTRY	0x90, 0x44, 0x7f,   0x90, 0x44, 0x00		; Pin 21
	MIDIO_OUT_ENTRY	0x90, 0x45, 0x7f,   0x90, 0x45, 0x00		; Pin 22
	MIDIO_OUT_ENTRY	0x90, 0x46, 0x7f,   0x90, 0x46, 0x00		; Pin 23
	MIDIO_OUT_ENTRY	0x90, 0x47, 0x7f,   0x90, 0x47, 0x00		; Pin 24
	MIDIO_OUT_ENTRY	0x90, 0x48, 0x7f,   0x90, 0x48, 0x00		; Pin 25
	MIDIO_OUT_ENTRY	0x90, 0x49, 0x7f,   0x90, 0x49, 0x00		; Pin 26
	MIDIO_OUT_ENTRY	0x90, 0x4a, 0x7f,   0x90, 0x4a, 0x00		; Pin 27
	MIDIO_OUT_ENTRY	0x90, 0x4b, 0x7f,   0x90, 0x4b, 0x00		; Pin 28
	MIDIO_OUT_ENTRY	0x90, 0x4c, 0x7f,   0x90, 0x4c, 0x00		; Pin 29
	MIDIO_OUT_ENTRY	0x90, 0x4d, 0x7f,   0x90, 0x4d, 0x00		; Pin 30
	MIDIO_OUT_ENTRY	0x90, 0x4e, 0x7f,   0x90, 0x4e, 0x00		; Pin 31
	MIDIO_OUT_ENTRY	0x90, 0x4f, 0x7f,   0x90, 0x4f, 0x00		; Pin 32
	
	MIDIO_OUT_ENTRY	0x90, 0x50, 0x7f,   0x90, 0x50, 0x00		; Pin 33
	MIDIO_OUT_ENTRY	0x90, 0x51, 0x7f,   0x90, 0x51, 0x00		; Pin 34
	MIDIO_OUT_ENTRY	0x90, 0x52, 0x7f,   0x90, 0x52, 0x00		; Pin 35
	MIDIO_OUT_ENTRY	0x90, 0x53, 0x7f,   0x90, 0x53, 0x00		; Pin 36
	MIDIO_OUT_ENTRY	0x90, 0x54, 0x7f,   0x90, 0x54, 0x00		; Pin 37
	MIDIO_OUT_ENTRY	0x90, 0x55, 0x7f,   0x90, 0x55, 0x00		; Pin 38
	MIDIO_OUT_ENTRY	0x90, 0x56, 0x7f,   0x90, 0x56, 0x00		; Pin 39
	MIDIO_OUT_ENTRY	0x90, 0x57, 0x7f,   0x90, 0x57, 0x00		; Pin 40
	MIDIO_OUT_ENTRY	0x90, 0x58, 0x7f,   0x90, 0x58, 0x00		; Pin 41
	MIDIO_OUT_ENTRY	0x90, 0x59, 0x7f,   0x90, 0x59, 0x00		; Pin 42
	MIDIO_OUT_ENTRY	0x90, 0x5a, 0x7f,   0x90, 0x5a, 0x00		; Pin 43
	MIDIO_OUT_ENTRY	0x90, 0x5b, 0x7f,   0x90, 0x5b, 0x00		; Pin 44
	MIDIO_OUT_ENTRY	0x90, 0x5c, 0x7f,   0x90, 0x5c, 0x00		; Pin 45
	MIDIO_OUT_ENTRY	0x90, 0x5d, 0x7f,   0x90, 0x5d, 0x00		; Pin 46
	MIDIO_OUT_ENTRY	0x90, 0x5e, 0x7f,   0x90, 0x5e, 0x00		; Pin 47
	MIDIO_OUT_ENTRY	0x90, 0x5f, 0x7f,   0x90, 0x5f, 0x00		; Pin 48
	
	MIDIO_OUT_ENTRY	0x90, 0x60, 0x7f,   0x90, 0x60, 0x00		; Pin 49
	MIDIO_OUT_ENTRY	0x90, 0x61, 0x7f,   0x90, 0x61, 0x00		; Pin 50
	MIDIO_OUT_ENTRY	0x90, 0x62, 0x7f,   0x90, 0x62, 0x00		; Pin 51
	MIDIO_OUT_ENTRY	0x90, 0x63, 0x7f,   0x90, 0x63, 0x00		; Pin 52
	MIDIO_OUT_ENTRY	0x90, 0x64, 0x7f,   0x90, 0x64, 0x00		; Pin 53
	MIDIO_OUT_ENTRY	0x90, 0x65, 0x7f,   0x90, 0x65, 0x00		; Pin 54
	MIDIO_OUT_ENTRY	0x90, 0x66, 0x7f,   0x90, 0x66, 0x00		; Pin 55
	MIDIO_OUT_ENTRY	0x90, 0x67, 0x7f,   0x90, 0x67, 0x00		; Pin 56
	MIDIO_OUT_ENTRY	0x90, 0x68, 0x7f,   0x90, 0x68, 0x00		; Pin 57 	
	MIDIO_OUT_ENTRY	0x90, 0x69, 0x7f,   0x90, 0x69, 0x00		; Pin 58
	MIDIO_OUT_ENTRY	0x90, 0x6a, 0x7f,   0x90, 0x6a, 0x00		; Pin 59
	MIDIO_OUT_ENTRY	0x90, 0x6b, 0x7f,   0x90, 0x6b, 0x00		; Pin 60
	MIDIO_OUT_ENTRY	0x90, 0x6c, 0x7f,   0x90, 0x6c, 0x00		; Pin 61
	MIDIO_OUT_ENTRY	0x90, 0x6d, 0x7f,   0x90, 0x6d, 0x00		; Pin 62
	MIDIO_OUT_ENTRY	0x90, 0x6e, 0x7f,   0x90, 0x6e, 0x00		; Pin 63
	MIDIO_OUT_ENTRY	0x90, 0x6f, 0x7f,   0x90, 0x6f, 0x00		; Pin 64
	
	MIDIO_OUT_ENTRY	0xb0, 0x10, 0x7f,   0xb0, 0x10, 0x00		; Pin 65
	MIDIO_OUT_ENTRY	0xb0, 0x11, 0x7f,   0xb0, 0x11, 0x00		; Pin 66
	MIDIO_OUT_ENTRY	0xb0, 0x12, 0x7f,   0xb0, 0x12, 0x00		; Pin 67
	MIDIO_OUT_ENTRY	0xb0, 0x13, 0x7f,   0xb0, 0x13, 0x00		; Pin 68
	MIDIO_OUT_ENTRY	0xb0, 0x14, 0x7f,   0xb0, 0x14, 0x00		; Pin 69
	MIDIO_OUT_ENTRY	0xb0, 0x15, 0x7f,   0xb0, 0x15, 0x00		; Pin 70
	MIDIO_OUT_ENTRY	0xb0, 0x16, 0x7f,   0xb0, 0x16, 0x00		; Pin 71
	MIDIO_OUT_ENTRY	0xb0, 0x17, 0x7f,   0xb0, 0x17, 0x00		; Pin 72
	MIDIO_OUT_ENTRY	0xb0, 0x18, 0x7f,   0xb0, 0x18, 0x00		; Pin 73
	MIDIO_OUT_ENTRY	0xb0, 0x19, 0x7f,   0xb0, 0x19, 0x00 		; Pin 74
	MIDIO_OUT_ENTRY	0xb0, 0x1a, 0x7f,   0xb0, 0x1a, 0x00		; Pin 75
	MIDIO_OUT_ENTRY	0xb0, 0x1b, 0x7f,   0xb0, 0x1b, 0x00		; Pin 76
	MIDIO_OUT_ENTRY	0xb0, 0x1c, 0x7f,   0xb0, 0x1c, 0x00		; Pin 77
	MIDIO_OUT_ENTRY	0xb0, 0x1d, 0x7f,   0xb0, 0x1d, 0x00		; Pin 78
	MIDIO_OUT_ENTRY	0xb0, 0x1e, 0x7f,   0xb0, 0x1e, 0x00		; Pin 79
	MIDIO_OUT_ENTRY	0xb0, 0x1f, 0x7f,   0xb0, 0x1f, 0x00		; Pin 80
	
	MIDIO_OUT_ENTRY	0xb0, 0x20, 0x7f,   0xb0, 0x20, 0x00		; Pin 81
	MIDIO_OUT_ENTRY	0xb0, 0x21, 0x7f,   0xb0, 0x21, 0x00		; Pin 82
	MIDIO_OUT_ENTRY	0xb0, 0x22, 0x7f,   0xb0, 0x22, 0x00		; Pin 83
	MIDIO_OUT_ENTRY	0xb0, 0x23, 0x7f,   0xb0, 0x23, 0x00		; Pin 84
	MIDIO_OUT_ENTRY	0xb0, 0x24, 0x7f,   0xb0, 0x24, 0x00		; Pin 85
	MIDIO_OUT_ENTRY	0xb0, 0x25, 0x7f,   0xb0, 0x25, 0x00		; Pin 86
	MIDIO_OUT_ENTRY	0xb0, 0x26, 0x7f,   0xb0, 0x26, 0x00		; Pin 87
	MIDIO_OUT_ENTRY	0xb0, 0x27, 0x7f,   0xb0, 0x27, 0x00		; Pin 88
	MIDIO_OUT_ENTRY	0xb0, 0x28, 0x7f,   0xb0, 0x28, 0x00		; Pin 89
	MIDIO_OUT_ENTRY	0xb0, 0x29, 0x7f,   0xb0, 0x29, 0x00		; Pin 90
	MIDIO_OUT_ENTRY	0xb0, 0x2a, 0x7f,   0xb0, 0x2a, 0x00		; Pin 91	
	MIDIO_OUT_ENTRY	0xb0, 0x2b, 0x7f,   0xb0, 0x2b, 0x00		; Pin 92
	MIDIO_OUT_ENTRY	0xb0, 0x2c, 0x7f,   0xb0, 0x2c, 0x00		; Pin 93
	MIDIO_OUT_ENTRY	0xb0, 0x2d, 0x7f,   0xb0, 0x2d, 0x00		; Pin 94
	MIDIO_OUT_ENTRY	0xb0, 0x2e, 0x7f,   0xb0, 0x2e, 0x00		; Pin 95
	MIDIO_OUT_ENTRY	0xb0, 0x2f, 0x7f,   0xb0, 0x2f, 0x00		; Pin 96
	
	MIDIO_OUT_ENTRY	0xb0, 0x30, 0x7f,   0xb0, 0x30, 0x00		; Pin 97
	MIDIO_OUT_ENTRY	0xb0, 0x31, 0x7f,   0xb0, 0x31, 0x00		; Pin 98
	MIDIO_OUT_ENTRY	0xb0, 0x32, 0x7f,   0xb0, 0x32, 0x00		; Pin 99
	MIDIO_OUT_ENTRY	0xb0, 0x33, 0x7f,   0xb0, 0x33, 0x00		; Pin 100
	MIDIO_OUT_ENTRY	0xb0, 0x34, 0x7f,   0xb0, 0x34, 0x00		; Pin 101
	MIDIO_OUT_ENTRY	0xb0, 0x35, 0x7f,   0xb0, 0x35, 0x00		; Pin 102
	MIDIO_OUT_ENTRY	0xb0, 0x36, 0x7f,   0xb0, 0x36, 0x00		; Pin 103 	
	MIDIO_OUT_ENTRY	0xb0, 0x37, 0x7f,   0xb0, 0x37, 0x00		; Pin 104
	MIDIO_OUT_ENTRY	0xb0, 0x38, 0x7f,   0xb0, 0x38, 0x00		; Pin 105
	MIDIO_OUT_ENTRY	0xb0, 0x39, 0x7f,   0xb0, 0x39, 0x00		; Pin 106
	MIDIO_OUT_ENTRY	0xb0, 0x3a, 0x7f,   0xb0, 0x3a, 0x00		; Pin 107
	MIDIO_OUT_ENTRY	0xb0, 0x3b, 0x7f,   0xb0, 0x3b, 0x00		; Pin 108
	MIDIO_OUT_ENTRY	0xb0, 0x3c, 0x7f,   0xb0, 0x3c, 0x00		; Pin 109
	MIDIO_OUT_ENTRY	0xb0, 0x3d, 0x7f,   0xb0, 0x3d, 0x00		; Pin 110
	MIDIO_OUT_ENTRY	0xb0, 0x3e, 0x7f,   0xb0, 0x3e, 0x00		; Pin 111
	MIDIO_OUT_ENTRY	0xb0, 0x3f, 0x7f,   0xb0, 0x3f, 0x00		; Pin 112

	MIDIO_OUT_ENTRY	0xb0, 0x40, 0x7f,   0xb0, 0x40, 0x00		; Pin 113
	MIDIO_OUT_ENTRY	0xb0, 0x41, 0x7f,   0xb0, 0x41, 0x00		; Pin 114
	MIDIO_OUT_ENTRY	0xb0, 0x42, 0x7f,   0xb0, 0x42, 0x00		; Pin 115
	MIDIO_OUT_ENTRY	0xb0, 0x43, 0x7f,   0xb0, 0x43, 0x00		; Pin 116
	MIDIO_OUT_ENTRY	0xb0, 0x44, 0x7f,   0xb0, 0x44, 0x00		; Pin 117
	MIDIO_OUT_ENTRY	0xb0, 0x45, 0x7f,   0xb0, 0x45, 0x00		; Pin 118
	MIDIO_OUT_ENTRY	0xb0, 0x46, 0x7f,   0xb0, 0x46, 0x00		; Pin 119
	MIDIO_OUT_ENTRY	0xb0, 0x47, 0x7f,   0xb0, 0x47, 0x00		; Pin 120
	MIDIO_OUT_ENTRY	0xb0, 0x48, 0x7f,   0xb0, 0x48, 0x00		; Pin 121
	MIDIO_OUT_ENTRY	0xb0, 0x49, 0x7f,   0xb0, 0x49, 0x00		; Pin 122
	MIDIO_OUT_ENTRY	0xb0, 0x4a, 0x7f,   0xb0, 0x4a, 0x00		; Pin 123
	MIDIO_OUT_ENTRY	0xb0, 0x4b, 0x7f,   0xb0, 0x4b, 0x00		; Pin 124
	MIDIO_OUT_ENTRY	0xb0, 0x4c, 0x7f,   0xb0, 0x4c, 0x00		; Pin 125
	MIDIO_OUT_ENTRY	0xb0, 0x4d, 0x7f,   0xb0, 0x4d, 0x00		; Pin 126
	MIDIO_OUT_ENTRY	0xb0, 0x4e, 0x7f,   0xb0, 0x4e, 0x00		; Pin 127
	MIDIO_OUT_ENTRY	0xb0, 0x4f, 0x7f,   0xb0, 0x4f, 0x00		; Pin 128


	;; NOTE: in internal bank, all reads and writes from offset 0x200
	;; with be forwarded to the EEPROM address 0xf00000!
	;; by MIDIO_BANK_Write, MIDIO_BANK_Read

	org	0xf00000	; eeprom base address

MIDIO_Presets_OffsetGlobal
MIDIO_Presets_CFG0
	db	0x00, 0x00	; disable merger by default
MIDIO_Presets_DEBOUNCE_CTR
	db	(DEFAULT_SRIO_DEBOUNCE_CTR) & 0x0f, ((DEFAULT_SRIO_DEBOUNCE_CTR) >> 4)&0x0f
MIDIO_Presets_ALT_PROGCHNG
	db	DEFAULT_ALT_PROGCHNG&0x0f, 0x00
MIDIO_Presets_FORWARD_IO
	db	DEFAULT_FORWARD_IO&0x0f, 0x00
MIDIO_Presets_INVERSE_DIN
	db	DEFAULT_INVERSE_DIN&0x0f, 0x00
MIDIO_Presets_INVERSE_DOUT
	db	DEFAULT_INVERSE_DOUT&0x0f, 0x00	
MIDIO_Presets_TS_SENSITIVITY
	db	(DEFAULT_TS_SENSITIVITY)&0x0f, ((DEFAULT_TS_SENSITIVITY) >> 4)&0x0f
MIDIO_Presets_GLOBAL_CHANNEL
	db	0x00, 0x00	; (not used)
MIDIO_Presets_ALL_NOTES_OFF
	db	(DEFAULT_ALL_NOTES_OFF_CHANNEL)&0x0f, ((DEFAULT_ALL_NOTES_OFF_CHANNEL) >> 4)&0x0f
MIDIO_Presets_Reserved1
	db	0x00, 0x00
MIDIO_Presets_Reserved2
	db	0x00, 0x00
MIDIO_Presets_Reserved3
	db	0x00, 0x00
MIDIO_Presets_Reserved4
	db	0x00, 0x00
MIDIO_Presets_Reserved5
	db	0x00, 0x00
MIDIO_Presets_Reserved6
	db	0x00, 0x00
MIDIO_Presets_Reserved7
	db	0x00, 0x00

MIDIO_Presets_DIN_MODES		; 1 nibble for every DIN
	db	0x00, 0x00	; DIN 0x03-0x00
	db	0x00, 0x00	; DIN 0x07-0x04
	db	0x00, 0x00	; DIN 0x0b-0x08
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	db	0x00, 0x00	; DIN 0x7f-0x7c

	;; fill unused area
	db	0, 0, 0, 0, 0, 0, 0, 0, 0, 0, 0, 0, 0, 0, 0, 0
	db	0, 0, 0, 0, 0, 0, 0, 0, 0, 0, 0, 0, 0, 0, 0, 0
	db	0, 0, 0, 0, 0, 0, 0, 0, 0, 0, 0, 0, 0, 0, 0, 0
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	db	0, 0, 0, 0, 0, 0, 0, 0, 0, 0, 0, 0, 0, 0


	;; these two entries cannot be overwritten via SysEx.
	;; it contains the device ID and the to-COM option
EEPROM_READONLY
	db	0x00, DEFAULT_DEVICE_ID

