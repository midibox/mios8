; $Id$
;
; MBHP_MF_V3
; Presets (EEPROM content)
;
; ==========================================================================
;
;  Copyright 2010 Thorsten Klose (tk@midibox.org)
;  Licensed for personal non-commercial use only.
;  All other rights reserved.
; 
; ==========================================================================

        ERRORLEVEL      -220    ; suppress "Address exceeds maximum range for this processor."
	;; this is (unfortunately) required for gpasm

	org	0xf00000	; eeprom base address
	;; order of registers must match with app_defines.h, 0x180-0x1ff
MF_PRESETS
	;; name should be all-zero if not changed by user
	;; otherwise formatted external patches would get the name "Internal Patch" (or similar)
MF_PRESETS_NAME0_7	db	0x00, 0x00, 0x00, 0x00, 0x00, 0x00, 0x00, 0x00
MF_PRESETS_NAME8_15	db	0x00, 0x00, 0x00, 0x00, 0x00, 0x00, 0x00, 0x00

	;; 0x10..0x1f
MF_PRESETS_CFG		db	0x08, 0x00 ; number of faders / operation mode
			db	0x00, 0x40 ; merger mode / pwm steps
			db	0x03, 0x03 ; AIN deadband, MF deadband
			db	0x01, 0x03 ; touch sensor mode / sensitivity

			db	0x00, 0x00 ; reserved
			db	0x00, 0x00 ; reserved
			db	0x00, 0x00 ; reserved
			db	0x00, 0x00 ; reserved

	;; 0x20..0x57
#if 0
MF_PRESETS_FADER_MODE	db	0x01, 0x01, 0x01, 0x01, 0x01, 0x01, 0x01, 0x01
MF_PRESETS_MIN_VALUE_L	db	0x14, 0x14, 0x14, 0x14, 0x14, 0x14, 0x14, 0x14 ; only low-byte is stored (0..255)
MF_PRESETS_MAX_VALUE_L	db	0xe8, 0xe8, 0xe8, 0xe8, 0xe8, 0xe8, 0xe8, 0xe8 ; only low-byte is stored (768..1023)
MF_PRESETS_MIN_DUTY_UP	db	0x28, 0x28, 0x28, 0x28, 0x28, 0x28, 0x28, 0x28
MF_PRESETS_MAX_DUTY_UP	db	0x40, 0x40, 0x40, 0x40, 0x40, 0x40, 0x40, 0x40
MF_PRESETS_MIN_DUTY_DOWN db	0x28, 0x28, 0x28, 0x28, 0x28, 0x28, 0x28, 0x28
MF_PRESETS_MAX_DUTY_DOWN db	0x40, 0x40, 0x40, 0x40, 0x40, 0x40, 0x40, 0x40
MF_PRESETS_RESERVED	db	0x40, 0x40, 0x40, 0x40, 0x40, 0x40, 0x40, 0x40
#else
;; TK's default settings
MF_PRESETS_FADER_MODE	db	0x01, 0x01, 0x01, 0x01, 0x01, 0x01, 0x01, 0x01
MF_PRESETS_MIN_VALUE_L	db	0x14, 0x14, 0x14, 0x14, 0x14, 0x14, 0x14, 0x14 ; only low-byte is stored (0..255)
MF_PRESETS_MAX_VALUE_L	db	0xe8, 0xe8, 0xe8, 0xe8, 0xe8, 0xe8, 0xe8, 0xe8 ; only low-byte is stored (768..1023)
MF_PRESETS_MIN_DUTY_UP	db	0x28, 0x28, 0x28, 0x28, 0x28, 0x28, 0x28, 0x28
MF_PRESETS_MAX_DUTY_UP	db	0x40, 0x40, 0x40, 0x40, 0x40, 0x40, 0x40, 0x40
MF_PRESETS_MIN_DUTY_DOWN db	0x28, 0x28, 0x28, 0x28, 0x28, 0x28, 0x28, 0x28
MF_PRESETS_MAX_DUTY_DOWN db	0x40, 0x40, 0x40, 0x40, 0x40, 0x40, 0x40, 0x40
MF_PRESETS_RESERVED	db	0x40, 0x40, 0x40, 0x40, 0x40, 0x40, 0x40, 0x40
#endif

	;; 0x60..0xff: reserved
			db	0x00, 0x00, 0x00, 0x00, 0x00, 0x00, 0x00, 0x00 ; 0x60
			db	0x00, 0x00, 0x00, 0x00, 0x00, 0x00, 0x00, 0x00 ; 0x68
			db	0x00, 0x00, 0x00, 0x00, 0x00, 0x00, 0x00, 0x00 ; 0x70
			db	0x00, 0x00, 0x00, 0x00, 0x00, 0x00, 0x00, 0x00 ; 0x78
			db	0x00, 0x00, 0x00, 0x00, 0x00, 0x00, 0x00, 0x00 ; 0x80
			db	0x00, 0x00, 0x00, 0x00, 0x00, 0x00, 0x00, 0x00 ; 0x88
			db	0x00, 0x00, 0x00, 0x00, 0x00, 0x00, 0x00, 0x00 ; 0x90
			db	0x00, 0x00, 0x00, 0x00, 0x00, 0x00, 0x00, 0x00 ; 0x98
			db	0x00, 0x00, 0x00, 0x00, 0x00, 0x00, 0x00, 0x00 ; 0xa0
			db	0x00, 0x00, 0x00, 0x00, 0x00, 0x00, 0x00, 0x00 ; 0xa8
			db	0x00, 0x00, 0x00, 0x00, 0x00, 0x00, 0x00, 0x00 ; 0xb0
			db	0x00, 0x00, 0x00, 0x00, 0x00, 0x00, 0x00, 0x00 ; 0xb8
			db	0x00, 0x00, 0x00, 0x00, 0x00, 0x00, 0x00, 0x00 ; 0xc0
			db	0x00, 0x00, 0x00, 0x00, 0x00, 0x00, 0x00, 0x00 ; 0xc8
			db	0x00, 0x00, 0x00, 0x00, 0x00, 0x00, 0x00, 0x00 ; 0xd0
			db	0x00, 0x00, 0x00, 0x00, 0x00, 0x00, 0x00, 0x00 ; 0xd8
			db	0x00, 0x00, 0x00, 0x00, 0x00, 0x00, 0x00, 0x00 ; 0xe0
			db	0x00, 0x00, 0x00, 0x00, 0x00, 0x00, 0x00, 0x00 ; 0xe8
			db	0x00, 0x00, 0x00, 0x00, 0x00, 0x00, 0x00, 0x00 ; 0xf0
			db	0x00, 0x00, 0x00, 0x00, 0x00, 0x00, 0x00, 0x00 ; 0xf8
