; $Id$
;
; MIDIbox CV
; Presets (EEPROM content)
;
; ==========================================================================
;
;  Copyright 1998-2007 Thorsten Klose (tk@midibox.org)
;  Licensed for personal non-commercial use only.
;  All other rights reserved.
; 
; ==========================================================================

        ERRORLEVEL      -220    ; suppress "Address exceeds maximum range for this processor."
	;; this is (unfortunately) required for gpasm

	org	0xf00000	; eeprom base address
	;; order of registers must match with app_defines.h, 0x180-0x1ff
CV_PRESETS
CV_PRESETS_CFG		db	(1 << CV_CFG0_MERGEROFF), 0x00, 0x00, 0x03, 0x00, 0x00, 0x00, 0x00
CV_PRESETS_CHN		db	0x00, 0x01, 0x02, 0x03, 0x04, 0x05, 0x06, 0x07
CV_PRESETS_MODE		db	0x10, 0x10, 0x10, 0x10, 0x10, 0x10, 0x10, 0x10
CV_PRESETS_PITCHRANGE	db	0x02, 0x02, 0x02, 0x02, 0x02, 0x02, 0x02, 0x02
CV_PRESETS_SPLIT_L	db	0x00, 0x00, 0x00, 0x00, 0x00, 0x00, 0x00, 0x00
CV_PRESETS_SPLIT_U	db	0x7f, 0x7f, 0x7f, 0x7f, 0x7f, 0x7f, 0x7f, 0x7f
CV_PRESETS_TRANSP_OCT	db	0x00, 0x00, 0x00, 0x00, 0x00, 0x00, 0x00, 0x00
CV_PRESETS_TRANSP_SEM	db	0x00, 0x00, 0x00, 0x00, 0x00, 0x00, 0x00, 0x00
CV_PRESETS_CC_NUMBER	db	0x10, 0x11, 0x12, 0x13, 0x14, 0x15, 0x16, 0x17
CV_PRESETS_CURVE	db	0x00, 0x00, 0x00, 0x00, 0x00, 0x00, 0x00, 0x00
CV_PRESETS_SLEW_RATE	db	0x00, 0x00, 0x00, 0x00, 0x00, 0x00, 0x00, 0x00

CV_PRESETS_RESERVED7	db	0x00, 0x00, 0x00, 0x00, 0x00, 0x00, 0x00, 0x00

CV_PRESETS_RESERVED9	db	0x00, 0x00, 0x00, 0x00, 0x00, 0x00, 0x00, 0x00
CV_PRESETS_RESERVEDA	db	0x00, 0x00, 0x00, 0x00, 0x00, 0x00, 0x00, 0x00
CV_PRESETS_RESERVEDB	db	0x00, 0x00, 0x00, 0x00, 0x00, 0x00, 0x00, 0x00
CV_PRESETS_RESERVEDC	db	0x00, 0x00, 0x00, 0x00, 0x00, 0x00, 0x00, 0x00

	;; not used
CV_PRESETS_RESERVED10	db	0x00, 0x00, 0x00, 0x00, 0x00, 0x00, 0x00, 0x00
CV_PRESETS_RESERVED11	db	0x00, 0x00, 0x00, 0x00, 0x00, 0x00, 0x00, 0x00
CV_PRESETS_RESERVED12	db	0x00, 0x00, 0x00, 0x00, 0x00, 0x00, 0x00, 0x00
CV_PRESETS_RESERVED13	db	0x00, 0x00, 0x00, 0x00, 0x00, 0x00, 0x00, 0x00

CV_PRESETS_RESERVED14	db	0x00, 0x00, 0x00, 0x00, 0x00, 0x00, 0x00, 0x00
CV_PRESETS_RESERVED15	db	0x00, 0x00, 0x00, 0x00, 0x00, 0x00, 0x00, 0x00
CV_PRESETS_RESERVED16	db	0x00, 0x00, 0x00, 0x00, 0x00, 0x00, 0x00, 0x00
CV_PRESETS_RESERVED17	db	0x00, 0x00, 0x00, 0x00, 0x00, 0x00, 0x00, 0x00

CV_PRESETS_RESERVED18	db	0x00, 0x00, 0x00, 0x00, 0x00, 0x00, 0x00, 0x00
CV_PRESETS_RESERVED19	db	0x00, 0x00, 0x00, 0x00, 0x00, 0x00, 0x00, 0x00
CV_PRESETS_RESERVED1A	db	0x00, 0x00, 0x00, 0x00, 0x00, 0x00, 0x00, 0x00
CV_PRESETS_RESERVED1B	db	0x00, 0x00, 0x00, 0x00, 0x00, 0x00, 0x00, 0x00

CV_PRESETS_RESERVED1C	db	0x00, 0x00, 0x00, 0x00, 0x00, 0x00, 0x00, 0x00
CV_PRESETS_RESERVED1D	db	0x00, 0x00, 0x00, 0x00, 0x00, 0x00, 0x00, 0x00


	;; name should be all-zero if not changed by user
	;; otherwise formatted external patches would get the name "Internal Patch" (or similar)
CV_PRESETS_NAME0_7	db	0x00, 0x00, 0x00, 0x00, 0x00, 0x00, 0x00, 0x00
CV_PRESETS_NAME8_15	db	0x00, 0x00, 0x00, 0x00, 0x00, 0x00, 0x00, 0x00
