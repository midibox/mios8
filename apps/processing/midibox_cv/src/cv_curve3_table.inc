; $Id$
;; generated with 'perl utilsrve3_table.pl > cv_curve3_table.inc
CV_CURVE3_TABLE
	dw	0x0000  ;   0
	dw	0x007e  ;   1
	dw	0x00f8  ;   2
	dw	0x016e  ;   3
	dw	0x01e1  ;   4
	dw	0x0250  ;   5
	dw	0x02bc  ;   6
	dw	0x0324  ;   7
	dw	0x038a  ;   8
	dw	0x03ec  ;   9
	dw	0x044b  ;  10
	dw	0x04a7  ;  11
	dw	0x0500  ;  12
	dw	0x0557  ;  13
	dw	0x05ab  ;  14
	dw	0x05fc  ;  15
	dw	0x064b  ;  16
	dw	0x0698  ;  17
	dw	0x06e2  ;  18
	dw	0x0729  ;  19
	dw	0x076f  ;  20
	dw	0x07b3  ;  21
	dw	0x07f4  ;  22
	dw	0x0833  ;  23
	dw	0x0871  ;  24
	dw	0x08ac  ;  25
	dw	0x08e6  ;  26
	dw	0x091e  ;  27
	dw	0x0954  ;  28
	dw	0x0989  ;  29
	dw	0x09bb  ;  30
	dw	0x09ed  ;  31
	dw	0x0a1d  ;  32
	dw	0x0a4b  ;  33
	dw	0x0a78  ;  34
	dw	0x0aa4  ;  35
	dw	0x0ace  ;  36
	dw	0x0af7  ;  37
	dw	0x0b1e  ;  38
	dw	0x0b45  ;  39
	dw	0x0b6a  ;  40
	dw	0x0b8e  ;  41
	dw	0x0bb1  ;  42
	dw	0x0bd3  ;  43
	dw	0x0bf4  ;  44
	dw	0x0c14  ;  45
	dw	0x0c33  ;  46
	dw	0x0c51  ;  47
	dw	0x0c6e  ;  48
	dw	0x0c8a  ;  49
	dw	0x0ca5  ;  50
	dw	0x0cbf  ;  51
	dw	0x0cd9  ;  52
	dw	0x0cf2  ;  53
	dw	0x0d0a  ;  54
	dw	0x0d21  ;  55
	dw	0x0d38  ;  56
	dw	0x0d4e  ;  57
	dw	0x0d63  ;  58
	dw	0x0d77  ;  59
	dw	0x0d8b  ;  60
	dw	0x0d9f  ;  61
	dw	0x0db1  ;  62
	dw	0x0dc4  ;  63
	dw	0x0dd5  ;  64
	dw	0x0de6  ;  65
	dw	0x0df7  ;  66
	dw	0x0e07  ;  67
	dw	0x0e16  ;  68
	dw	0x0e25  ;  69
	dw	0x0e34  ;  70
	dw	0x0e42  ;  71
	dw	0x0e50  ;  72
	dw	0x0e5d  ;  73
	dw	0x0e6a  ;  74
	dw	0x0e76  ;  75
	dw	0x0e83  ;  76
	dw	0x0e8e  ;  77
	dw	0x0e9a  ;  78
	dw	0x0ea5  ;  79
	dw	0x0eaf  ;  80
	dw	0x0eba  ;  81
	dw	0x0ec4  ;  82
	dw	0x0ecd  ;  83
	dw	0x0ed7  ;  84
	dw	0x0ee0  ;  85
	dw	0x0ee9  ;  86
	dw	0x0ef1  ;  87
	dw	0x0efa  ;  88
	dw	0x0f02  ;  89
	dw	0x0f0a  ;  90
	dw	0x0f11  ;  91
	dw	0x0f18  ;  92
	dw	0x0f20  ;  93
	dw	0x0f26  ;  94
	dw	0x0f2d  ;  95
	dw	0x0f34  ;  96
	dw	0x0f3a  ;  97
	dw	0x0f40  ;  98
	dw	0x0f46  ;  99
	dw	0x0f4c  ; 100
	dw	0x0f51  ; 101
	dw	0x0f56  ; 102
	dw	0x0f5c  ; 103
	dw	0x0f61  ; 104
	dw	0x0f66  ; 105
	dw	0x0f6a  ; 106
	dw	0x0f6f  ; 107
	dw	0x0f73  ; 108
	dw	0x0f78  ; 109
	dw	0x0f7c  ; 110
	dw	0x0f80  ; 111
	dw	0x0f84  ; 112
	dw	0x0f88  ; 113
	dw	0x0f8b  ; 114
	dw	0x0f8f  ; 115
	dw	0x0f92  ; 116
	dw	0x0f96  ; 117
	dw	0x0f99  ; 118
	dw	0x0f9c  ; 119
	dw	0x0f9f  ; 120
	dw	0x0fa2  ; 121
	dw	0x0fa5  ; 122
	dw	0x0fa8  ; 123
	dw	0x0faa  ; 124
	dw	0x0fad  ; 125
	dw	0x0fb0  ; 126
	dw	0x0fb2  ; 127
