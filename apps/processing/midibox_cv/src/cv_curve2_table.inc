; $Id$
;; generated with 'perl utilsrve2_table.pl > cv_curve2_table.inc'
CV_CURVE2_TABLE
	dw	0x0fe8  ;   0
	dw	0x0fc8  ;   1
	dw	0x0fa8  ;   2
	dw	0x0f88  ;   3
	dw	0x0f68  ;   4
	dw	0x0f48  ;   5
	dw	0x0f28  ;   6
	dw	0x0f08  ;   7
	dw	0x0ee8  ;   8
	dw	0x0ec8  ;   9
	dw	0x0ea8  ;  10
	dw	0x0e88  ;  11
	dw	0x0e68  ;  12
	dw	0x0e48  ;  13
	dw	0x0e28  ;  14
	dw	0x0e08  ;  15
	dw	0x0de8  ;  16
	dw	0x0dc8  ;  17
	dw	0x0da8  ;  18
	dw	0x0d88  ;  19
	dw	0x0d68  ;  20
	dw	0x0d48  ;  21
	dw	0x0d28  ;  22
	dw	0x0d08  ;  23
	dw	0x0ce8  ;  24
	dw	0x0cc8  ;  25
	dw	0x0ca8  ;  26
	dw	0x0c88  ;  27
	dw	0x0c68  ;  28
	dw	0x0c48  ;  29
	dw	0x0c28  ;  30
	dw	0x0c08  ;  31
	dw	0x0be8  ;  32
	dw	0x0bc8  ;  33
	dw	0x0ba8  ;  34
	dw	0x0b88  ;  35
	dw	0x0b68  ;  36
	dw	0x0b48  ;  37
	dw	0x0b28  ;  38
	dw	0x0b08  ;  39
	dw	0x0ae8  ;  40
	dw	0x0ac8  ;  41
	dw	0x0aa8  ;  42
	dw	0x0a88  ;  43
	dw	0x0a68  ;  44
	dw	0x0a48  ;  45
	dw	0x0a28  ;  46
	dw	0x0a08  ;  47
	dw	0x09e8  ;  48
	dw	0x09c8  ;  49
	dw	0x09a8  ;  50
	dw	0x0988  ;  51
	dw	0x0968  ;  52
	dw	0x0948  ;  53
	dw	0x0928  ;  54
	dw	0x0908  ;  55
	dw	0x08e8  ;  56
	dw	0x08c8  ;  57
	dw	0x08a8  ;  58
	dw	0x0888  ;  59
	dw	0x0868  ;  60
	dw	0x0848  ;  61
	dw	0x0828  ;  62
	dw	0x0808  ;  63
	dw	0x07e8  ;  64
	dw	0x07c8  ;  65
	dw	0x07a8  ;  66
	dw	0x0788  ;  67
	dw	0x0768  ;  68
	dw	0x0748  ;  69
	dw	0x0728  ;  70
	dw	0x0708  ;  71
	dw	0x06e8  ;  72
	dw	0x06c8  ;  73
	dw	0x06a8  ;  74
	dw	0x0688  ;  75
	dw	0x0668  ;  76
	dw	0x0648  ;  77
	dw	0x0628  ;  78
	dw	0x0608  ;  79
	dw	0x05e8  ;  80
	dw	0x05c8  ;  81
	dw	0x05a8  ;  82
	dw	0x0588  ;  83
	dw	0x0568  ;  84
	dw	0x0548  ;  85
	dw	0x0528  ;  86
	dw	0x0508  ;  87
	dw	0x04e8  ;  88
	dw	0x04c8  ;  89
	dw	0x04a8  ;  90
	dw	0x0488  ;  91
	dw	0x0468  ;  92
	dw	0x0448  ;  93
	dw	0x0428  ;  94
	dw	0x0408  ;  95
	dw	0x03e8  ;  96
	dw	0x03c8  ;  97
	dw	0x03a8  ;  98
	dw	0x0388  ;  99
	dw	0x0368  ; 100
	dw	0x0348  ; 101
	dw	0x0328  ; 102
	dw	0x0308  ; 103
	dw	0x02e8  ; 104
	dw	0x02c8  ; 105
	dw	0x02a8  ; 106
	dw	0x0288  ; 107
	dw	0x0268  ; 108
	dw	0x0248  ; 109
	dw	0x0228  ; 110
	dw	0x0208  ; 111
	dw	0x01e8  ; 112
	dw	0x01c8  ; 113
	dw	0x01a8  ; 114
	dw	0x0188  ; 115
	dw	0x0168  ; 116
	dw	0x0148  ; 117
	dw	0x0128  ; 118
	dw	0x0108  ; 119
	dw	0x00e8  ; 120
	dw	0x00c8  ; 121
	dw	0x00a8  ; 122
	dw	0x0088  ; 123
	dw	0x0068  ; 124
	dw	0x0048  ; 125
	dw	0x0028  ; 126
	dw	0x0008  ; 127
