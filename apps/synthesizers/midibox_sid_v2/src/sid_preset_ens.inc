; $Id$
;
; MIDIbox SID
; Ensemble Preset
; (included from sid_presets.inc for EEPROM preload, and sid_ens.inc 
; for runtime re-initialisation)
;
; ==========================================================================
;
;  Copyright 1998-2007 Thorsten Klose (tk@midibox.org)
;  Licensed for personal non-commercial use only.
;  All other rights reserved.
; 
; ==========================================================================

	;; SID1
	;;	Bank  Patch CTRL1 CTRL2 CkDiv BPM  SP.C  A.Inv
	db	0x00, 0x00, 0x02, 0x00, 0x02, 120, 0x00, 0x00

	;; filter calibration values for left and right channel SID
	dw	(DEFAULT_FILTER_CALI_MIN)<<4, (DEFAULT_FILTER_CALI_MAX)<<4	; SIDL Filter Min/Max
	dw	(DEFAULT_FILTER_CALI_MIN)<<4, (DEFAULT_FILTER_CALI_MAX)<<4	; SIDL Filter Min/Max

	;;	Chn   SplL  SplU  Trn.  res1  res2  res3  res4
	db	0x00, 0x00, 0x7f, 0x40, 0x00, 0x00, 0x00, 0x00	; Instr.1
	db	0x10, 0x00, 0x7f, 0x40, 0x00, 0x00, 0x00, 0x00	; Instr.2
	db	0x10, 0x00, 0x7f, 0x40, 0x00, 0x00, 0x00, 0x00	; Instr.3
	db	0x10, 0x00, 0x7f, 0x40, 0x00, 0x00, 0x00, 0x00	; Instr.4
	db	0x10, 0x00, 0x7f, 0x40, 0x00, 0x00, 0x00, 0x00	; Instr.5
	db	0x10, 0x00, 0x7f, 0x40, 0x00, 0x00, 0x00, 0x00	; Instr.6

	;; SID2
	;;	Bank  Patch CTRL1 CTRL2 CkDiv BPM  SP.C  A.Inv
	db	0x00, 0x00, 0x00, 0x00, 0x02, 120, 0x00, 0x00

	;; filter calibration values for left and right channel SID
	dw	(DEFAULT_FILTER_CALI_MIN)<<4, (DEFAULT_FILTER_CALI_MAX)<<4	; SIDL Filter Min/Max
	dw	(DEFAULT_FILTER_CALI_MIN)<<4, (DEFAULT_FILTER_CALI_MAX)<<4	; SIDL Filter Min/Max

	;;	Chn   SplL  SplU  Trn.  res1  res2  res3  res4
	db	0x01, 0x00, 0x7f, 0x40, 0x00, 0x00, 0x00, 0x00	; Instr.1
	db	0x10, 0x00, 0x7f, 0x40, 0x00, 0x00, 0x00, 0x00	; Instr.2
	db	0x10, 0x00, 0x7f, 0x40, 0x00, 0x00, 0x00, 0x00	; Instr.3
	db	0x10, 0x00, 0x7f, 0x40, 0x00, 0x00, 0x00, 0x00	; Instr.4
	db	0x10, 0x00, 0x7f, 0x40, 0x00, 0x00, 0x00, 0x00	; Instr.5
	db	0x10, 0x00, 0x7f, 0x40, 0x00, 0x00, 0x00, 0x00	; Instr.6

	;; SID3
	;;	Bank  Patch CTRL1 CTRL2 CkDiv BPM  SP.C  A.Inv
	db	0x00, 0x00, 0x00, 0x00, 0x02, 120, 0x00, 0x00

	;; filter calibration values for left and right channel SID
	dw	(DEFAULT_FILTER_CALI_MIN)<<4, (DEFAULT_FILTER_CALI_MAX)<<4	; SIDL Filter Min/Max
	dw	(DEFAULT_FILTER_CALI_MIN)<<4, (DEFAULT_FILTER_CALI_MAX)<<4	; SIDL Filter Min/Max

	;;	Chn   SplL  SplU  Trn.  res1  res2  res3  res4
	db	0x02, 0x00, 0x7f, 0x40, 0x00, 0x00, 0x00, 0x00	; Instr.1
	db	0x10, 0x00, 0x7f, 0x40, 0x00, 0x00, 0x00, 0x00	; Instr.2
	db	0x10, 0x00, 0x7f, 0x40, 0x00, 0x00, 0x00, 0x00	; Instr.3
	db	0x10, 0x00, 0x7f, 0x40, 0x00, 0x00, 0x00, 0x00	; Instr.4
	db	0x10, 0x00, 0x7f, 0x40, 0x00, 0x00, 0x00, 0x00	; Instr.5
	db	0x10, 0x00, 0x7f, 0x40, 0x00, 0x00, 0x00, 0x00	; Instr.6

	;; SID4
	;;	Bank  Patch CTRL1 CTRL2 CkDiv BPM  SP.C  A.Inv
	db	0x00, 0x00, 0x00, 0x00, 0x02, 120, 0x00, 0x00

	;; filter calibration values for left and right channel SID
	dw	(DEFAULT_FILTER_CALI_MIN)<<4, (DEFAULT_FILTER_CALI_MAX)<<4	; SIDL Filter Min/Max
	dw	(DEFAULT_FILTER_CALI_MIN)<<4, (DEFAULT_FILTER_CALI_MAX)<<4	; SIDL Filter Min/Max

	;;	Chn   SplL  SplU  Trn.  res1  res2  res3  res4
	db	0x03, 0x00, 0x7f, 0x40, 0x00, 0x00, 0x00, 0x00	; Instr.1
	db	0x10, 0x00, 0x7f, 0x40, 0x00, 0x00, 0x00, 0x00	; Instr.2
	db	0x10, 0x00, 0x7f, 0x40, 0x00, 0x00, 0x00, 0x00	; Instr.3
	db	0x10, 0x00, 0x7f, 0x40, 0x00, 0x00, 0x00, 0x00	; Instr.4
	db	0x10, 0x00, 0x7f, 0x40, 0x00, 0x00, 0x00, 0x00	; Instr.5
	db	0x10, 0x00, 0x7f, 0x40, 0x00, 0x00, 0x00, 0x00	; Instr.6
