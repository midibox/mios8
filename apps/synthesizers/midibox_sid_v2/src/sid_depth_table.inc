; $Id$
;
; MIDIbox SID
; Depth Table
; derived from MIDIbox SID V1.5
; required since the frequency table has been changed to keep the influence
; of the depth parameter compatible with older firmware versions
;
; ==========================================================================
;
;  Copyright 1998-2007 Thorsten Klose (tk@midibox.org)
;  Licensed for personal non-commercial use only.
;  All other rights reserved.
; 
; ==========================================================================

SID_DEPTH_TABLE
	db	0x00, 0x01, 0x02, 0x03, 0x04, 0x05, 0x06, 0x07
	db	0x08, 0x0a, 0x0c, 0x0e, 0x11, 0x12, 0x13, 0x14
	db	0x15, 0x16, 0x18, 0x18, 0x1b, 0x1c, 0x1e, 0x20
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	db	0xd9, 0xe6, 0xf4, 0xff, 0xff, 0xff, 0xff, 0xff
