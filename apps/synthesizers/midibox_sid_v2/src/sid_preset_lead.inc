; $Id$
;
; MIDIbox SID
; Lead Patch Preset
; (included from sid_presets.inc for EEPROM preload, and sid_patch.inc 
; for runtime re-initialisation)
;
; ==========================================================================
;
;  Copyright 1998-2007 Thorsten Klose (tk@midibox.org)
;  Licensed for personal non-commercial use only.
;  All other rights reserved.
; 
; ==========================================================================

	db      'L','e','a','d',' ','P','a','t','c','h',' ',' ',' ',' ',' ',' '

	;;      ENGINE  HWFLAGS  OPT1  OPT2  Swtch -     -     -
	db	0x00,   0x00,    0x00, 0x00, 0x00, 0x00, 0x00, 0x00

	;;      PAR1  PAR2  INIT  MIN   MAX     PAR1  PAR2  INIT  MIN   MAX
	db	0x00, 0x00, 0x80, 0x00, 0xff,   0x00, 0x00, 0x80, 0x00, 0xff	; Knob1/2
	db	0x00, 0x00, 0x80, 0x00, 0xff,   0x00, 0x00, 0x80, 0x00, 0xff	; Knob3/4
	db	0x00, 0x00, 0x80, 0x00, 0xff,   0x00, 0x00, 0x80, 0x00, 0xff	; Knob5/Vel
	db	0x50, 0x00, 0x80, 0x00, 0xff,   0x00, 0x00, 0x80, 0x00, 0xff	; PB/Aftertouch

	;;	EXT Parameters 1-8 - 16 bit values (low/high), normaly used as AOUT offset
	db	0x00, 0x80	; AOUT#1
	db	0x00, 0x80	; AOUT#2
	db	0x00, 0x80	; AOUT#3
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	db	0x00, 0x80	; AOUT#8

	;;	FLAGS  DETUNE VOL  PHASE
	db	0x00,  0x00, 0x7f, 0x00

	;;	C/M    CutOff      Res.  -     -
	db	0x10,  0x00, 0x02, 0x00, 0x00, 0x00	; Filter1
	db	0x10,  0x00, 0x02, 0x00, 0x00, 0x00	; Filter2

	;;	Flgs  Wave   AD    SR   PW_L  PW_H  Res1  Delay Trns  Fine  PRng  Port. ArpM  A.S/D A.G/R Res2
	db	0x00, 0x04, 0x00, 0xf0, 0x00, 0x08, 0x00, 0x00, 0x40, 0x80, 0x02, 0x00, 0x00, 0x5f, 0x05, 0x00	; SID1 Voice1
	db	0x00, 0x14, 0x00, 0xf0, 0x00, 0x08, 0x00, 0x00, 0x40, 0x80, 0x02, 0x00, 0x00, 0x5f, 0x05, 0x00	; SID1 Voice2
	db	0x00, 0x14, 0x00, 0xf0, 0x00, 0x08, 0x00, 0x00, 0x40, 0x80, 0x02, 0x00, 0x00, 0x5f, 0x05, 0x00	; SID1 Voice3
	db	0x00, 0x04, 0x00, 0xf0, 0x00, 0x08, 0x00, 0x00, 0x40, 0x80, 0x02, 0x00, 0x00, 0x5f, 0x05, 0x00	; SID2 Voice1
	db	0x00, 0x14, 0x00, 0xf0, 0x00, 0x08, 0x00, 0x00, 0x40, 0x80, 0x02, 0x00, 0x00, 0x5f, 0x05, 0x00	; SID2 Voice2
	db	0x00, 0x14, 0x00, 0xf0, 0x00, 0x08, 0x00, 0x00, 0x40, 0x80, 0x02, 0x00, 0x00, 0x5f, 0x05, 0x00	; SID2 Voice3

	;;	Mode  Dep.  Rate  Dly   Phs    Mode  Dep.  Rate  Dly   Phs
	db	0x01, 0x80, 0x00, 0x00, 0x00,  0x01, 0x80, 0x00, 0x00, 0x00	; LFO1/2
	db	0x01, 0x80, 0x00, 0x00, 0x00,  0x01, 0x80, 0x00, 0x00, 0x00	; LFO3/4
	db	0x01, 0x80, 0x00, 0x00, 0x00,  0x01, 0x80, 0x00, 0x00, 0x00	; LFO5/6

	;; reserved
	db	0,0

	;;	Mode  Dep.  Del.  Atk1  AtkL  Atk2  Dec1  DecL  Dec2  Sust  Rel1  RelL  Rel2  ACur  DCur  SCur
	db	0x00, 0xc0, 0x00, 0x30, 0xff, 0x00, 0x00, 0xff, 0x30, 0x40, 0x20, 0x00, 0x00, 0x80, 0x80, 0x80	; ENV1
	db	0x00, 0x40, 0x00, 0x50, 0xff, 0x00, 0x00, 0xff, 0x50, 0x10, 0x30, 0x00, 0x00, 0x80, 0x80, 0x80	; ENV2

	;;	SRC1  SRC2  OP    Depth TrgL  TrgR  X.#1  X.#2
	db	0x01, 0x00, 0x03, 0xc0, 0x00, 0x00, 0x00, 0x00	; Mod1
	db	0x02, 0x00, 0x03, 0xc0, 0x00, 0x00, 0x00, 0x00	; Mod2
	db	0x03, 0x00, 0x03, 0xc0, 0x00, 0x00, 0x00, 0x00	; Mod3
	db	0x04, 0x00, 0x03, 0xc0, 0x00, 0x00, 0x00, 0x00	; Mod4
	db	0x05, 0x00, 0x03, 0xc0, 0x00, 0x00, 0x00, 0x00	; Mod5
	db	0x06, 0x00, 0x03, 0xc0, 0x00, 0x00, 0x00, 0x00	; Mod6
	db	0x07, 0x00, 0x03, 0xc0, 0x00, 0x00, 0x00, 0x00	; Mod7
	db	0x08, 0x00, 0x03, 0xc0, 0x00, 0x00, 0x00, 0x00	; Mod8

	;;	Trigger Matrix
	db	0xff, 0x00, 0x0f,   0x3f, 0x03, 0x00	; Note On / Note Off
	db	0x00, 0x00, 0x00,   0x00, 0x00, 0x00	; ENV1/2 Sustain Phase
	db	0x00, 0x00, 0x00,   0x00, 0x00, 0x00	; LFO1/2 Period
	db	0x00, 0x00, 0x00,   0x00, 0x00, 0x00	; LFO3/4 Period
	db	0x00, 0x00, 0x00,   0x00, 0x00, 0x00	; LFO5/6 Period
	db	0x00, 0x00, 0xf0,   0x00, 0x00, 0x00	; Clock, Clock/4
	db	0x00, 0x00, 0x00,   0x00, 0x00, 0x00	; Clock/16, MIDI Clock Start

	;; reserved
	db	0,0

	;;	Speed Asgn  Begin End   Loop    Speed Asgn  Begin End   Loop
	db	0xcb, 0x00, 0x00, 0x1f, 0x80,   0xcb, 0x00, 0x20, 0x3f, 0xa0	; WT#1 and WT#2
	db	0xcb, 0x00, 0x40, 0x5f, 0xc0,   0xcb, 0x00, 0x60, 0x7f, 0xe0	; WT#3 and WT#4

	db	0x40,0x40,0x40,0x40,0x40,0x40,0x40,0x40,0x40,0x40,0x40,0x40,0x40,0x40,0x40,0x40	; Wavetable Preload
	db	0x40,0x40,0x40,0x40,0x40,0x40,0x40,0x40,0x40,0x40,0x40,0x40,0x40,0x40,0x40,0x40	; Wavetable Preload
	db	0x40,0x40,0x40,0x40,0x40,0x40,0x40,0x40,0x40,0x40,0x40,0x40,0x40,0x40,0x40,0x40	; Wavetable Preload
	db	0x40,0x40,0x40,0x40,0x40,0x40,0x40,0x40,0x40,0x40,0x40,0x40,0x40,0x40,0x40,0x40	; Wavetable Preload
	db	0x40,0x40,0x40,0x40,0x40,0x40,0x40,0x40,0x40,0x40,0x40,0x40,0x40,0x40,0x40,0x40	; Wavetable Preload
	db	0x40,0x40,0x40,0x40,0x40,0x40,0x40,0x40,0x40,0x40,0x40,0x40,0x40,0x40,0x40,0x40	; Wavetable Preload
	db	0x40,0x40,0x40,0x40,0x40,0x40,0x40,0x40,0x40,0x40,0x40,0x40,0x40,0x40,0x40,0x40	; Wavetable Preload
	db	0x40,0x40,0x40,0x40,0x40,0x40,0x40,0x40,0x40,0x40,0x40,0x40,0x40,0x40,0x40,0x40	; Wavetable Preload
