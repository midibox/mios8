; $Id$
;
; MIDIbox SID
; LFO Table
; generated with lfo_table.pl - calculates sweep from 0.008 Hz to 44 Hz
;
; ==========================================================================
;
;  Copyright 1998-2007 Thorsten Klose (tk@midibox.org)
;  Licensed for personal non-commercial use only.
;  All other rights reserved.
; 
; ==========================================================================

SID_LFO_TABLE
	dw	    0	;   0:  0.000 Hz
	dw	    1	;   1:  0.008 Hz
	dw	    3	;   2:  0.023 Hz
	dw	    6	;   3:  0.046 Hz
	dw	    8	;   4:  0.061 Hz
	dw	   10	;   5:  0.076 Hz
	dw	   12	;   6:  0.092 Hz
	dw	   14	;   7:  0.107 Hz
	dw	   16	;   8:  0.122 Hz
	dw	   18	;   9:  0.137 Hz
	dw	   21	;  10:  0.160 Hz
	dw	   23	;  11:  0.175 Hz
	dw	   25	;  12:  0.191 Hz
	dw	   28	;  13:  0.214 Hz
	dw	   30	;  14:  0.229 Hz
	dw	   33	;  15:  0.252 Hz
	dw	   35	;  16:  0.267 Hz
	dw	   38	;  17:  0.290 Hz
	dw	   40	;  18:  0.305 Hz
	dw	   43	;  19:  0.328 Hz
	dw	   45	;  20:  0.343 Hz
	dw	   48	;  21:  0.366 Hz
	dw	   51	;  22:  0.389 Hz
	dw	   54	;  23:  0.412 Hz
	dw	   56	;  24:  0.427 Hz
	dw	   59	;  25:  0.450 Hz
	dw	   62	;  26:  0.473 Hz
	dw	   65	;  27:  0.496 Hz
	dw	   68	;  28:  0.519 Hz
	dw	   71	;  29:  0.542 Hz
	dw	   74	;  30:  0.565 Hz
	dw	   77	;  31:  0.587 Hz
	dw	   80	;  32:  0.610 Hz
	dw	   83	;  33:  0.633 Hz
	dw	   87	;  34:  0.664 Hz
	dw	   90	;  35:  0.687 Hz
	dw	   93	;  36:  0.710 Hz
	dw	   97	;  37:  0.740 Hz
	dw	  100	;  38:  0.763 Hz
	dw	  104	;  39:  0.793 Hz
	dw	  107	;  40:  0.816 Hz
	dw	  111	;  41:  0.847 Hz
	dw	  115	;  42:  0.877 Hz
	dw	  118	;  43:  0.900 Hz
	dw	  122	;  44:  0.931 Hz
	dw	  126	;  45:  0.961 Hz
	dw	  130	;  46:  0.992 Hz
	dw	  134	;  47:  1.022 Hz
	dw	  138	;  48:  1.053 Hz
	dw	  142	;  49:  1.083 Hz
	dw	  146	;  50:  1.114 Hz
	dw	  150	;  51:  1.144 Hz
	dw	  154	;  52:  1.175 Hz
	dw	  159	;  53:  1.213 Hz
	dw	  163	;  54:  1.244 Hz
	dw	  168	;  55:  1.282 Hz
	dw	  172	;  56:  1.312 Hz
	dw	  177	;  57:  1.350 Hz
	dw	  181	;  58:  1.381 Hz
	dw	  186	;  59:  1.419 Hz
	dw	  191	;  60:  1.457 Hz
	dw	  196	;  61:  1.495 Hz
	dw	  201	;  62:  1.534 Hz
	dw	  206	;  63:  1.572 Hz
	dw	  211	;  64:  1.610 Hz
	dw	  216	;  65:  1.648 Hz
	dw	  221	;  66:  1.686 Hz
	dw	  227	;  67:  1.732 Hz
	dw	  232	;  68:  1.770 Hz
	dw	  237	;  69:  1.808 Hz
	dw	  243	;  70:  1.854 Hz
	dw	  249	;  71:  1.900 Hz
	dw	  254	;  72:  1.938 Hz
	dw	  260	;  73:  1.984 Hz
	dw	  266	;  74:  2.029 Hz
	dw	  272	;  75:  2.075 Hz
	dw	  278	;  76:  2.121 Hz
	dw	  284	;  77:  2.167 Hz
	dw	  291	;  78:  2.220 Hz
	dw	  297	;  79:  2.266 Hz
	dw	  304	;  80:  2.319 Hz
	dw	  310	;  81:  2.365 Hz
	dw	  317	;  82:  2.419 Hz
	dw	  324	;  83:  2.472 Hz
	dw	  331	;  84:  2.525 Hz
	dw	  337	;  85:  2.571 Hz
	dw	  345	;  86:  2.632 Hz
	dw	  352	;  87:  2.686 Hz
	dw	  359	;  88:  2.739 Hz
	dw	  367	;  89:  2.800 Hz
	dw	  374	;  90:  2.853 Hz
	dw	  382	;  91:  2.914 Hz
	dw	  389	;  92:  2.968 Hz
	dw	  397	;  93:  3.029 Hz
	dw	  405	;  94:  3.090 Hz
	dw	  413	;  95:  3.151 Hz
	dw	  422	;  96:  3.220 Hz
	dw	  430	;  97:  3.281 Hz
	dw	  438	;  98:  3.342 Hz
	dw	  447	;  99:  3.410 Hz
	dw	  456	; 100:  3.479 Hz
	dw	  465	; 101:  3.548 Hz
	dw	  474	; 102:  3.616 Hz
	dw	  483	; 103:  3.685 Hz
	dw	  492	; 104:  3.754 Hz
	dw	  502	; 105:  3.830 Hz
	dw	  511	; 106:  3.899 Hz
	dw	  521	; 107:  3.975 Hz
	dw	  531	; 108:  4.051 Hz
	dw	  541	; 109:  4.128 Hz
	dw	  551	; 110:  4.204 Hz
	dw	  561	; 111:  4.280 Hz
	dw	  572	; 112:  4.364 Hz
	dw	  582	; 113:  4.440 Hz
	dw	  593	; 114:  4.524 Hz
	dw	  604	; 115:  4.608 Hz
	dw	  615	; 116:  4.692 Hz
	dw	  626	; 117:  4.776 Hz
	dw	  638	; 118:  4.868 Hz
	dw	  650	; 119:  4.959 Hz
	dw	  661	; 120:  5.043 Hz
	dw	  673	; 121:  5.135 Hz
	dw	  686	; 122:  5.234 Hz
	dw	  698	; 123:  5.325 Hz
	dw	  710	; 124:  5.417 Hz
	dw	  723	; 125:  5.516 Hz
	dw	  736	; 126:  5.615 Hz
	dw	  749	; 127:  5.714 Hz
	dw	  762	; 128:  5.814 Hz
	dw	  776	; 129:  5.920 Hz
	dw	  790	; 130:  6.027 Hz
	dw	  804	; 131:  6.134 Hz
	dw	  818	; 132:  6.241 Hz
	dw	  832	; 133:  6.348 Hz
	dw	  847	; 134:  6.462 Hz
	dw	  861	; 135:  6.569 Hz
	dw	  876	; 136:  6.683 Hz
	dw	  892	; 137:  6.805 Hz
	dw	  907	; 138:  6.920 Hz
	dw	  923	; 139:  7.042 Hz
	dw	  939	; 140:  7.164 Hz
	dw	  955	; 141:  7.286 Hz
	dw	  971	; 142:  7.408 Hz
	dw	  988	; 143:  7.538 Hz
	dw	 1005	; 144:  7.668 Hz
	dw	 1022	; 145:  7.797 Hz
	dw	 1040	; 146:  7.935 Hz
	dw	 1057	; 147:  8.064 Hz
	dw	 1075	; 148:  8.202 Hz
	dw	 1093	; 149:  8.339 Hz
	dw	 1112	; 150:  8.484 Hz
	dw	 1131	; 151:  8.629 Hz
	dw	 1150	; 152:  8.774 Hz
	dw	 1169	; 153:  8.919 Hz
	dw	 1189	; 154:  9.071 Hz
	dw	 1209	; 155:  9.224 Hz
	dw	 1229	; 156:  9.377 Hz
	dw	 1250	; 157:  9.537 Hz
	dw	 1271	; 158:  9.697 Hz
	dw	 1292	; 159:  9.857 Hz
	dw	 1313	; 160: 10.017 Hz
	dw	 1335	; 161: 10.185 Hz
	dw	 1357	; 162: 10.353 Hz
	dw	 1380	; 163: 10.529 Hz
	dw	 1403	; 164: 10.704 Hz
	dw	 1426	; 165: 10.880 Hz
	dw	 1449	; 166: 11.055 Hz
	dw	 1473	; 167: 11.238 Hz
	dw	 1497	; 168: 11.421 Hz
	dw	 1522	; 169: 11.612 Hz
	dw	 1547	; 170: 11.803 Hz
	dw	 1572	; 171: 11.993 Hz
	dw	 1598	; 172: 12.192 Hz
	dw	 1624	; 173: 12.390 Hz
	dw	 1651	; 174: 12.596 Hz
	dw	 1678	; 175: 12.802 Hz
	dw	 1705	; 176: 13.008 Hz
	dw	 1733	; 177: 13.222 Hz
	dw	 1761	; 178: 13.435 Hz
	dw	 1790	; 179: 13.657 Hz
	dw	 1819	; 180: 13.878 Hz
	dw	 1848	; 181: 14.099 Hz
	dw	 1878	; 182: 14.328 Hz
	dw	 1909	; 183: 14.565 Hz
	dw	 1939	; 184: 14.793 Hz
	dw	 1971	; 185: 15.038 Hz
	dw	 2002	; 186: 15.274 Hz
	dw	 2035	; 187: 15.526 Hz
	dw	 2067	; 188: 15.770 Hz
	dw	 2101	; 189: 16.029 Hz
	dw	 2134	; 190: 16.281 Hz
	dw	 2169	; 191: 16.548 Hz
	dw	 2203	; 192: 16.808 Hz
	dw	 2239	; 193: 17.082 Hz
	dw	 2274	; 194: 17.349 Hz
	dw	 2311	; 195: 17.632 Hz
	dw	 2348	; 196: 17.914 Hz
	dw	 2385	; 197: 18.196 Hz
	dw	 2423	; 198: 18.486 Hz
	dw	 2462	; 199: 18.784 Hz
	dw	 2501	; 200: 19.081 Hz
	dw	 2541	; 201: 19.386 Hz
	dw	 2581	; 202: 19.691 Hz
	dw	 2622	; 203: 20.004 Hz
	dw	 2664	; 204: 20.325 Hz
	dw	 2706	; 205: 20.645 Hz
	dw	 2749	; 206: 20.973 Hz
	dw	 2793	; 207: 21.309 Hz
	dw	 2837	; 208: 21.645 Hz
	dw	 2882	; 209: 21.988 Hz
	dw	 2927	; 210: 22.331 Hz
	dw	 2973	; 211: 22.682 Hz
	dw	 3020	; 212: 23.041 Hz
	dw	 3068	; 213: 23.407 Hz
	dw	 3116	; 214: 23.773 Hz
	dw	 3165	; 215: 24.147 Hz
	dw	 3215	; 216: 24.529 Hz
	dw	 3266	; 217: 24.918 Hz
	dw	 3317	; 218: 25.307 Hz
	dw	 3369	; 219: 25.703 Hz
	dw	 3422	; 220: 26.108 Hz
	dw	 3476	; 221: 26.520 Hz
	dw	 3530	; 222: 26.932 Hz
	dw	 3586	; 223: 27.359 Hz
	dw	 3642	; 224: 27.786 Hz
	dw	 3699	; 225: 28.221 Hz
	dw	 3757	; 226: 28.664 Hz
	dw	 3816	; 227: 29.114 Hz
	dw	 3875	; 228: 29.564 Hz
	dw	 3936	; 229: 30.029 Hz
	dw	 3997	; 230: 30.495 Hz
	dw	 4060	; 231: 30.975 Hz
	dw	 4123	; 232: 31.456 Hz
	dw	 4187	; 233: 31.944 Hz
	dw	 4253	; 234: 32.448 Hz
	dw	 4319	; 235: 32.951 Hz
	dw	 4386	; 236: 33.463 Hz
	dw	 4454	; 237: 33.981 Hz
	dw	 4524	; 238: 34.515 Hz
	dw	 4594	; 239: 35.049 Hz
	dw	 4665	; 240: 35.591 Hz
	dw	 4738	; 241: 36.148 Hz
	dw	 4812	; 242: 36.713 Hz
	dw	 4886	; 243: 37.277 Hz
	dw	 4962	; 244: 37.857 Hz
	dw	 5039	; 245: 38.445 Hz
	dw	 5117	; 246: 39.040 Hz
	dw	 5197	; 247: 39.650 Hz
	dw	 5277	; 248: 40.260 Hz
	dw	 5359	; 249: 40.886 Hz
	dw	 5442	; 250: 41.519 Hz
	dw	 5526	; 251: 42.160 Hz
	dw	 5611	; 252: 42.809 Hz
	dw	 5698	; 253: 43.472 Hz
	dw	 5786	; 254: 44.144 Hz
	dw	 5876	; 255: 44.830 Hz



	;; alternative table for MIDI clock (32 entries selected with rate/8)
	;; Table taken from Waldorf Blofeld - Thank You guys, I like your synths!!! :-)
SID_LFO_TABLE_MCLK
	dw	      0,  0                ;  0: LFO disabled
	dw	256*4*6, 65536 / (256*4*6) ;  1: 16 bars
	dw	224*4*6, 65536 / (224*4*6) ;  2: 14 bars
	dw	192*4*6, 65536 / (192*4*6) ;  3: 12 bars
	dw	160*4*6, 65536 / (160*4*6) ;  4: 10 bars
	dw	136*4*6, 65536 / (136*4*6) ;  5: 9 bars
	dw	128*4*6, 65536 / (128*4*6) ;  6: 8 bars
	dw	112*4*6, 65536 / (112*4*6) ;  7: 7 bars
	dw	 96*4*6, 65536 / ( 96*4*6) ;  8: 6 bars
	dw	 80*4*6, 65536 / ( 80*4*6) ;  9: 5 bars
	dw	 64*4*6, 65536 / ( 64*4*6) ; 10: 4 bars
	dw	 56*4*6, 65536 / ( 56*4*6) ; 11: 3.5 bars
	dw	 48*4*6, 65536 / ( 48*4*6) ; 12: 3 bars
	dw	 40*4*6, 65536 / ( 40*4*6) ; 13: 2.5 bars
	dw	 32*4*6, 65536 / ( 32*4*6) ; 14: 2 bars
	dw	 24*4*6, 65536 / ( 24*4*6) ; 15: 1.5 bars
	dw	 16*4*6, 65536 / ( 16*4*6) ; 16: 1 bar
	dw	  8*4*9, 65536 / (  8*4*9) ; 17: 1/2.
	dw	 16*4*4, 65536 / ( 16*4*4) ; 18: 1/1T
	dw	  8*4*6, 65536 / (  8*4*6) ; 19: 1/2
	dw	  4*4*9, 65536 / (  4*4*9) ; 20: 1/4.
	dw	  8*4*4, 65536 / (  8*4*4) ; 21: 1/2T
	dw	  4*4*6, 65536 / (  4*4*6) ; 22: 1/4
	dw	  2*4*9, 65536 / (  2*4*9) ; 23: 1/8.
	dw	  4*4*4, 65536 / (  4*4*4) ; 24: 1/4T
	dw	  2*4*6, 65536 / (  2*4*6) ; 25: 1/8
	dw	  1*4*9, 65536 / (  1*4*9) ; 26: 1/16.
	dw	  2*4*4, 65536 / (  2*4*4) ; 27: 1/8T
	dw	  1*4*6, 65536 / (  1*4*6) ; 28: 1/16
	dw	  1*2*9, 65536 / (  1*2*9) ; 29: 1/32.
	dw	  1*4*4, 65536 / (  1*4*4) ; 30: 1/16T
	dw	  1*2*6, 65536 / (  1*2*6) ; 31: 1/32
