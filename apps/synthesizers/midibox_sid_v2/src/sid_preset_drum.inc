; $Id$
;
; MIDIbox SID
; Drum Patch Preset
; (included from sid_patch.inc for runtime re-initialisation)
;
; ==========================================================================
;
;  Copyright 1998-2007 Thorsten Klose (tk@midibox.org)
;  Licensed for personal non-commercial use only.
;  All other rights reserved.
; 
; ==========================================================================

	db      'D','r','u','m',' ','K','i','t',' ',' ',' ',' ',' ',' ',' ',' '

	;;      ENGINE  HWFLAGS  OPT1  OPT2  Swtch -     -     -
	db	0x02,   0x00,    0x01, 0x00, 0x00, 0x00, 0x00, 0x00

	;;      PAR1  PAR2  INIT  MIN   MAX     PAR1  PAR2  INIT  MIN   MAX
	db	0x00, 0x00, 0x80, 0x00, 0xff,   0x00, 0x00, 0x80, 0x00, 0xff	; Knob1/2
	db	0x00, 0x00, 0x80, 0x00, 0xff,   0x00, 0x00, 0x80, 0x00, 0xff	; Knob3/4
	db	0x00, 0x00, 0x80, 0x00, 0xff,   0x00, 0x00, 0x80, 0x00, 0xff	; Knob5/Vel
	db	0x00, 0x00, 0x80, 0x00, 0xff,   0x00, 0x00, 0x80, 0x00, 0xff	; PB/Aftertouch

	;;	EXT Parameters 1-8 - 16 bit values (low/high), normaly used as AOUT offset
	db	0x00, 0x80	; AOUT#1
	db	0x00, 0x80	; AOUT#2
	db	0x00, 0x80	; AOUT#3
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	db	0x00, 0x80	; AOUT#8

	;;	SEQ Speed Num VOL  SEQLen
	db	0x03,  0x08, 0x7f, 0x0f

	;;	C/M    CutOff      Res.  -     -
	db	0x10,  0x00, 0x02, 0x00, 0x00, 0x00	; Filter1
	db	0x10,  0x00, 0x02, 0x00, 0x00, 0x00	; Filter2

	;;	Flgs  Model  AD    SR   Tune  PAR1  PAR2  PAR3  VelA  res.
	db	0x00, 0x00, 0x09, 0xc9, 0x80, 0x80, 0x80, 0x80, 0x00, 0x00	; Instrument #1
	db	0x00, 0x01, 0x09, 0xc9, 0x80, 0x80, 0x80, 0x80, 0x00, 0x00	; Instrument #2
	db	0x00, 0x02, 0x09, 0xc9, 0x80, 0x80, 0x80, 0x80, 0x00, 0x00	; Instrument #3
	db	0x00, 0x03, 0x09, 0xc9, 0xff, 0x80, 0x80, 0x80, 0x00, 0x00	; Instrument #4
	db	0x00, 0x04, 0x09, 0xc9, 0x80, 0x80, 0x80, 0x80, 0x00, 0x00	; Instrument #5
	db	0x00, 0x05, 0x09, 0xc9, 0x80, 0x80, 0x80, 0x80, 0x00, 0x00	; Instrument #6
	db	0x00, 0x06, 0x09, 0xc9, 0x80, 0x80, 0x80, 0x80, 0x00, 0x00	; Instrument #7
	db	0x00, 0x07, 0x09, 0xc9, 0x80, 0x80, 0x80, 0x80, 0x00, 0x00	; Instrument #8
	db	0x00, 0x08, 0x09, 0xc9, 0x80, 0x80, 0x80, 0x80, 0x00, 0x00	; Instrument #9
	db	0x00, 0x09, 0x09, 0xc9, 0x80, 0x80, 0x80, 0x80, 0x00, 0x00	; Instrument #10
	db	0x00, 0x0a, 0x09, 0xc9, 0x80, 0x80, 0x80, 0x80, 0x00, 0x00	; Instrument #11
	db	0x00, 0x0b, 0x09, 0xc9, 0x80, 0x80, 0x80, 0x80, 0x00, 0x00	; Instrument #12
	db	0x00, 0x0c, 0x09, 0xc9, 0x80, 0x80, 0x80, 0x80, 0x00, 0x00	; Instrument #13
	db	0x00, 0x0d, 0x09, 0xc9, 0x80, 0x80, 0x80, 0x80, 0x00, 0x00	; Instrument #14
	db	0x00, 0x0e, 0x09, 0xc9, 0x80, 0x80, 0x80, 0x80, 0x00, 0x00	; Instrument #15
	db	0x00, 0x0f, 0x09, 0xc9, 0x80, 0x80, 0x80, 0x80, 0x00, 0x00	; Instrument #16


	;; Sequencer tracks
	;;      Trk1                  Trk2                  Trk3                  Trk4
	;;      gate acc.  gate acc.  gate acc.  gate acc.  gate acc.  gate acc.  gate acc.  gate acc.
	db	0x11,0x00, 0x11,0x00, 0x00,0x00, 0x00,0x00, 0x00,0x00, 0x00,0x00, 0x00,0x00, 0x00,0x00	; SEQ#1, Trk1-4
	;;      Trk5                  Trk6                  Trk7                  Trk8
	db	0x00,0x00, 0x00,0x00, 0x00,0x00, 0x00,0x00, 0x00,0x00, 0x00,0x00, 0x00,0x00, 0x00,0x00	; SEQ#1, Trk5-8

	db	0x11,0x00, 0x11,0x00, 0x00,0x00, 0x00,0x00, 0x00,0x00, 0x00,0x00, 0x00,0x00, 0x00,0x00	; SEQ#2, Trk1-4
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	db	0x00,0x00, 0x00,0x00, 0x00,0x00, 0x00,0x00, 0x00,0x00, 0x00,0x00, 0x00,0x00, 0x00,0x00	; SEQ#8, Trk5-8
