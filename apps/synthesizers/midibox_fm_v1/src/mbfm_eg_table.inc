; $Id$
;
; MIDIbox FM
; Envelope Table
; generated with env_delay.pl - calculates sweep from 800 uS to 30s
;
; ==========================================================================
;
;  Copyright 1998-2006 Thorsten Klose (tk@midibox.org)
;  Licensed for personal non-commercial use only.
;  All other rights reserved.
; 
; ==========================================================================

;; --------------------------------------------------------------------------
;; In: index (0x00-0x7f) in WREG
;; Out: low byte in WREG and MIOS_PARAMETER1, high byte in MIOS_PARAMETER2
;; --------------------------------------------------------------------------
MBFM_EG_TABLE_Get
	clrc
	rlf	WREG, W
	addlw	MBFM_EG_TABLE & 0xff
	movwf	TBLPTRL
	clrf	TBLPTRH
	movlw	MBFM_EG_TABLE >> 8
	addwfc	TBLPTRH, F

	tblrd*+
	movff	TABLAT, MIOS_PARAMETER1
	tblrd*+
	movff	TABLAT, MIOS_PARAMETER2
	movf	MIOS_PARAMETER1, W
	return

;   x |  Time/s | ADD_H | ADD_L 
; ----+---------+-------+-------
;   1 |  0.0020 |   255 |   255
;   2 |  0.0022 |   231 |   172
;   3 |  0.0028 |   180 |    66
;   4 |  0.0039 |   131 |   143
;   5 |  0.0054 |    95 |   107
;   6 |  0.0073 |    70 |   124
;   7 |  0.0096 |    53 |   101
;   8 |  0.0123 |    41 |   123
;   9 |  0.0155 |    32 |   247
;  10 |  0.0192 |    26 |   186
;  11 |  0.0232 |    22 |    12
;  12 |  0.0277 |    18 |   117
;  13 |  0.0327 |    15 |   168
;  14 |  0.0381 |    13 |   109
;  15 |  0.0440 |    11 |   161
;  16 |  0.0504 |    10 |    41
;  17 |  0.0572 |     8 |   242
;  18 |  0.0646 |     7 |   237
;  19 |  0.0724 |     7 |    18
;  20 |  0.0808 |     6 |    87
;  21 |  0.0896 |     5 |   182
;  22 |  0.0990 |     5 |    43
;  23 |  0.1090 |     4 |   178
;  24 |  0.1195 |     4 |    72
;  25 |  0.1306 |     3 |   235
;  26 |  0.1423 |     3 |   153
;  27 |  0.1545 |     3 |    80
;  28 |  0.1674 |     3 |    14
;  29 |  0.1810 |     2 |   212
;  30 |  0.1952 |     2 |   159
;  31 |  0.2100 |     2 |   112
;  32 |  0.2256 |     2 |    68
;  33 |  0.2419 |     2 |    29
;  34 |  0.2590 |     1 |   250
;  35 |  0.2768 |     1 |   217
;  36 |  0.2954 |     1 |   187
;  37 |  0.3148 |     1 |   160
;  38 |  0.3351 |     1 |   135
;  39 |  0.3562 |     1 |   111
;  40 |  0.3783 |     1 |    90
;  41 |  0.4013 |     1 |    70
;  42 |  0.4253 |     1 |    52
;  43 |  0.4504 |     1 |    35
;  44 |  0.4765 |     1 |    19
;  45 |  0.5036 |     1 |     4
;  46 |  0.5320 |     0 |   246
;  47 |  0.5615 |     0 |   233
;  48 |  0.5922 |     0 |   221
;  49 |  0.6243 |     0 |   209
;  50 |  0.6577 |     0 |   199
;  51 |  0.6925 |     0 |   189
;  52 |  0.7287 |     0 |   179
;  53 |  0.7665 |     0 |   171
;  54 |  0.8058 |     0 |   162
;  55 |  0.8468 |     0 |   154
;  56 |  0.8895 |     0 |   147
;  57 |  0.9340 |     0 |   140
;  58 |  0.9804 |     0 |   133
;  59 |  1.0288 |     0 |   127
;  60 |  1.0792 |     0 |   121
;  61 |  1.1317 |     0 |   115
;  62 |  1.1866 |     0 |   110
;  63 |  1.2437 |     0 |   105
;  64 |  1.3033 |     0 |   100
;  65 |  1.3655 |     0 |    95
;  66 |  1.4304 |     0 |    91
;  67 |  1.4982 |     0 |    87
;  68 |  1.5689 |     0 |    83
;  69 |  1.6427 |     0 |    79
;  70 |  1.7198 |     0 |    76
;  71 |  1.8003 |     0 |    72
;  72 |  1.8844 |     0 |    69
;  73 |  1.9722 |     0 |    66
;  74 |  2.0641 |     0 |    63
;  75 |  2.1601 |     0 |    60
;  76 |  2.2604 |     0 |    57
;  77 |  2.3654 |     0 |    55
;  78 |  2.4752 |     0 |    52
;  79 |  2.5902 |     0 |    50
;  80 |  2.7104 |     0 |    48
;  81 |  2.8364 |     0 |    46
;  82 |  2.9682 |     0 |    44
;  83 |  3.1063 |     0 |    42
;  84 |  3.2510 |     0 |    40
;  85 |  3.4027 |     0 |    38
;  86 |  3.5617 |     0 |    36
;  87 |  3.7284 |     0 |    35
;  88 |  3.9032 |     0 |    33
;  89 |  4.0867 |     0 |    32
;  90 |  4.2793 |     0 |    30
;  91 |  4.4814 |     0 |    29
;  92 |  4.6937 |     0 |    27
;  93 |  4.9167 |     0 |    26
;  94 |  5.1510 |     0 |    25
;  95 |  5.3973 |     0 |    24
;  96 |  5.6562 |     0 |    23
;  97 |  5.9285 |     0 |    22
;  98 |  6.2150 |     0 |    21
;  99 |  6.5165 |     0 |    20
; 100 |  6.8339 |     0 |    19
; 101 |  7.1682 |     0 |    18
; 102 |  7.5202 |     0 |    17
; 103 |  7.8912 |     0 |    16
; 104 |  8.2823 |     0 |    15
; 105 |  8.6946 |     0 |    15
; 106 |  9.1295 |     0 |    14
; 107 |  9.5883 |     0 |    13
; 108 | 10.0726 |     0 |    13
; 109 | 10.5839 |     0 |    12
; 110 | 11.1239 |     0 |    11
; 111 | 11.6944 |     0 |    11
; 112 | 12.2973 |     0 |    10
; 113 | 12.9347 |     0 |    10
; 114 | 13.6088 |     0 |     9
; 115 | 14.3220 |     0 |     9
; 116 | 15.0768 |     0 |     8
; 117 | 15.8758 |     0 |     8
; 118 | 16.7219 |     0 |     7
; 119 | 17.6183 |     0 |     7
; 120 | 18.5683 |     0 |     7
; 121 | 19.5754 |     0 |     6
; 122 | 20.6434 |     0 |     6
; 123 | 21.7765 |     0 |     6
; 124 | 22.9789 |     0 |     5
; 125 | 24.2554 |     0 |     5
; 126 | 25.6110 |     0 |     5
; 127 | 27.0512 |     0 |     4

MBFM_EG_TABLE
	db	0xff, 0xff	; delay=0.0020
	db	0xff, 0xff	; delay=0.0020
	db	0xac, 0xe7	; delay=0.0022
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	db	0x04, 0x00	; delay=27.0512
