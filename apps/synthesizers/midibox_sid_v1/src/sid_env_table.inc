; $Id$
;
; MIDIbox SID
; Envelope Table
; generated with env_delay.pl - calculates sweep from 800 uS to 30s
;
; ==========================================================================
;
;  Copyright 1998-2006 Thorsten Klose (tk@midibox.org)
;  Licensed for personal non-commercial use only.
;  All other rights reserved.
; 
; ==========================================================================

;; --------------------------------------------------------------------------
;; In: index (0x00-0x7f) in WREG
;; Out: low byte in WREG and MIOS_PARAMETER1, high byte in MIOS_PARAMETER2
;; --------------------------------------------------------------------------
SID_ENV_TABLE_Get
	clrc
	rlf	WREG, W
	addlw	SID_ENV_TABLE & 0xff
	movwf	TBLPTRL
	clrf	TBLPTRH
	movlw	SID_ENV_TABLE >> 8
	addwfc	TBLPTRH, F

	tblrd*+
	movff	TABLAT, MIOS_PARAMETER1
	tblrd*+
	movff	TABLAT, MIOS_PARAMETER2
	movf	MIOS_PARAMETER1, W
	return

;   x |  Time/s | ADD_H | ADD_L 
; ----+---------+-------+-------
;   1 |  0.0008 |   256 |     0
;   2 |  0.0010 |   202 |   196
;   3 |  0.0016 |   124 |   217
;   4 |  0.0027 |    76 |    21
;   5 |  0.0042 |    49 |    41
;   6 |  0.0061 |    33 |   198
;   7 |  0.0084 |    24 |   105
;   8 |  0.0111 |    18 |    97
;   9 |  0.0143 |    14 |    74
;  10 |  0.0180 |    11 |   103
;  11 |  0.0220 |     9 |    76
;  12 |  0.0265 |     7 |   183
;  13 |  0.0315 |     6 |   128
;  14 |  0.0369 |     5 |   139
;  15 |  0.0428 |     4 |   200
;  16 |  0.0492 |     4 |    41
;  17 |  0.0560 |     3 |   167
;  18 |  0.0634 |     3 |    59
;  19 |  0.0712 |     2 |   224
;  20 |  0.0796 |     2 |   147
;  21 |  0.0884 |     2 |    80
;  22 |  0.0978 |     2 |    23
;  23 |  0.1078 |     1 |   230
;  24 |  0.1183 |     1 |   187
;  25 |  0.1294 |     1 |   149
;  26 |  0.1411 |     1 |   115
;  27 |  0.1533 |     1 |    85
;  28 |  0.1662 |     1 |    59
;  29 |  0.1798 |     1 |    35
;  30 |  0.1940 |     1 |    14
;  31 |  0.2088 |     0 |   251
;  32 |  0.2244 |     0 |   233
;  33 |  0.2407 |     0 |   217
;  34 |  0.2578 |     0 |   203
;  35 |  0.2756 |     0 |   190
;  36 |  0.2942 |     0 |   178
;  37 |  0.3136 |     0 |   167
;  38 |  0.3339 |     0 |   157
;  39 |  0.3550 |     0 |   147
;  40 |  0.3771 |     0 |   139
;  41 |  0.4001 |     0 |   131
;  42 |  0.4241 |     0 |   123
;  43 |  0.4492 |     0 |   116
;  44 |  0.4753 |     0 |   110
;  45 |  0.5024 |     0 |   104
;  46 |  0.5308 |     0 |    98
;  47 |  0.5603 |     0 |    93
;  48 |  0.5910 |     0 |    88
;  49 |  0.6231 |     0 |    84
;  50 |  0.6565 |     0 |    79
;  51 |  0.6913 |     0 |    75
;  52 |  0.7275 |     0 |    72
;  53 |  0.7653 |     0 |    68
;  54 |  0.8046 |     0 |    65
;  55 |  0.8456 |     0 |    62
;  56 |  0.8883 |     0 |    59
;  57 |  0.9328 |     0 |    56
;  58 |  0.9792 |     0 |    53
;  59 |  1.0276 |     0 |    51
;  60 |  1.0780 |     0 |    48
;  61 |  1.1305 |     0 |    46
;  62 |  1.1854 |     0 |    44
;  63 |  1.2425 |     0 |    42
;  64 |  1.3021 |     0 |    40
;  65 |  1.3643 |     0 |    38
;  66 |  1.4292 |     0 |    36
;  67 |  1.4970 |     0 |    35
;  68 |  1.5677 |     0 |    33
;  69 |  1.6415 |     0 |    31
;  70 |  1.7186 |     0 |    30
;  71 |  1.7991 |     0 |    29
;  72 |  1.8832 |     0 |    27
;  73 |  1.9710 |     0 |    26
;  74 |  2.0629 |     0 |    25
;  75 |  2.1589 |     0 |    24
;  76 |  2.2592 |     0 |    23
;  77 |  2.3642 |     0 |    22
;  78 |  2.4740 |     0 |    21
;  79 |  2.5890 |     0 |    20
;  80 |  2.7092 |     0 |    19
;  81 |  2.8352 |     0 |    18
;  82 |  2.9670 |     0 |    17
;  83 |  3.1051 |     0 |    16
;  84 |  3.2498 |     0 |    16
;  85 |  3.4015 |     0 |    15
;  86 |  3.5605 |     0 |    14
;  87 |  3.7272 |     0 |    14
;  88 |  3.9020 |     0 |    13
;  89 |  4.0855 |     0 |    12
;  90 |  4.2781 |     0 |    12
;  91 |  4.4802 |     0 |    11
;  92 |  4.6925 |     0 |    11
;  93 |  4.9155 |     0 |    10
;  94 |  5.1498 |     0 |    10
;  95 |  5.3961 |     0 |     9
;  96 |  5.6550 |     0 |     9
;  97 |  5.9273 |     0 |     8
;  98 |  6.2138 |     0 |     8
;  99 |  6.5153 |     0 |     8
; 100 |  6.8327 |     0 |     7
; 101 |  7.1670 |     0 |     7
; 102 |  7.5190 |     0 |     6
; 103 |  7.8900 |     0 |     6
; 104 |  8.2811 |     0 |     6
; 105 |  8.6934 |     0 |     6
; 106 |  9.1283 |     0 |     5
; 107 |  9.5871 |     0 |     5
; 108 | 10.0714 |     0 |     5
; 109 | 10.5827 |     0 |     4
; 110 | 11.1227 |     0 |     4
; 111 | 11.6932 |     0 |     4
; 112 | 12.2961 |     0 |     4
; 113 | 12.9335 |     0 |     4
; 114 | 13.6076 |     0 |     3
; 115 | 14.3208 |     0 |     3
; 116 | 15.0756 |     0 |     3
; 117 | 15.8746 |     0 |     3
; 118 | 16.7207 |     0 |     3
; 119 | 17.6171 |     0 |     2
; 120 | 18.5671 |     0 |     2
; 121 | 19.5742 |     0 |     2
; 122 | 20.6422 |     0 |     2
; 123 | 21.7753 |     0 |     2
; 124 | 22.9777 |     0 |     2
; 125 | 24.2542 |     0 |     2
; 126 | 25.6098 |     0 |     2
; 127 | 27.0500 |     0 |     1

SID_ENV_TABLE
	db	0xff, 0xff	; delay=0.0008
	db	0xff, 0xff	; delay=0.0008
	db	0xc4, 0xca	; delay=0.0010
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	db	0x01, 0x00	; dummy
