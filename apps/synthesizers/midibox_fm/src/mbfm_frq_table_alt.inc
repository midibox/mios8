; $Id$
;
; MIDIbox FM
; Alternative Frequency Table (generated by utils/frqtab.pl)
; Less accurate form (block bitfield is unchanged) - used for modulations
;
; ==========================================================================
;
;  Copyright 1998-2006 Thorsten Klose (tk@midibox.org)
;  Licensed for personal non-commercial use only.
;  All other rights reserved.
; 
; ==========================================================================


MBFM_FRQ_TABLE_ALT
	db	0x40, 0x01	;      8.176 Hz (0x0140  C--2)
	db	0x40, 0x01	;      8.662 Hz (0x0140  C#-2)
	db	0x80, 0x01	;      9.177 Hz (0x0180  D--2)
	db	0x80, 0x01	;      9.723 Hz (0x0180  D#-2)
	db	0x80, 0x01	;     10.301 Hz (0x0180  E--2)
	db	0xc0, 0x01	;     10.913 Hz (0x01c0  F--2)
	db	0xc0, 0x01	;     11.562 Hz (0x01c0  F#-2)
	db	0x00, 0x02	;     12.250 Hz (0x0200  G--2)
	db	0x00, 0x02	;     12.978 Hz (0x0200  G#-2)
	db	0x40, 0x02	;     13.750 Hz (0x0240  A--2)
	db	0x40, 0x02	;     14.568 Hz (0x0240  A#-2)
	db	0x80, 0x02	;     15.434 Hz (0x0280  H--2)
	db	0x80, 0x02	;     16.352 Hz (0x0280  C--1)
	db	0xc0, 0x02	;     17.324 Hz (0x02c0  C#-1)
	db	0x00, 0x03	;     18.354 Hz (0x0300  D--1)
	db	0x00, 0x03	;     19.445 Hz (0x0300  D#-1)
	db	0x40, 0x03	;     20.602 Hz (0x0340  E--1)
	db	0x80, 0x03	;     21.827 Hz (0x0380  F--1)
	db	0xc0, 0x03	;     23.125 Hz (0x03c0  F#-1)
	db	0x00, 0x04	;     24.500 Hz (0x0400  G--1)
	db	0x40, 0x04	;     25.957 Hz (0x0440  G#-1)
	db	0x80, 0x04	;     27.500 Hz (0x0480  A--1)
	db	0xc0, 0x04	;     29.135 Hz (0x04c0  A#-1)
	db	0x00, 0x05	;     30.868 Hz (0x0500  H--1)
	db	0x40, 0x05	;     32.703 Hz (0x0540  C-0)
	db	0x80, 0x05	;     34.648 Hz (0x0580  C#0)
	db	0x00, 0x06	;     36.708 Hz (0x0600  D-0)
	db	0x40, 0x06	;     38.891 Hz (0x0640  D#0)
	db	0xc0, 0x06	;     41.203 Hz (0x06c0  E-0)
	db	0x00, 0x07	;     43.654 Hz (0x0700  F-0)
	db	0x80, 0x07	;     46.249 Hz (0x0780  F#0)
	db	0x00, 0x08	;     48.999 Hz (0x0800  G-0)
	db	0x80, 0x08	;     51.913 Hz (0x0880  G#0)
	db	0x00, 0x09	;     55.000 Hz (0x0900  A-0)
	db	0x80, 0x09	;     58.270 Hz (0x0980  A#0)
	db	0x00, 0x0a	;     61.735 Hz (0x0a00  H-0)
	db	0xc0, 0x0a	;     65.406 Hz (0x0ac0  C-1)
	db	0x40, 0x0b	;     69.296 Hz (0x0b40  C#1)
	db	0x00, 0x0c	;     73.416 Hz (0x0c00  D-1)
	db	0xc0, 0x0c	;     77.782 Hz (0x0cc0  D#1)
	db	0x80, 0x0d	;     82.407 Hz (0x0d80  E-1)
	db	0x40, 0x0e	;     87.307 Hz (0x0e40  F-1)
	db	0x00, 0x0f	;     92.499 Hz (0x0f00  F#1)
	db	0x00, 0x10	;     97.999 Hz (0x1000  G-1)
	db	0x00, 0x11	;    103.826 Hz (0x1100  G#1)
	db	0x00, 0x12	;    110.000 Hz (0x1200  A-1)
	db	0x00, 0x13	;    116.541 Hz (0x1300  A#1)
	db	0x40, 0x14	;    123.471 Hz (0x1440  H-1)
	db	0x80, 0x15	;    130.813 Hz (0x1580  C-2)
	db	0xc0, 0x16	;    138.591 Hz (0x16c0  C#2)
	db	0x00, 0x18	;    146.832 Hz (0x1800  D-2)
	db	0x80, 0x19	;    155.564 Hz (0x1980  D#2)
	db	0x00, 0x1b	;    164.814 Hz (0x1b00  E-2)
	db	0xc0, 0x1c	;    174.614 Hz (0x1cc0  F-2)
	db	0x40, 0x1e	;    184.997 Hz (0x1e40  F#2)
	db	0x40, 0x20	;    195.998 Hz (0x2040  G-2)
	db	0x00, 0x22	;    207.652 Hz (0x2200  G#2)
	db	0x40, 0x24	;    220.000 Hz (0x2440  A-2)
	db	0x40, 0x26	;    233.082 Hz (0x2640  A#2)
	db	0x80, 0x28	;    246.942 Hz (0x2880  H-2)
	db	0x00, 0x2b	;    261.626 Hz (0x2b00  C-3)
	db	0x80, 0x2d	;    277.183 Hz (0x2d80  C#3)
	db	0x40, 0x30	;    293.665 Hz (0x3040  D-3)
	db	0x40, 0x33	;    311.127 Hz (0x3340  D#3)
	db	0x40, 0x36	;    329.628 Hz (0x3640  E-3)
	db	0x80, 0x39	;    349.228 Hz (0x3980  F-3)
	db	0xc0, 0x3c	;    369.995 Hz (0x3cc0  F#3)
	db	0x80, 0x40	;    391.996 Hz (0x4080  G-3)
	db	0x40, 0x44	;    415.305 Hz (0x4440  G#3)
	db	0x80, 0x48	;    440.000 Hz (0x4880  A-3)
	db	0xc0, 0x4c	;    466.164 Hz (0x4cc0  A#3)
	db	0x40, 0x51	;    493.883 Hz (0x5140  H-3)
	db	0x00, 0x56	;    523.252 Hz (0x5600  C-4)
	db	0x40, 0x5b	;    554.366 Hz (0x5b40  C#4)
	db	0xc0, 0x60	;    587.330 Hz (0x60c0  D-4)
	db	0x80, 0x66	;    622.254 Hz (0x6680  D#4)
	db	0x80, 0x6c	;    659.255 Hz (0x6c80  E-4)
	db	0x00, 0x73	;    698.457 Hz (0x7300  F-4)
	db	0xc0, 0x79	;    739.989 Hz (0x79c0  F#4)
	db	0x00, 0x81	;    783.991 Hz (0x8100  G-4)
	db	0xc0, 0x88	;    830.609 Hz (0x88c0  G#4)
	db	0x00, 0x91	;    880.000 Hz (0x9100  A-4)
	db	0x80, 0x99	;    932.327 Hz (0x9980  A#4)
	db	0xc0, 0xa2	;    987.766 Hz (0xa2c0  H-4)
	db	0x40, 0xac	;   1046.503 Hz (0xac40  C-5)
	db	0x80, 0xb6	;   1108.731 Hz (0xb680  C#5)
	db	0x80, 0xc1	;   1174.660 Hz (0xc180  D-5)
	db	0x00, 0xcd	;   1244.509 Hz (0xcd00  D#5)
	db	0x40, 0xd9	;   1318.511 Hz (0xd940  E-5)
	db	0x00, 0xe6	;   1396.913 Hz (0xe600  F-5)
	db	0xc0, 0xf3	;   1479.978 Hz (0xf3c0  F#5)
	db	0xc0, 0xff	;   1567.982 Hz (0xffc0  G-5)
	db	0xc0, 0xff	;   1661.219 Hz (0xffc0  G#5)
	db	0xc0, 0xff	;   1760.000 Hz (0xffc0  A-5)
	db	0xc0, 0xff	;   1864.655 Hz (0xffc0  A#5)
	db	0xc0, 0xff	;   1975.533 Hz (0xffc0  H-5)
	db	0xc0, 0xff	;   2093.006 Hz (0xffc0  C-6)
	db	0xc0, 0xff	;   2217.463 Hz (0xffc0  C#6)
	db	0xc0, 0xff	;   2349.320 Hz (0xffc0  D-6)
	db	0xc0, 0xff	;   2489.017 Hz (0xffc0  D#6)
	db	0xc0, 0xff	;   2637.022 Hz (0xffc0  E-6)
	db	0xc0, 0xff	;   2793.827 Hz (0xffc0  F-6)
	db	0xc0, 0xff	;   2959.956 Hz (0xffc0  F#6)
	db	0xc0, 0xff	;   3135.964 Hz (0xffc0  G-6)
	db	0xc0, 0xff	;   3322.438 Hz (0xffc0  G#6)
	db	0xc0, 0xff	;   3520.000 Hz (0xffc0  A-6)
	db	0xc0, 0xff	;   3729.310 Hz (0xffc0  A#6)
	db	0xc0, 0xff	;   3951.066 Hz (0xffc0  H-6)
	db	0xc0, 0xff	;   4186.012 Hz (0xffc0  C-7)
	db	0xc0, 0xff	;   4434.925 Hz (0xffc0  C#7)
	db	0xc0, 0xff	;   4698.639 Hz (0xffc0  D-7)
	db	0xc0, 0xff	;   4978.034 Hz (0xffc0  D#7)
	db	0xc0, 0xff	;   5274.043 Hz (0xffc0  E-7)
	db	0xc0, 0xff	;   5587.654 Hz (0xffc0  F-7)
	db	0xc0, 0xff	;   5919.912 Hz (0xffc0  F#7)
	db	0xc0, 0xff	;   6271.928 Hz (0xffc0  G-7)
	db	0xc0, 0xff	;   6644.876 Hz (0xffc0  G#7)
	db	0xc0, 0xff	;   7040.000 Hz (0xffc0  A-7)
	db	0xc0, 0xff	;   7458.620 Hz (0xffc0  A#7)
	db	0xc0, 0xff	;   7902.131 Hz (0xffc0  H-7)
	db	0xc0, 0xff	;   8372.025 Hz (0xffc0  C-8)
	db	0xc0, 0xff	;   8869.851 Hz (0xffc0  C#8)
	db	0xc0, 0xff	;   9397.278 Hz (0xffc0  D-8)
	db	0xc0, 0xff	;   9956.069 Hz (0xffc0  D#8)
	db	0xc0, 0xff	;  10548.087 Hz (0xffc0  E-8)
	db	0xc0, 0xff	;  11175.307 Hz (0xffc0  F-8)
	db	0xc0, 0xff	;  11839.825 Hz (0xffc0  F#8)
	;; 	db	0xc0, 0xff	;  12543.856 Hz (0xffc0  G-8)
