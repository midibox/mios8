; $Id$
;
; MIDIbox FM
; Sinus Table
; generated with sidtab.pl
;
; ==========================================================================
;
;  Copyright 1998-2006 Thorsten Klose (tk@midibox.org)
;  Licensed for personal non-commercial use only.
;  All other rights reserved.
; 
; ==========================================================================

;; --------------------------------------------------------------------------
;; In: index (0x00-0xff) in WREG
;; Out: Sin value in WREG and MIOS_PARAMETER1
;; --------------------------------------------------------------------------
MBFM_SIN_TABLE_Get
	;; note: the table has only 128 entries, the upper entries are just
	;; inverted, so we can save some memory
	movwf	MIOS_PARAMETER1
	btfss	MIOS_PARAMETER1, 7
	xorlw	0x7f
	andlw	0x7f

	addlw	MBFM_SIN_TABLE & 0xff
	movwf	TBLPTRL
	clrf	TBLPTRH
	movlw	MBFM_SIN_TABLE >> 8
	addwfc	TBLPTRH, F

	tblrd*+
	movf	TABLAT, W
	btfsc	MIOS_PARAMETER1, 7
	iorlw 0x80
	movwf	MIOS_PARAMETER1
	return

; ==========================================================================

MBFM_SIN_TABLE
	db	0x00, 0x01
	db	0x03, 0x04
	db	0x06, 0x07
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	db	0x7f, 0x7f
