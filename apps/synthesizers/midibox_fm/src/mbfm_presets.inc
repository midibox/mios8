; $Id$
;
; MIDIbox CV
; Presets (EEPROM content)
;
; ==========================================================================
;
;  Copyright 1998-2006 Thorsten Klose (tk@midibox.org)
;  Licensed for personal non-commercial use only.
;  All other rights reserved.
; 
; ==========================================================================


        ERRORLEVEL      -220    ; suppress "Address exceeds maximum range for this processor."
	;; this is (unfortunately) required for gpasm

	org	0xf00000	; eeprom base address for internal patch
MBFM_PRESET_PATCH
	db	"Rhodes Piano    "
	db	0x16,0x01,0x0b,0x81,0x57,0x08,0x2b,0x08,0xff,0xf3,0xe5,0xe2,0x8a,0x66,0xb5,0x86
	db	0x00,0x00,0x00,0x00,0x1c,0x11,0x02,0x00,0x00,0x40,0x02,0x00,0x00,0x00,0x40,0x00
	db	0x40,0x40,0x00,0x40,0x40,0x00,0x00,0x00,0x00,0x05,0x00,0x50,0x40,0x40,0x40,0x40
	db	0x40,0x40,0x40,0x05,0x00,0x70,0x40,0x40,0x40,0x40,0x40,0x40,0x40,0x00,0x20,0x60
	db	0x20,0x20,0x20,0x40,0x20,0x40,0x40,0x40,0x40,0x40,0x40,0x40,0x40,0x00,0x00,0x00

	org	0xf00080	; eeprom base address for internal drumset
MBFM_PRESET_DRUMSET
	db	0x00, 0x00, 0x00, 0x00, 0x04, 0x00, 0x0f, 0x17
	db	0x00, 0x00, 0x00, 0x00, 0x00, 0x00, 0xfa, 0xf5
	db	0xf0, 0xf0, 0xf0, 0xf4, 0xf0, 0xb8, 0x77, 0x05
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	db	0x00, 0x00, 0x00, 0x00, 0x00, 0x00, 0x00, 0x00

	org	0xf000c0	; eeprom base address for internal ensemble
MBFM_PRESET_ENSEMBLE
	db	0x00, 0x04, 0x00, 0x00, 0x7f, 0x00, 0x7f, 0x40
	db	0x00, 0x0f, 0x0f, 0x00, 0x00, 0x00, 0x00, 0x00
	db	0x00, 0x24, 0x01, 0x00, 0x7f, 0x00, 0x7f, 0x40
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	db	0x00, 0x0f, 0x0f, 0x00, 0x00, 0x00, 0x00, 0x00
