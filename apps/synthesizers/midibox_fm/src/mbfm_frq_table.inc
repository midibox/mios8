; $Id$
;
; MIDIbox FM
; Frequency Table (generated by utils/frqtab.pl)
; Most accurate form (block bitfield is used)
;
; ==========================================================================
;
;  Copyright 1998-2006 Thorsten Klose (tk@midibox.org)
;  Licensed for personal non-commercial use only.
;  All other rights reserved.
; 
; ==========================================================================


MBFM_FRQ_TABLE
	db	0x0a, 0x10	;      8.176 Hz (4:00a  C--2)
	db	0x0b, 0x10	;      8.662 Hz (4:00b  C#-2)
	db	0x0c, 0x10	;      9.177 Hz (4:00c  D--2)
	db	0x0c, 0x10	;      9.723 Hz (4:00c  D#-2)
	db	0x0d, 0x10	;     10.301 Hz (4:00d  E--2)
	db	0x0e, 0x10	;     10.913 Hz (4:00e  F--2)
	db	0x0f, 0x10	;     11.562 Hz (4:00f  F#-2)
	db	0x10, 0x10	;     12.250 Hz (4:010  G--2)
	db	0x11, 0x10	;     12.978 Hz (4:011  G#-2)
	db	0x12, 0x10	;     13.750 Hz (4:012  A--2)
	db	0x13, 0x10	;     14.568 Hz (4:013  A#-2)
	db	0x14, 0x10	;     15.434 Hz (4:014  H--2)
	db	0x15, 0x10	;     16.352 Hz (4:015  C--1)
	db	0x16, 0x10	;     17.324 Hz (4:016  C#-1)
	db	0x18, 0x10	;     18.354 Hz (4:018  D--1)
	db	0x19, 0x10	;     19.445 Hz (4:019  D#-1)
	db	0x1b, 0x10	;     20.602 Hz (4:01b  E--1)
	db	0x1c, 0x10	;     21.827 Hz (4:01c  F--1)
	db	0x1e, 0x10	;     23.125 Hz (4:01e  F#-1)
	db	0x20, 0x10	;     24.500 Hz (4:020  G--1)
	db	0x22, 0x10	;     25.957 Hz (4:022  G#-1)
	db	0x24, 0x10	;     27.500 Hz (4:024  A--1)
	db	0x26, 0x10	;     29.135 Hz (4:026  A#-1)
	db	0x28, 0x10	;     30.868 Hz (4:028  H--1)
	db	0x2b, 0x10	;     32.703 Hz (4:02b  C-0)
	db	0x2d, 0x10	;     34.648 Hz (4:02d  C#0)
	db	0x30, 0x10	;     36.708 Hz (4:030  D-0)
	db	0x33, 0x10	;     38.891 Hz (4:033  D#0)
	db	0x36, 0x10	;     41.203 Hz (4:036  E-0)
	db	0x39, 0x10	;     43.654 Hz (4:039  F-0)
	db	0x3c, 0x10	;     46.249 Hz (4:03c  F#0)
	db	0x40, 0x10	;     48.999 Hz (4:040  G-0)
	db	0x44, 0x10	;     51.913 Hz (4:044  G#0)
	db	0x48, 0x10	;     55.000 Hz (4:048  A-0)
	db	0x4c, 0x10	;     58.270 Hz (4:04c  A#0)
	db	0x51, 0x10	;     61.735 Hz (4:051  H-0)
	db	0x56, 0x10	;     65.406 Hz (4:056  C-1)
	db	0x5b, 0x10	;     69.296 Hz (4:05b  C#1)
	db	0x60, 0x10	;     73.416 Hz (4:060  D-1)
	db	0x66, 0x10	;     77.782 Hz (4:066  D#1)
	db	0x6c, 0x10	;     82.407 Hz (4:06c  E-1)
	db	0x73, 0x10	;     87.307 Hz (4:073  F-1)
	db	0x79, 0x10	;     92.499 Hz (4:079  F#1)
	db	0x81, 0x10	;     97.999 Hz (4:081  G-1)
	db	0x88, 0x10	;    103.826 Hz (4:088  G#1)
	db	0x91, 0x10	;    110.000 Hz (4:091  A-1)
	db	0x99, 0x10	;    116.541 Hz (4:099  A#1)
	db	0xa2, 0x10	;    123.471 Hz (4:0a2  H-1)
	db	0xac, 0x10	;    130.813 Hz (4:0ac  C-2)
	db	0xb6, 0x10	;    138.591 Hz (4:0b6  C#2)
	db	0xc1, 0x10	;    146.832 Hz (4:0c1  D-2)
	db	0xcd, 0x10	;    155.564 Hz (4:0cd  D#2)
	db	0xd9, 0x10	;    164.814 Hz (4:0d9  E-2)
	db	0xe6, 0x10	;    174.614 Hz (4:0e6  F-2)
	db	0xf3, 0x10	;    184.997 Hz (4:0f3  F#2)
	db	0x02, 0x11	;    195.998 Hz (4:102  G-2)
	db	0x11, 0x11	;    207.652 Hz (4:111  G#2)
	db	0x22, 0x11	;    220.000 Hz (4:122  A-2)
	db	0x33, 0x11	;    233.082 Hz (4:133  A#2)
	db	0x45, 0x11	;    246.942 Hz (4:145  H-2)
	db	0x58, 0x11	;    261.626 Hz (4:158  C-3)
	db	0x6d, 0x11	;    277.183 Hz (4:16d  C#3)
	db	0x83, 0x11	;    293.665 Hz (4:183  D-3)
	db	0x9a, 0x11	;    311.127 Hz (4:19a  D#3)
	db	0xb2, 0x11	;    329.628 Hz (4:1b2  E-3)
	db	0xcc, 0x11	;    349.228 Hz (4:1cc  F-3)
	db	0xe7, 0x11	;    369.995 Hz (4:1e7  F#3)
	db	0x04, 0x12	;    391.996 Hz (4:204  G-3)
	db	0x23, 0x12	;    415.305 Hz (4:223  G#3)
	db	0x44, 0x12	;    440.000 Hz (4:244  A-3)
	db	0x66, 0x12	;    466.164 Hz (4:266  A#3)
	db	0x8b, 0x12	;    493.883 Hz (4:28b  H-3)
	db	0xb1, 0x12	;    523.252 Hz (4:2b1  C-4)
	db	0xda, 0x12	;    554.366 Hz (4:2da  C#4)
	db	0x06, 0x13	;    587.330 Hz (4:306  D-4)
	db	0x34, 0x13	;    622.254 Hz (4:334  D#4)
	db	0x65, 0x13	;    659.255 Hz (4:365  E-4)
	db	0x98, 0x13	;    698.457 Hz (4:398  F-4)
	db	0xcf, 0x13	;    739.989 Hz (4:3cf  F#4)
	db	0x04, 0x16	;    783.991 Hz (5:204  G-4)
	db	0x23, 0x16	;    830.609 Hz (5:223  G#4)
	db	0x44, 0x16	;    880.000 Hz (5:244  A-4)
	db	0x66, 0x16	;    932.327 Hz (5:266  A#4)
	db	0x8b, 0x16	;    987.766 Hz (5:28b  H-4)
	db	0xb1, 0x16	;   1046.503 Hz (5:2b1  C-5)
	db	0xda, 0x16	;   1108.731 Hz (5:2da  C#5)
	db	0x06, 0x17	;   1174.660 Hz (5:306  D-5)
	db	0x34, 0x17	;   1244.509 Hz (5:334  D#5)
	db	0x65, 0x17	;   1318.511 Hz (5:365  E-5)
	db	0x98, 0x17	;   1396.913 Hz (5:398  F-5)
	db	0xcf, 0x17	;   1479.978 Hz (5:3cf  F#5)
	db	0x04, 0x1a	;   1567.982 Hz (6:204  G-5)
	db	0x23, 0x1a	;   1661.219 Hz (6:223  G#5)
	db	0x44, 0x1a	;   1760.000 Hz (6:244  A-5)
	db	0x66, 0x1a	;   1864.655 Hz (6:266  A#5)
	db	0x8b, 0x1a	;   1975.533 Hz (6:28b  H-5)
	db	0xb1, 0x1a	;   2093.006 Hz (6:2b1  C-6)
	db	0xda, 0x1a	;   2217.463 Hz (6:2da  C#6)
	db	0x06, 0x1b	;   2349.320 Hz (6:306  D-6)
	db	0x34, 0x1b	;   2489.017 Hz (6:334  D#6)
	db	0x65, 0x1b	;   2637.022 Hz (6:365  E-6)
	db	0x98, 0x1b	;   2793.827 Hz (6:398  F-6)
	db	0xcf, 0x1b	;   2959.956 Hz (6:3cf  F#6)
	db	0x04, 0x1e	;   3135.964 Hz (7:204  G-6)
	db	0x23, 0x1e	;   3322.438 Hz (7:223  G#6)
	db	0x44, 0x1e	;   3520.000 Hz (7:244  A-6)
	db	0x66, 0x1e	;   3729.310 Hz (7:266  A#6)
	db	0x8b, 0x1e	;   3951.066 Hz (7:28b  H-6)
	db	0xb1, 0x1e	;   4186.012 Hz (7:2b1  C-7)
	db	0xda, 0x1e	;   4434.925 Hz (7:2da  C#7)
	db	0x06, 0x1f	;   4698.639 Hz (7:306  D-7)
	db	0x34, 0x1f	;   4978.034 Hz (7:334  D#7)
	db	0x65, 0x1f	;   5274.043 Hz (7:365  E-7)
	db	0x98, 0x1f	;   5587.654 Hz (7:398  F-7)
	db	0xcf, 0x1f	;   5919.912 Hz (7:3cf  F#7)
	db	0xff, 0x1f	;   6271.928 Hz (7:3ff  G-7)
	db	0xff, 0x1f	;   6644.876 Hz (7:3ff  G#7)
	db	0xff, 0x1f	;   7040.000 Hz (7:3ff  A-7)
	db	0xff, 0x1f	;   7458.620 Hz (7:3ff  A#7)
	db	0xff, 0x1f	;   7902.131 Hz (7:3ff  H-7)
	db	0xff, 0x1f	;   8372.025 Hz (7:3ff  C-8)
	db	0xff, 0x1f	;   8869.851 Hz (7:3ff  C#8)
	db	0xff, 0x1f	;   9397.278 Hz (7:3ff  D-8)
	db	0xff, 0x1f	;   9956.069 Hz (7:3ff  D#8)
	db	0xff, 0x1f	;  10548.087 Hz (7:3ff  E-8)
	db	0xff, 0x1f	;  11175.307 Hz (7:3ff  F-8)
	db	0xff, 0x1f	;  11839.825 Hz (7:3ff  F#8)
	db	0xff, 0x1f	;  12543.856 Hz (7:3ff  G-8)
