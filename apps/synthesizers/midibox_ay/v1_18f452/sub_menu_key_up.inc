;; sub_menu_key_up.inc

;; ----------------------------------------------------------------------------
;; -------------------------[SUB MENU ROUTINE FOR UP]--------------------- 
;; =======================> UP @ keyb_decoding.inc HAS BEEN PRESSED

LABEL_AY_SUB_MENU_UP

LABEL_AY_SUB_MENU_UP_CHK_MAINMENU
	;; 1) CHECK WHICH MAIN MENU IS ACTIVATED
	;; ==> VIA CURRENT_MAIN_MENU
	;;
	;; 2) GOTO THE NEEDED SUB ROUTINE OF THE ACTIVATED
	;;    MAIN MENU
	

	movf CURRENT_MAIN_MENU, W
	JUMPTABLE_2BYTES 9 ;; [MENU 0 - 8]
		rgoto        SUB_MENU_UP_MAIN_MENU0
		rgoto        SUB_MENU_UP_MAIN_MENU1
		rgoto        SUB_MENU_UP_MAIN_MENU2
		rgoto        SUB_MENU_UP_MAIN_MENU3
		rgoto        SUB_MENU_UP_MAIN_MENU4
		rgoto        SUB_MENU_UP_MAIN_MENU5
		rgoto        SUB_MENU_UP_MAIN_MENU6
		rgoto        SUB_MENU_UP_MAIN_MENU7
		rgoto        SUB_MENU_UP_MAIN_MENU8
      		

;; -------[END OF: CHECK WHICH MAIN MENU IS ACTIVATED]---
;; ----------------------------------------------------------------


;; --------[UP @ MAIN MENU0]------------------

SUB_MENU_UP_MAIN_MENU0
	;; UP @ MENU SWITCH MENU - NO Function
	
		return


;; --------[UP @ MAIN MENU1]------------------
;; -------------------------------------------
SUB_MENU_UP_MAIN_MENU1
	;; MAIN MENU1 = PATCH INFO MENU
	;; UPIS NEEDED HERE TO:
	;; DECREMENT EDITING MODE POSITION => "*"
	;; IN PATCH INFO MENU
	;; VIA:
	;; AY_LCD_COURSER_POS_MAIN_MENU_PATCH_INFO 
	;; = AY_LCD_COURSER_POS_MAIN_MENU_PATCH_INFO -1
	
	
	;; DEC AY_LCD_COURSER_POS_MAIN_MENU_PATCH_INFO
	movff 	AY_LCD_COURSER_POS_MAIN_MENU_PATCH_INFO, MIOS_PARAMETER1
	decf 	MIOS_PARAMETER1, F
	movff 	MIOS_PARAMETER1, AY_LCD_COURSER_POS_MAIN_MENU_PATCH_INFO
	
	;; CHECK:
	;; ITEM POS IS NOT ALLOWED TO BE = 0
	;; IS AY_LCD_COURSER_POS_MAIN_MENU_PATCH_INFO = 0?
	movlw	MENU_ITEM_POS0_NOT_VALID
	cpfseq 	MIOS_PARAMETER1 ;; POS = 0?

				;; NO  (NOT POS 0)
				rgoto LABEL_AY_SUB_MENU_UP_MAIN_MENU1_DONE

		;; YES, OK
		;; POS 0 (NOT VALID) WILL BE SWITCHED TO POS 3
		;; -------------------------------------------		
		;; AY_LCD_COURSER_POS_MAIN_MENU_PATCH_INFO = 0 (NOT VALID) SO 
		;; AY_LCD_COURSER_POS_MAIN_MENU_PATCH_INFO MUST BE SWITCHED TO 4 (LAST POS)
		movlw	MENU_ITEM_POS3
		movwf	MIOS_PARAMETER1
		movff 	MIOS_PARAMETER1, AY_LCD_COURSER_POS_MAIN_MENU_PATCH_INFO
			
LABEL_AY_SUB_MENU_UP_MAIN_MENU1_DONE
				;; SUB ROUTINE IS DONE - EXIT HERE
				;; JUMP TO MAIN MENU	
				goto LABEL_AY_MAIN_MENU_01_PATCH_INFO

;; ----- --------------------------[END: UP @ MAIN MENU1]------------------	
				

;; ------------------------------[START: UP @ MAIN MENU2]------------------
SUB_MENU_UP_MAIN_MENU2
	;; MAIN MENU2 = TUNE MENU

	;; UP IS NEEDED HERE TO:
	;; DECREMENT EDITING MODE POSITION => "*"
		
	;; DEC EDITING MODE POS "*" in MAIN MENU2
	;; MOV EDITING MODE POS "*" TO MIOS_PARAMETER1
	movff 	AY_LCD_COURSER_POS_MAIN_MENU_ABC_TUNE, MIOS_PARAMETER1
	decf 	MIOS_PARAMETER1, F
	movff 	MIOS_PARAMETER1, AY_LCD_COURSER_POS_MAIN_MENU_ABC_TUNE
	
	;; CHECK:
	;; EDITING MODE POS "*" in MAIN MENU2 - POS OF "*" IS NOT ALLOWED TO BE = 0
	;; EDITING MODE POS "*" in MAIN MENU2 = 0?
	movlw	MENU_ITEM_POS0_NOT_VALID
	cpfseq 	MIOS_PARAMETER1 ;; POS = 0?

				;; NO (NOT POS 0)
				rgoto LABEL_AY_SUB_MENU_UP_MAIN_MENU2_DONE

		;; YES
		;; SO SET POS LAST POS
		;; -----------------------
		;; EDITING MODE POS "*" = 0
		;; EDITING MODE POS "*" MUST BE SWITCHED TO 6
		movlw	MENU_ITEM_POS6
		movwf	MIOS_PARAMETER1
		movff 	MIOS_PARAMETER1, AY_LCD_COURSER_POS_MAIN_MENU_ABC_TUNE
			
LABEL_AY_SUB_MENU_UP_MAIN_MENU2_DONE
				;; SWITCH MAIN MENU TO: TUNE MENU
				goto LABEL_MAIN_MENUE_SWITCH

;; ----------------------------[END: UP @ MAIN MENU2]------------------


;; ----------------------------[START: UP @ MAIN MENU3]-----------
;; ---------------------------------------------------------------
SUB_MENU_UP_MAIN_MENU3
	;; MAIN MENU3 = MIXER MENU

	;; UP IS NEEDED HERE TO:
	;; DECREMENT EDITING MODE POSITION => "*"
		
	;; DEC EDITING MODE POS "*" in MAIN MENU3
	;; MOV EDITING MODE POS "*" TO MIOS_PARAMETER1
	movff 	AY_LCD_COURSER_POS_MAIN_MENU_ABC_NOISE, MIOS_PARAMETER1
	decf 	MIOS_PARAMETER1, F
	movff 	MIOS_PARAMETER1, AY_LCD_COURSER_POS_MAIN_MENU_ABC_NOISE
	
	;; CHECK:
	;; EDITING MODE POS "*" in MAIN MENU3 - POS OF "*" IS NOT ALLOWED TO BE = 0
	;; EDITING MODE POS "*" in MAIN MENU3 = 0?
	movlw	MENU_ITEM_POS0_NOT_VALID
	cpfseq 	MIOS_PARAMETER1 ;; POS = 0?

			;; NO (NOT POS 0)
			rgoto LABEL_AY_SUB_MENU_UP_MAIN_MENU3_DONE

		;; YES
		;; POS = 0
		;; WE MUST SWITCH BACK TO LAST ITEM POS

		;; EDITING MODE POS "*" = 0
		;; EDITING MODE POS "*" MUST BE SWITCHED TO 4 (LAST POS)
		movlw	MENU_ITEM_POS4
		movwf	MIOS_PARAMETER1
		movff 	MIOS_PARAMETER1, AY_LCD_COURSER_POS_MAIN_MENU_ABC_NOISE
			
LABEL_AY_SUB_MENU_UP_MAIN_MENU3_DONE
			;; SUB ROUTINE IS DONE		
			goto LABEL_MAIN_MENUE_SWITCH

;; ----------------------------[END: UP @ MAIN MENU3]-----------
	

;; ----------------------------[UP @ MAIN MENU4]------------------
SUB_MENU_UP_MAIN_MENU4
	;; MAIN MENU4 = AMPLITUDE/VOLUME MENU
	;; --------------------------------------
	;; UP IS NEEDED HERE TO:
	;; DECREMENT EDITING MODE POSITION => "*"
	;; --------------------------------------
	;; DEC EDITING MODE POS "*" in MAIN MENU4
	;; MOV EDITING MODE POS "*" TO MIOS_PARAMETER1
	movff 	AY_LCD_COURSER_POS_MAIN_MENU_AMPLITUDE, MIOS_PARAMETER1
	decf 	MIOS_PARAMETER1, F
	movff 	MIOS_PARAMETER1, AY_LCD_COURSER_POS_MAIN_MENU_AMPLITUDE
	
	;; CHECK:
	;; EDITING MODE POS "*" in MAIN MENU4 - POS OF "*" IS NOT ALLOWED TO BE = 0
	;; EDITING MODE POS "*" in MAIN MENU4 = 0?
	movlw	MENU_ITEM_POS0_NOT_VALID
	cpfseq 	MIOS_PARAMETER1 ;; POS = 0?

				;; NO (NOT POS 0)
				rgoto LABEL_AY_SUB_MENU_UP_MAIN_MENU4_DONE

		;; YES
		;; EDITING MODE POS "*" = 0
		;; EDITING MODE POS "*" MUST BE SWITCHED TO 3 (LAST POS)
		movlw	MENU_ITEM_POS3
		movwf	MIOS_PARAMETER1
		movff 	MIOS_PARAMETER1, AY_LCD_COURSER_POS_MAIN_MENU_AMPLITUDE
			
LABEL_AY_SUB_MENU_UP_MAIN_MENU4_DONE
				;; SUB ROUTINE IS DONE		
				goto LABEL_MAIN_MENUE_SWITCH


;; --------[UP @ MAIN MENU5]------------------
SUB_MENU_UP_MAIN_MENU5
	;; MAIN MENU5 = ENVELOPE MENU
	;; --------------------------
	;; UP IS NEEDED HERE TO:
	;; DECREMENT EDITING MODE POSITION => "*"
	;; --------------------------------------
	;; DEC EDITING MODE POS "*" in MAIN MENU5
	;; MOV EDITING MODE POS "*" TO MIOS_PARAMETER1
	movff 	AY_LCD_COURSER_POS_MAIN_MENU_ENVELOPE, MIOS_PARAMETER1
	decf 	MIOS_PARAMETER1, F
	movff 	MIOS_PARAMETER1, AY_LCD_COURSER_POS_MAIN_MENU_ENVELOPE
	
	;; CHECK:
	;; EDITING MODE POS "*" in MAIN MENU5 - POS OF "*" IS NOT ALLOWED TO BE = 0
	;; EDITING MODE POS "*" in MAIN MENU5 = 0?
	movlw	MENU_ITEM_POS0_NOT_VALID
	cpfseq 	MIOS_PARAMETER1 ;; POS = 0?

				;; NO (NOT POS 0)
				rgoto LABEL_AY_SUB_MENU_UP_MAIN_MENU5_DONE

		;; YES
		;; EDITING MODE POS "*" = 0
		;; EDITING MODE POS "*" MUST BE SWITCHED TO 4 (LAST POS)
		movlw	MENU_ITEM_POS4
		movwf	MIOS_PARAMETER1
		movff 	MIOS_PARAMETER1, AY_LCD_COURSER_POS_MAIN_MENU_ENVELOPE
			
LABEL_AY_SUB_MENU_UP_MAIN_MENU5_DONE
				;; SUB ROUTINE IS DONE		
				goto LABEL_MAIN_MENUE_SWITCH


;; -----------------[UP @ MAIN MENU 6]---------------------------------------------	
SUB_MENU_UP_MAIN_MENU6
	;; MAIN MENU6 = TONE ABC MIDI-CHANNEL CONTROL
	;; ------------------------------------------	
	;; UP IS NEEDED HERE TO:
	;; DECREMENT EDITING MODE POSITION => "*"
	;; ------------------------------------------
	;; DEC EDITING MODE POS "*" in MAIN MENU6
	;; MOV EDITING MODE POS "*" TO MIOS_PARAMETER1
	movff 	AY_LCD_COURSER_POS_MAIN_MENU_MIDI_CONFIG, MIOS_PARAMETER1
	decf 	MIOS_PARAMETER1, F
	movff 	MIOS_PARAMETER1, AY_LCD_COURSER_POS_MAIN_MENU_MIDI_CONFIG   

	;; CHECK:
	;; EDITING MODE POS "*" in MAIN MENU6 - POS. OF "*" IS NOT ALLOWED TO BE = 0
	;; EDITING MODE POS "*" in MAIN MENU6 = 0?
	movlw	MENU_ITEM_POS0_NOT_VALID
	cpfseq 	MIOS_PARAMETER1 ;; POS = 0?

				;; NO (NOT POS 0)
				rgoto LABEL_AY_SUB_MENU_UP_MAIN_MENU6_DONE

		;; YES (POS 0)
		;; EDITING MODE POS "*" = 0
		;; EDITING MODE POS "*" MUST BE SWITCHED TO 3 (LAST POS)
		movlw	MENU_ITEM_POS3
		movwf	MIOS_PARAMETER1
		movff 	MIOS_PARAMETER1, AY_LCD_COURSER_POS_MAIN_MENU_MIDI_CONFIG
	
LABEL_AY_SUB_MENU_UP_MAIN_MENU6_DONE
			;; SUBROUTINE IS DONE 
			goto LABEL_MAIN_MENUE_SWITCH

;; --------

SUB_MENU_UP_MAIN_MENU7
	;; KEYBORAD: KEY HANDLING
	;; IF KEY [UP] IS = DEPRESSED THEN DO NOT DEC POS OF
	;; EDITING MODE "*"	

	;; POS=POS-1 - DEC POS @ MAIN MENU 7 
	;; VELOCITY TO => ABC + NOISE PERIOD
	movff 	AY_LCD_COURSER_POS_MAIN_MENU_VELOCITY_CONFIG, MIOS_PARAMETER1
	decf 	MIOS_PARAMETER1, F
	movff 	MIOS_PARAMETER1, AY_LCD_COURSER_POS_MAIN_MENU_VELOCITY_CONFIG
	
	;; CHECK:
	;; POS IS NOT ALLOWED TO BE = 0
	;; IS POS = 0?
	movlw	MENU_ITEM_POS0_NOT_VALID
	cpfseq 	MIOS_PARAMETER1 ;; POS = 0?

				;; NO (NOT POS 0)
				rgoto LABEL_AY_SUB_MENU_UP_MAIN_MENU7_DONE
		;; YES
		;; POS = 0 SO 
		;; POS MUST BE SWITCHED TO 4 (LAST POS)
		movlw	MENU_ITEM_POS4
		movwf	MIOS_PARAMETER1
		movff 	MIOS_PARAMETER1, AY_LCD_COURSER_POS_MAIN_MENU_VELOCITY_CONFIG

LABEL_AY_SUB_MENU_UP_MAIN_MENU7_DONE
				;; SUB ROUTINE IS DONE EXIT HERE TO MAIN MENU		
				goto LABEL_MAIN_MENUE_SWITCH



;; -----------------------------------
SUB_MENU_UP_MAIN_MENU8
	;; UP IS NEEDED HERE TO:
	;; DECREMENT EDITING MODE POSITION => "*"
		
	;; DEC EDITING MODE POS "*" in MAIN MENU8
	;; MOV EDITING MODE POS "*" TO MIOS_PARAMETER1
	movff 	AY_LCD_COURSER_POS_MAIN_MENU_FX, MIOS_PARAMETER1
	decf 	MIOS_PARAMETER1, F
	movff 	MIOS_PARAMETER1, AY_LCD_COURSER_POS_MAIN_MENU_FX
	
	;; CHECK:
	;; EDITING MODE POS "*" in MAIN MENU8 - POS OF "*" IS NOT ALLOWED TO BE = 0
	;; EDITING MODE POS "*" in MAIN MENU8 = 0?
	movlw	MENU_ITEM_POS0_NOT_VALID
	cpfseq 	MIOS_PARAMETER1 ;; POS = 0?
				;; NO (NOT POS 0)
				rgoto LABEL_AY_SUB_MENU_UP_MAIN_MENU8_DONE

		;; YES
		;; EDITING MODE POS "*" = 0
		;; EDITING MODE POS "*" MUST BE SWITCHED TO 4 (LAST POS)
		movlw	MENU_ITEM_POS4
		movwf	MIOS_PARAMETER1
		movff 	MIOS_PARAMETER1, AY_LCD_COURSER_POS_MAIN_MENU_FX
;; --------
LABEL_AY_SUB_MENU_UP_MAIN_MENU8_DONE
				;; SUB ROUTINE IS DONE		
				goto LABEL_MAIN_MENUE_SWITCH

	



;; -------------------------[END - SUB MENU ROUTINE FOR *UP* [KEY]]---------- 
	
