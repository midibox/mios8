;; main_menu_04_amplitude.inc


;; FUNCTION:
;; WRITE TONE ABC VOLUME (AMPLITUDE) MAIN MENU TO THE LCD
;; CHECK IF ENVELOPE MODE IS ON - IF YES THAN PRINT [ENV.ON] (priority 1)
;; CHECK IF VELOCITY TO VOLUME IS ON - IF YES THAN PRINT [VELOCITY] (priority 2)
;; CHECK THE AMPLITUDE/VOLUME - PRINT THE VALUE (0-15) ON LCD (priority 3)

;; ----------------------------------------------------------------------------
;; -------------------------[MB AY MENU 4: TONE ABC VOLUME/AMPLITUDE]----------------------------- 
;; ========================= F4 = MAIN MENU 4 SHORTCUT


LABEL_AY_MAIN_MENU_04_ABC_AMPLITUDE

;; ------[AMPLITUDE CH A]-------

LABEL_AY_MENU_AMPLITUDE_CH_A
	call    MIOS_LCD_Clear
   
        ;; PRINT MENUE HEADLINE (LCD ROW1)
        TABLE_ADDR TEXT_AY_MENU_AMPLITUDE_HEADLINE
        call    MIOS_LCD_PrintString


	;; AMPLITUDE CH A
        TABLE_ADDR TEXT_AY_MENU_AMPLITUDE_CH_A
        call    MIOS_LCD_PrintString

	movlw   LCD_ROW2 + 13
	call    MIOS_LCD_CursorSet

	movf    AY_R8_CH_A_AMPLITUDE,W
	call        MIOS_LCD_PrintBCD3

LABEL_AY_MENU_AMPLITUDE_CH_A_CHECK_VELOCITY
	;; CHECK if VELOCITY @ TONE A is ON or OFF
	;; BIT0 CLEAR? 
	btfsc AY_VELOCITY_TO_ABC_NOISE_PERIOD_ON_OFF, BIT0_VELOCITY_ON_OFF_TONE_A
		;; NO - BIT0 = SET => VELOCITY TO VOLUME
		rgoto  LABEL_AY_MENU_AMPLITUDE_CH_A_CHECK_VELOCITY_ON
		;; YES - BIT0 = CLEAR => VELOCITY IS *NOT* VOLUME
		rgoto  LABEL_AY_MENU_AMPLITUDE_CH_A_CHECK_VELOCITY_OFF


LABEL_AY_MENU_AMPLITUDE_CH_A_CHECK_VELOCITY_ON
		TABLE_ADDR TEXT_AY_MENU_AMPLITUDE_CH_A_VELOC
		call    MIOS_LCD_PrintString
		      rgoto LABEL_AY_MENU_AMPLITUDE_CHK_AMPLITUDE_MODE_CH_A

LABEL_AY_MENU_AMPLITUDE_CH_A_CHECK_VELOCITY_OFF
		rgoto LABEL_AY_MENU_AMPLITUDE_CHK_AMPLITUDE_MODE_CH_A


LABEL_AY_MENU_AMPLITUDE_CHK_AMPLITUDE_MODE_CH_A
	;; IS ENVELOPE MODE (BIT4) ON OR OFF?
        btfsc AY_R8_CH_A_AMPLITUDE, BIT4_ENVELOPE_ON_OFF
	      rgoto LABEL_AY_MENU_AMPLITUDE_MODE_CH_A_SET
	      rgoto LABEL_AY_MENU_AMPLITUDE_CH_B

;; ------[AMPLITUDE CH B]-------

        
LABEL_AY_MENU_AMPLITUDE_CH_B
        ;; AMPLITUDE CH B
        TABLE_ADDR TEXT_AY_MENU_AMPLITUDE_CH_B
        call    MIOS_LCD_PrintString
        
        movlw   LCD_ROW3 + 13
        call    MIOS_LCD_CursorSet

	movf    AY_R9_CH_B_AMPLITUDE,W
	      call   MIOS_LCD_PrintBCD3


LABEL_AY_MENU_AMPLITUDE_CH_B_CHECK_VELOCITY
	;; BIT1 CLEAR? 
	btfsc AY_VELOCITY_TO_ABC_NOISE_PERIOD_ON_OFF, BIT1_VELOCITY_ON_OFF_TONE_B
		;; NO - BIT1 = SET => VELOCITY TO VOLUME
		rgoto  LABEL_AY_MENU_AMPLITUDE_CH_B_CHECK_VELOCITY_ON
		;; YES - BIT1 = CLEAR => VELOCITY IS *NOT* VOLUME
		rgoto  LABEL_AY_MENU_AMPLITUDE_CH_B_CHECK_VELOCITY_OFF


LABEL_AY_MENU_AMPLITUDE_CH_B_CHECK_VELOCITY_ON
		TABLE_ADDR TEXT_AY_MENU_AMPLITUDE_CH_B_VELOC
		call    MIOS_LCD_PrintString
		      	rgoto LABEL_AY_MENU_AMPLITUDE_CHK_AMPLITUDE_MODE_CH_B

LABEL_AY_MENU_AMPLITUDE_CH_B_CHECK_VELOCITY_OFF
			rgoto LABEL_AY_MENU_AMPLITUDE_CHK_AMPLITUDE_MODE_CH_B



LABEL_AY_MENU_AMPLITUDE_CHK_AMPLITUDE_MODE_CH_B
	;; IS ENVELOPE MODE (BIT4) ON OR OFF?
        btfsc AY_R9_CH_B_AMPLITUDE, BIT4_ENVELOPE_ON_OFF
	      		rgoto LABEL_AY_MENU_AMPLITUDE_MODE_CH_B_SET
	      		rgoto LABEL_AY_MENU_AMPLITUDE_CH_C

;; ------[AMPLITUDE CH C]-------
        
LABEL_AY_MENU_AMPLITUDE_CH_C     
        ;; AMPLITUDE CH C
        TABLE_ADDR TEXT_AY_MENU_AMPLITUDE_CH_C
        call    MIOS_LCD_PrintString
        
        movlw   LCD_ROW4 + 13
        call    MIOS_LCD_CursorSet

	movf    AY_R10_CH_C_AMPLITUDE,W
	      call        MIOS_LCD_PrintBCD3


LABEL_AY_MENU_AMPLITUDE_CH_C_CHECK_VELOCITY
	;; IS VELOCITY TONE C ON or OFF
	;; BIT2 CLEAR? 
	btfsc AY_VELOCITY_TO_ABC_NOISE_PERIOD_ON_OFF, BIT2_VELOCITY_ON_OFF_TONE_C
		;; NO - BIT2 = SET => VELOCITY TO VOLUME
		rgoto  LABEL_AY_MENU_AMPLITUDE_CH_C_CHECK_VELOCITY_ON
		;; YES - BIT2 = CLEAR => VELOCITY IS *NOT* VOLUME
		rgoto  LABEL_AY_MENU_AMPLITUDE_CH_C_CHECK_VELOCITY_OFF

LABEL_AY_MENU_AMPLITUDE_CH_C_CHECK_VELOCITY_ON
		TABLE_ADDR TEXT_AY_MENU_AMPLITUDE_CH_C_VELOC
		call    MIOS_LCD_PrintString
		      	rgoto LABEL_AY_MENU_AMPLITUDE_CHK_AMPLITUDE_MODE_CH_C

LABEL_AY_MENU_AMPLITUDE_CH_C_CHECK_VELOCITY_OFF
			rgoto LABEL_AY_MENU_AMPLITUDE_CHK_AMPLITUDE_MODE_CH_C

	
LABEL_AY_MENU_AMPLITUDE_CHK_AMPLITUDE_MODE_CH_C
	;; IS ENVELOPE MODE @ TONE C (BIT4) ON OR OFF?
        btfsc AY_R10_CH_C_AMPLITUDE, BIT4_ENVELOPE_ON_OFF
        		;; ENVELOPE MODE ON
			rgoto LABEL_AY_MENU_AMPLITUDE_MODE_CH_C_SET
			;; ENVELOPE MODE OFF
			rgoto LABEL_AY_MAIN_MENU_04_FIND_EDIT_POS1 ;; GO ON WITH POSITION of *


;; ------------------------
;; MAIN MENU 4: AMPLITUDE ABC EDITING MODE...
;; Show the POSITION of * [LCD: MAIN MENU EDIT POINTER] for Main Menu EDITING Posiotion
LABEL_AY_MAIN_MENU_04_FIND_EDIT_POS1

	;; EDITING MODE @ AMPLITUDE A?
	;; IS AY_LCD_COURSER_POS_MAIN_MENU_AMPLITUDE = 1?
	movff AY_LCD_COURSER_POS_MAIN_MENU_AMPLITUDE, MIOS_PARAMETER1
	
	movlw MENU_ITEM_POS1
	cpfseq MIOS_PARAMETER1 ;; COMPARE F WITH WREG	
		;; NO
		rgoto LABEL_AY_MAIN_MENU_04_NOT_POS1
		;; YES
		rgoto LABEL_AY_MAIN_MENU_04_POS1


LABEL_AY_MAIN_MENU_04_POS1
		;; EDITING MODE @ AMPLITUDE A
		;; PRINT "*" ON EDIT POSITION1
		movlw 	LCD_ROW2 + 7
		call    MIOS_LCD_CursorSet
		movlw   '*'
		call    MIOS_LCD_PrintChar
			
			rgoto LABEL_AY_MAIN_MENU_04_FIND_EDIT_POS2


LABEL_AY_MAIN_MENU_04_NOT_POS1
		;; NO EDITING MODE @ AMPLITUDE A 
		;; PRINT ":" ON EDIT POSITION1
		movlw 	LCD_ROW2 + 7
		call    MIOS_LCD_CursorSet
		movlw   ':'
		call    MIOS_LCD_PrintChar
			
        		rgoto LABEL_AY_MAIN_MENU_04_FIND_EDIT_POS2


	
	
LABEL_AY_MAIN_MENU_04_FIND_EDIT_POS2

	;; EDITING MODE @ AMPLITUDE B
	;; IS AY_LCD_COURSER_POS_MAIN_MENU_AMPLITUDE = 2?
	movff AY_LCD_COURSER_POS_MAIN_MENU_AMPLITUDE, MIOS_PARAMETER1
	
	movlw MENU_ITEM_POS2
	cpfseq MIOS_PARAMETER1 ;; COMPARE F WITH WREG
			
		;; NO
		rgoto LABEL_AY_MAIN_MENU_04_NOT_POS2

		;; YES
		rgoto LABEL_AY_MAIN_MENU_04_POS2



LABEL_AY_MAIN_MENU_04_POS2	
		;; EDITING MODE @ AMPLITUDE B
		;; PRINT "*" ON EDIT POSITION2
		movlw 	LCD_ROW3 + 7
		call    MIOS_LCD_CursorSet
		movlw   '*'
		call    MIOS_LCD_PrintChar
			
			rgoto LABEL_AY_MAIN_MENU_04_FIND_EDIT_POS3


LABEL_AY_MAIN_MENU_04_NOT_POS2
		;; NO EDITING MODE @ AMPLITUDE B
		;; PRINT ":" ON EDIT POSITION2
		movlw 	LCD_ROW3 + 7
		call    MIOS_LCD_CursorSet
		movlw   ':'
		call    MIOS_LCD_PrintChar
        	
        		rgoto LABEL_AY_MAIN_MENU_04_FIND_EDIT_POS3



LABEL_AY_MAIN_MENU_04_FIND_EDIT_POS3
	;; EDITING MODE @ AMPLITUDE C?
	;; IS AY_LCD_COURSER_POS_MAIN_MENU_AMPLITUDE = 3?
	movff AY_LCD_COURSER_POS_MAIN_MENU_AMPLITUDE, MIOS_PARAMETER1
	
	movlw MENU_ITEM_POS3
	cpfseq MIOS_PARAMETER1 ;; COMPARE F WITH WREG
		;; NO
		rgoto LABEL_AY_MAIN_MENU_04_NOT_POS3
		;; YES
		rgoto LABEL_AY_MAIN_MENU_04_POS3

LABEL_AY_MAIN_MENU_04_POS3
		;; EDITING MODE @ AMPLITUDE C
		;; PRINT "*" ON EDIT POSITION3
		movlw 	LCD_ROW4 + 7
		call    MIOS_LCD_CursorSet
		movlw   '*'
		call    MIOS_LCD_PrintChar
		
			rgoto LABEL_AY_MENU_AMPLITUDE_END


LABEL_AY_MAIN_MENU_04_NOT_POS3
		;; NO EDITING MODE @ AMPLITUDE C
		;; PRINT ":" ON EDIT POSITION2
		movlw 	LCD_ROW4 + 7
		call    MIOS_LCD_CursorSet
		movlw   ':'
		call    MIOS_LCD_PrintChar
			
        		rgoto LABEL_AY_MENU_AMPLITUDE_END

LABEL_AY_MENU_AMPLITUDE_END
	;; Exit here
	return

;; -----------------------------------------------------------------------------


;; SUB ROUTINE:
;; --------------------------------------------------------------------------------------------------	
;; [IF "RELATIVE AMPLITUDE MODE" IS SET SO WRITE AMPLITUDE MODE INFO OVER FIXED AMPLITUE VALUE ON LCD]
;; ---------------------------------------------------------------------------------------------------


;; WRITE TO LCD IF "AMPLITUDE MODE IS SET" - CH A
LABEL_AY_MENU_AMPLITUDE_MODE_CH_A_SET
	TABLE_ADDR TEXT_AY_MENU_AMPLITUDE_CH_A_ENV
        call    MIOS_LCD_PrintString
        	rgoto 	LABEL_AY_MENU_AMPLITUDE_CH_B

;; WRITE TO LCD IF "AMPLITUDE MODE IS SET" - CH B
LABEL_AY_MENU_AMPLITUDE_MODE_CH_B_SET
	TABLE_ADDR TEXT_AY_MENU_AMPLITUDE_CH_B_ENV
        call    MIOS_LCD_PrintString
        	rgoto 	LABEL_AY_MENU_AMPLITUDE_CH_C


;; WRITE TO LCD IF "AMPLITUDE MODE IS SET" - CH C
LABEL_AY_MENU_AMPLITUDE_MODE_CH_C_SET	
	TABLE_ADDR TEXT_AY_MENU_AMPLITUDE_CH_C_ENV
        call    MIOS_LCD_PrintString
        	rgoto 	LABEL_AY_MAIN_MENU_04_FIND_EDIT_POS1 ;; GO ON WITH POSITION of *

;; --------[END SUB ROUTINE]


	
