;; sub_menu_key_minus_menu_5.inc


; --------[MINUS @ MAIN MENU5]------------------
;; jumped in here from 
MINUS_KEY_SUBROUTINE_AT_MAIN_MENU5
	;; MAIN MENU5 = ENVELOPE MENU

	;; 1) CHECK WHICH ITEM (AY REG) IS 
	;; IN EDITING MODE "*"
	;; VIA AY_LCD_COURSER_POS_MAIN_MENU_ENVELOPE
	;;
	;; 2) DEC ITEM 1-4

;; --[ 1) CHECK ITEM]-------

	;; CHECK LOCATION VIA EDITING MODE "*"
	;; COPY THE VALUE OF EDITING MODE TO  MIOS_PARAMETER1
	movff 	AY_LCD_COURSER_POS_MAIN_MENU_ENVELOPE, MIOS_PARAMETER1

LABEL_AY_SUB_MENU_MINUS_MAIN_MENU5_CHK_ITEM1	
	movlw 	MENU_ITEM_POS1
	cpfseq 	MIOS_PARAMETER1 ;; EDITING MODE ITEM  = 1?

		;; NO
		rgoto LABEL_AY_SUB_MENU_MINUS_MAIN_MENU5_CHK_ITEM2

		;; YES
		rgoto LABEL_AY_SUB_MENU_MINUS_MAIN_MENU5_DEC_ITEM1
	

LABEL_AY_SUB_MENU_MINUS_MAIN_MENU5_CHK_ITEM2

	movlw 	MENU_ITEM_POS2
	cpfseq 	MIOS_PARAMETER1 ;; EDITING MODE ITEM  = 2?

		;; NO
		rgoto LABEL_AY_SUB_MENU_MINUS_MAIN_MENU5_CHK_ITEM3

		;; YES
		rgoto LABEL_AY_SUB_MENU_MINUS_MAIN_MENU5_DEC_ITEM2	


LABEL_AY_SUB_MENU_MINUS_MAIN_MENU5_CHK_ITEM3
	
	movlw 	MENU_ITEM_POS3
	cpfseq 	MIOS_PARAMETER1 ;; EDITING MODE ITEM  = 3?

		;; NO? - LAST ITEM FOR + SO QUIT HERE
		goto LABEL_MAIN_MENUE_SWITCH

		;; YES
		rgoto LABEL_AY_SUB_MENU_MINUS_MAIN_MENU5_DEC_ITEM3	



;;---[ 2) DECREASE ITEM 1-3 [@MAIN MENU5]]--------

;;---[ 2) DEC ENV PERIOD COARSE [ITEM1 @ MAIN MENU5]--------
LABEL_AY_SUB_MENU_MINUS_MAIN_MENU5_DEC_ITEM1
	;; DEC ITEM1
	;; ITEM1 => AY_R12_ENV_PERIOD_COARSE
	;; => RANGE 0-255 	DEC.
	;; => RANGE 0x00-0xFF  	HEX

		;; CHEK ITEM VALUE 
		;; ITEM1 = 8BIT = 0x00 to 0xFF
		;; compare f with WREG, skip < 1
		clrw
		cpfseq 	AY_R12_ENV_PERIOD_COARSE
		
			;; NO
			rgoto LABEL_AY_SUB_MENU_MINUS_MAIN_MENU5_DEC_ITEM1_OK

			;; YES
			goto LABEL_MAIN_MENUE_SWITCH


LABEL_AY_SUB_MENU_MINUS_MAIN_MENU5_DEC_ITEM1_OK

	
	;; ITEM = ITEM -1
	decf AY_R12_ENV_PERIOD_COARSE, F
	
	;; PREPARE ITEM DATA FOR TRANSFERE TO AY CHIP VIA ay_sr.inc
	;; --------------------------------------------------------
	;; WRITE AY REG *ADRESS* TO AY_REG_ADDRESS FOR => AY_SR_Write
	movlw AY_CHIP_ADR_12_GLOBAL_ENVELOPE_COARSE
	movwf AY_REG_ADDRESS 		; ADDRESS FOR => AY_SR_Write
	;; WRITE AY REG *DATA* TO AY_REG_DATA FOR => AY_SR_Write
	movff AY_R12_ENV_PERIOD_COARSE, AY_REG_DATA 
	
	;; WRITING 8BIT DATA (AY_REG_ADDRESS, AY_REG_DATA)TO AY REG(X) ROUTINE
	call LABEL_AY_SR_Write

		;; SUB ROUTINE IS DONE		
		;; JUMP TO MAIN MENU (REDRAW LCD MENU5)		
		

		;; SWITCH MAIN MENU TO: MAIN MENU 5
		goto LABEL_MAIN_MENUE_SWITCH



;;---[ 2) DEC ENV PERIOD FINE [ITEM2 @ MAIN MENU5]--------

LABEL_AY_SUB_MENU_MINUS_MAIN_MENU5_DEC_ITEM2
		;; CHEK ITEM VALUE 
		;; ITEM2 = 8BIT = 0xFF = 0-255 DEC
		;; compare f with WREG, skip < 1
		clrw 
		;; IS AY REG < 0x01 ? 
		cpfseq 	AY_R11_ENV_PERIOD_FINE
		
			;; NO
			rgoto LABEL_AY_SUB_MENU_MINUS_MAIN_MENU5_DEC_ITEM2_OK

			;; YES (f = 0) SO SKIP SUB ROUTINE HERE
			goto LABEL_MAIN_MENUE_SWITCH


LABEL_AY_SUB_MENU_MINUS_MAIN_MENU5_DEC_ITEM2_OK
	;; ITEM = ITEM -1
	decf AY_R11_ENV_PERIOD_FINE, F
	
	;; PREPARE ITEM DATA FOR TRANSFERE TO AY CHIP VIA ay_sr.inc
	;; --------------------------------------------------------
	;; WRITE AY REG *ADRESS* TO AY_REG_ADDRESS FOR => AY_SR_Write
	movlw AY_CHIP_ADR_11_GLOBAL_ENVELOPE_FINE
	movwf AY_REG_ADDRESS 		; ADDRESS FOR => AY_SR_Write
	;; WRITE AY REG *DATA* TO AY_REG_DATA FOR => AY_SR_Write
	movff AY_R11_ENV_PERIOD_FINE, AY_REG_DATA 
	
	;; WRITING 8BIT DATA (AY_REG_ADDRESS, AY_REG_DATA)TO AY REG(X) ROUTINE
	;; @ay_sr.inc
	call LABEL_AY_SR_Write

		;; SUB ROUTINE IS DONE		
		;; JUMP TO MAIN MENU (REDRAW LCD MENU5)		
		;; SWITCH MAIN MENU TO: MAIN MENU 5
		goto LABEL_MAIN_MENUE_SWITCH


;;---[ 2) DEC ENV SHAPE [ITEM3 @ MAIN MENU5]--------

LABEL_AY_SUB_MENU_MINUS_MAIN_MENU5_DEC_ITEM3

	;; DEC ITEM ENV SHAPE
	;; 1) DEC ENV_SHAPE_0_15_to_1_8_TRANSLATOR [Range 1 to 8]
	;; 2) POINTER TO AY_R13_ENV_SHAPE_CYCLE [RANGE 0 to 15]

		;; CHEK ITEM VALUE 
		;; ENV_SHAPE_0_15_to_1_8_TRANSLATOR [Range 1 to 8]
		;; compare f with WREG, skip IF < 2
		;; ENV_SHAPE_0_15_to_1_8_TRANSLATOR < 0x02? [=1 or 0]
		;; [THERE IS NO ENVELOPE SHAPE 0 (!)]
		movlw 	0x02
		cpfslt 	ENV_SHAPE_0_15_to_1_8_TRANSLATOR
		
			;; NO
			rgoto LABEL_AY_SUB_MENU_MINUS_MAIN_MENU5_DEC_ITEM3_OK

			;; YES
			goto LABEL_MAIN_MENUE_SWITCH


LABEL_AY_SUB_MENU_MINUS_MAIN_MENU5_DEC_ITEM3_OK
	;; ITEM = ITEM -1
	decf ENV_SHAPE_0_15_to_1_8_TRANSLATOR, F
	
		;; SUB ROUTINE IS DONE		
		;; JUMP TO MAIN MENU (REDRAW LCD MENU5)		
		goto LABEL_MAIN_MENUE_SWITCH

;; --------[END OF KEY [MINUS (-)] FUNCTION @ MENU 5 ]------------------


