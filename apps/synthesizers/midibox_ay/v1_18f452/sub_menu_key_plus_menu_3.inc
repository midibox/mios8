;; sub_menu_key_plus_menu_3.inc


;; ----------------------------------------------
;; --------[PLUS @ MAIN MENU3]------------------

PLUS_KEY_SUBROUTINE_AT_MAIN_MENU3
;; jumped in here from sub_menu_key_plus.inc
	;; MAIN MENU3 = MIXER MENU 
	;; MIX CH ABC + ADD NOISE TO CH ABC
	;; PLUS HAD BEEN PRESSED

	;; 1) CHECK WHICH ITEM (AY REG) IS 
	;; IN EDITING MODE "*"
	;; VIA AY_LCD_COURSER_POS_MAIN_MENU_ABC_NOISE
	;;
	;; 2) INC ITEM 

;; --[ 1) CHECK ITEM]-------

	;; CHECK LOCATION VIA EDITING MODE "*"
	;; COPY THE VALUE OF EDITING MODE TO  MIOS_PARAMETER1
	movff 	AY_LCD_COURSER_POS_MAIN_MENU_ABC_NOISE, MIOS_PARAMETER1

LABEL_AY_SUB_MENU_PLUS_MAIN_MENU3_CHK_ITEM4	
	;; ITEM3 = NOISE PERIOD IS THE ONLY POS. WHRER PLUS
	;; IS NEEDED FOR INC THE NOISE PERIOD, SO CHECK
	;; IF THE EDITING MODE POS "*" = 4
	movlw 	MENU_ITEM_POS4
	cpfseq 	MIOS_PARAMETER1 ;; EDITING MODE ITEM  = 4?

		;; NO, SO QUIT
		goto LABEL_MAIN_MENUE_SWITCH

		;; YES
		rgoto LABEL_AY_SUB_MENU_PLUS_MAIN_MENU3_INC_ITEM4	

;;---[ 2) INC ITEM [MAIN MENU3 - ITEM4 [NOISE PERIOD]]]--------
LABEL_AY_SUB_MENU_PLUS_MAIN_MENU3_INC_ITEM4
	
	;; INC ITEM4
	;; ITEM3 => AY REG 6 = RANGE BIT0-4 (!)
	;; => RANGE 0-31 DEC.
	;; => RANGE 0-1F HEX.

		;; CHEK ITEM VALUE 
		;; ITEM4 = HAS 5BIT = 0x1F = 31 DEC
		;; compare f with WREG, skip IF < 1
		;; AY REG = 0x00?
		clrw 
		cpfseq 	AY_R6_NOISE_PERIOD
		
			;; NO
			rgoto LABEL_AY_SUB_MENU_PLUS_MAIN_MENU3_INC_ITEM4_OK

			;; YES
			goto LABEL_MAIN_MENUE_SWITCH




LABEL_AY_SUB_MENU_PLUS_MAIN_MENU3_INC_ITEM4_OK

	;; DONT BE CONFUSED:
	;; INC FOR LCD!
	;; DEC FOR AY REG
	decf AY_R6_NOISE_PERIOD, F
	
	;; PREPARE ITEM DATA FOR TRANSFERE TO AY CHIP VIA ay_sr.inc
	;; --------------------------------------------------------
	;; WRITE AY REG *ADRESS* TO AY_REG_ADDRESS FOR => AY_SR_Write
	movlw AY_CHIP_ADR_06_NOISE_PERIOD ; ADRESS => AY REGISTER
	movwf AY_REG_ADDRESS 		  ; ADDRESS FOR => AY_SR_Write
	;; WRITE AY REG *DATA* TO AY_REG_DATA FOR => AY_SR_Write
	movff AY_R6_NOISE_PERIOD, AY_REG_DATA 
	
	;; WRITING 8BIT DATA (AY_REG_ADDRESS, AY_REG_DATA)TO AY REG(X) ROUTINE
	;; @ay_sr.inc
	call LABEL_AY_SR_Write

		
		;; GO BACK TO: MAIN MENU 3
		goto LABEL_MAIN_MENUE_SWITCH

	

