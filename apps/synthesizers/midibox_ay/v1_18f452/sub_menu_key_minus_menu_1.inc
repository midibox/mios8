;; sub_menu_minus_menu_1.inc



;; --------[MINUS @ MAIN MENU1]------------------
;; JUMPED IN HERE FROM sub_menu_key_minus.inc
MINUS_KEY_SUBROUTINE_AT_MAIN_MENU1
	;; MAIN MENU1 = PATCH INFO MENU
	;; MINUS IS NEEDED HERE SO

	;; Jumped in here from sub_menu_key_plus.inc
	
	;; 1) CHECK ITEM = EDITING MODE "*"
	;;
	;; 2) INC ITEM 

;; --[ 1) CHECK ITEM]-------

	;; CHECK LOCATION VIA EDITING MODE "*"
	;; COPY THE VALUE OF EDITING MODE TO  MIOS_PARAMETER1
	movff 	AY_LCD_COURSER_POS_MAIN_MENU_PATCH_INFO, MIOS_PARAMETER1

	;; check if pos = 2
	movlw 	MENU_ITEM_POS2
	cpfseq 	MIOS_PARAMETER1 ;; EDITING MODE ITEM  = 2?

			;; NO
			;; Exit here
			return

		;; YES,
		;; DEC ITEM2
		;; ITEM2 = PATCH NUMBER [INT(0) - 1-127 (BANKSTICK])
		;; => RANGE 0    - 127   DEC.
		;; => RANGE 0x00 - 0x80  HEX.
		;; CHEK ITEM VALUE 
		;; compare f with WREG, 
		;; skip if BROWSE_PATCH_NR > 2 [1 or 0]
		movlw 	0x02
		cpfslt 	BROWSE_PATCH_NR
			;; NO
			;; BROWSE_PATCH_NR > or = 2
			rgoto LABEL_AY_SUB_MENU_MINUS_MAIN_MENU1_DEC_ITEM2

	;; YES 
	;; SET BROWSE_PATCH_NR to 0
	clrf BROWSE_PATCH_NR
	
	;; BROWSE PATCH = INTERNAL PATCH
	;; PATCH_MENU_STATE_FLAGS
	;; BIT2 = 0 = LOAD EEPROM PATCH (PIC INTERNAL PATCH)
	;; BIT2 = 1 = LOAD BANKSTICK PATCH
	bcf	PATCH_MENU_STATE_FLAGS, BIT2_SELECTED_PATCH_BANKSTICK_OR_INTERNAL
	
	;; GO AND LOAD INTERNAL PATCH NAME
	rgoto LABEL_AY_SUB_MENU_MINUS_MAIN_MENU1_GO_MAIN_MENU1


LABEL_AY_SUB_MENU_MINUS_MAIN_MENU1_DEC_ITEM2
			;; ITEM [PATCH NUMBER] = ITEM -1
			decf BROWSE_PATCH_NR, F

LABEL_AY_SUB_MENU_MINUS_MAIN_MENU1_GO_MAIN_MENU1		
	;; Another PATCH NAME WILL BE LOADED BY THE MAIN MENU1
	;; THIS PATCH NAME IS NOT EDITED BY THE USER (yet)
	;; SO CLEAR BIT 5
	bcf 	PATCH_MENU_STATE_FLAGS, BIT5_PATCH_NAME_IS_NEW
	
	;; -----------------------[exit here]------------------------------
	;; Redraw MAIN MENU LCD
	;; main_menu_01_patch.inc
	goto LABEL_AY_MAIN_MENU_01_PATCH_INFO
				

