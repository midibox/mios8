;; sub_menu_key_c.inc

;; ---------------------------------------------------------
;; -------------------------[C]----------------------------- 
;; =======================> [C] HAD BEEN PRESSED

LABEL_AY_SUB_MENU_C

LABEL_AY_SUB_MENU_C_CHK_MAINMENU
	;; 1) CHECK WHICH MAIN MENU IS ACTIVATED
	;; ==> VIA CURRENT_MAIN_MENU
	;;
	;; 2) GOTO THE NEEDED SUB ROUTINE OF THE ACTIVATED
	;;    MAIN MENU

	movf CURRENT_MAIN_MENU, W
	JUMPTABLE_2BYTES 7
		rgoto        LABEL_AY_SUB_MENU_C_EXIT
		rgoto        LABEL_AY_SUB_MENU_C_EXIT
        	rgoto        LABEL_AY_SUB_MENU_C_EXIT
        	rgoto        LABEL_AY_SUB_MENU_C_MAIN_MENU3
        	rgoto        LABEL_AY_SUB_MENU_C_EXIT
        	rgoto        LABEL_AY_SUB_MENU_C_MAIN_MENU5
        	rgoto        LABEL_AY_SUB_MENU_C_EXIT
       

;; -------[END OF: CHECK WHICH MAIN MENU IS ACTIVATED]---
;; ----------------------------------------------------------------

;; --------[C @ MAIN MENU0]------------------

LABEL_AY_SUB_MENU_C_EXIT
	;; C @ MENU SWITCH MENU - NO Function
	goto LABEL_MAIN_MENUE_SWITCH



;; --------[C @ MAIN MENU3]------------------
LABEL_AY_SUB_MENU_C_MAIN_MENU3
	;; MAIN MENU3 = MIXER CH ABC +NOISE
	;; KEY C HAD BEEN PRESSED
	;;
	;; 1) CHECK WHICH ITEM (AY REG) IS 
	;; IN EDITING MODE "*"
	;; VIA AY_LCD_COURSER_POS_MAIN_MENU_ABC_NOISE
	;;
	;; 2) TOGGLE CH C ON/OFF

;; --[ 1) CHECK ITEM]-------

	;; CHECK LOCATION VIA EDITING MODE "*"
	;; COPY THE VALUE OF EDITING MODE TO  MIOS_PARAMETER1
	movff 	AY_LCD_COURSER_POS_MAIN_MENU_ABC_NOISE, MIOS_PARAMETER1

LABEL_AY_SUB_MENU_C_MAIN_MENU3_CHK_ITEM1	
	movlw 	MENU_ITEM_POS1
	cpfseq 	MIOS_PARAMETER1 ;; EDITING MODE ITEM  = 1?

		;; NO
		rgoto LABEL_AY_SUB_MENU_C_MAIN_MENU3_CHK_ITEM2

		;; YES
		rgoto LABEL_AY_SUB_MENU_C_MAIN_MENU3_TOGGLE_FX_C


LABEL_AY_SUB_MENU_C_MAIN_MENU3_CHK_ITEM2	
	movlw 	MENU_ITEM_POS2
	cpfseq 	MIOS_PARAMETER1 ;; EDITING MODE ITEM  = 2?

		;; NO
		rgoto LABEL_AY_SUB_MENU_C_MAIN_MENU3_CHK_ITEM3

		;; YES
		rgoto LABEL_AY_SUB_MENU_C_MAIN_MENU3_TOGGLE_CH_C

;; -------

LABEL_AY_SUB_MENU_C_MAIN_MENU3_CHK_ITEM3	
	movlw 	MENU_ITEM_POS3
	cpfseq 	MIOS_PARAMETER1 ;; EDITING MODE "*" ITEM  = 3?

			;; NO
			;; KEY [C] IS NEEDED JUST FOR EDITING POS 2 + 3
			;; SO EXIT HERE...
			goto LABEL_MAIN_MENUE_SWITCH

		;; YES
		rgoto LABEL_AY_SUB_MENU_C_MAIN_MENU3_TOGGLE_NOISE_C



;; ---------[MAIN MENU 3 @ ITEM1 - SUB-ROUTINE KEY [C] TOGGLE FX A ON/ OFF]---------------


LABEL_AY_SUB_MENU_C_MAIN_MENU3_TOGGLE_FX_C
	;; TOGGLE FX C ON/OFF
	;; BIT2 = 1 ==> FX CH C ON 
	;; BIT2 = 0 ==> FX CH C OFF 
	;; IF BIT2 = 0 => TOGGLE BIT2 to 1
	;; IF BIT2 = 1 => TOGGLE BIT2 to 0

	;; CHECK IS BIT2 = 0?  
	btfsc FX_USER_ON_OFF_ABC, BIT2_FX_ON_OFF_TONE_C ;; CHK BIT2
		
		;; NO - BIT2 = 1, SO CLEAR BIT0 TO 0
		rgoto  LABEL_AY_SUB_MENU_C_MAIN_MENU3_CLR_FX_C
		
		
		;; YES BIT2 = 0, SO SET BIT2 TO 1
		rgoto LABEL_AY_SUB_MENU_C_MAIN_MENU3_SET_FX_C
		

LABEL_AY_SUB_MENU_C_MAIN_MENU3_SET_FX_C
		;; SET BIT2
		bsf FX_USER_ON_OFF_ABC, BIT2_FX_ON_OFF_TONE_C
		;; CS LED
		call LED_Fx_C_on
			goto LABEL_MAIN_MENUE_SWITCH

LABEL_AY_SUB_MENU_C_MAIN_MENU3_CLR_FX_C
		;; CLEAR BIT2
		bcf FX_USER_ON_OFF_ABC, BIT2_FX_ON_OFF_TONE_C
		;; CS LED
		call LED_Fx_C_off
			goto LABEL_MAIN_MENUE_SWITCH






;;--------------------[END ITEM1 - FX]-----------------------------

LABEL_AY_SUB_MENU_C_MAIN_MENU3_TOGGLE_CH_C

	;; TOGGLE CH C ON/OFF
	;; BIT2 = 0 ==> TONE CH C *ON* (!)
	;; BIT2 = 1 ==> TONE CH C *OFF* (!)
	;; BIT2 of AY_TONE_NOISE_ABC_USER_ON_OFF_SWITCH:
	;; IF BIT2 = 0 => TOGGLE BIT2 to 1
	;; IF BIT2 = 1 => TOGGLE BIT2 to 0

	;; BIT2 AY_TONE_NOISE_ABC_USER_ON_OFF_SWITCH TEST
	;; SCIP IF CLEAR
	;; IS BIT2 OF AY_TONE_NOISE_ABC_USER_ON_OFF_SWITCH = 0?  
	btfsc AY_TONE_NOISE_ABC_USER_ON_OFF_SWITCH, BIT2_FX_ON_OFF_TONE_C ;; CHK BIT2
		
		;; NO - BIT2 = 1, SO CLEAR BIT2
		rgoto  LABEL_AY_SUB_MENU_C_MAIN_MENU3_CLR_CHC
		
		
		;; YES BIT2 = 0, SO SET BIT2
		rgoto LABEL_AY_SUB_MENU_C_MAIN_MENU3_SET_CHC
		

LABEL_AY_SUB_MENU_C_MAIN_MENU3_SET_CHC
		;; SET BIT2
		bsf AY_TONE_NOISE_ABC_USER_ON_OFF_SWITCH, BIT2_FX_ON_OFF_TONE_C
		;; CS LED
		call LED_ToneC_off
			goto LABEL_MAIN_MENUE_SWITCH

LABEL_AY_SUB_MENU_C_MAIN_MENU3_CLR_CHC
		;; CLEAR BIT2
		bcf AY_TONE_NOISE_ABC_USER_ON_OFF_SWITCH, BIT2_FX_ON_OFF_TONE_C
		;; CS LED
		call LED_ToneC_on
			goto LABEL_MAIN_MENUE_SWITCH


;; ---------[END: TOGGLE CH C ON/ OFF]---------------




;; ---------[TOGGLE [ADD NOISE TO CH C] ON/ OFF]---------------

LABEL_AY_SUB_MENU_C_MAIN_MENU3_TOGGLE_NOISE_C

	;; TOGGLE NOISE CH C ON/OFF
	
	;; BIT5 of AY_TONE_NOISE_ABC_USER_ON_OFF_SWITCH:
	;; IF BIT5 = 0 => TOGGLE BIT5 to 1
	;; IF BIT5 = 1 => TOGGLE BIT5 to 0

	;; BIT5 AY_TONE_NOISE_ABC_USER_ON_OFF_SWITCH TEST
	;; SKIP IF CLEAR
	;; IS BIT5 OF AY_TONE_NOISE_ABC_USER_ON_OFF_SWITCH = 0?  
	btfsc AY_TONE_NOISE_ABC_USER_ON_OFF_SWITCH, BIT5_NOISE_C_ON_OFF
		
		;; NO - BIT5 = 1, SO CLEAR BIT5
		rgoto  	LABEL_AY_SUB_MENU_C_MAIN_MENU3_CLR_B5_NOISE_C
		
		
		;; YES BIT5 = 0, SO SET BIT5
		rgoto 	LABEL_AY_SUB_MENU_C_MAIN_MENU3_SET_B5_NOISE_C
		

LABEL_AY_SUB_MENU_C_MAIN_MENU3_SET_B5_NOISE_C
		;; SET BIT5
		bsf AY_TONE_NOISE_ABC_USER_ON_OFF_SWITCH, BIT5_NOISE_C_ON_OFF
		;; CS LED
		call LED_NoiseC_off
			goto LABEL_MAIN_MENUE_SWITCH

LABEL_AY_SUB_MENU_C_MAIN_MENU3_CLR_B5_NOISE_C
		;; CLEAR BIT5
		bcf AY_TONE_NOISE_ABC_USER_ON_OFF_SWITCH, BIT5_NOISE_C_ON_OFF
		;; CS LED
		call LED_NoiseC_on
			goto LABEL_MAIN_MENUE_SWITCH


		



;; ---------[END: TOGGLE NOISE CH C ON/ OFF]---------------

;; --------[END: C @ MAIN MENU3]------------------




;; --------[C @ MAIN MENU5]------------------
LABEL_AY_SUB_MENU_C_MAIN_MENU5

	;; MAIN MENU5 = ENVELOPE CONTROL
	;; KEY [C] HAD BEEN PRESSED
	;;
	;; 1) CHECK WHICH ITEM (AY REG) IS 
	;; IN EDITING MODE "*"
	;; VIA AY_LCD_COURSER_POS_MAIN_MENU_ENVELOPE
	;;
	;; 2) TOGGLE CH C ON/OFF R.MODE
	;; ==> R.MODE => AY REG 11,12,13 MODE
	;; ==> R.MODE ON: ENV IS CONTROLLED BY AY REG 12,12,13

;; --[ 1) CHECK ITEM]-------

	;; CHECK LOCATION VIA EDITING MODE "*"
	;; COPY THE VALUE OF EDITING MODE TO  MIOS_PARAMETER1
	movff 	AY_LCD_COURSER_POS_MAIN_MENU_ENVELOPE, MIOS_PARAMETER1

LABEL_AY_SUB_MENU_C_MAIN_MENU5_CHK_ITEM4	
	;; POS4 IS THE ONLY POS WHRE KEY [C] IS IN USE @ MAIN MENU5
	;; SO JUST CHECK POS3...
	movlw 	MENU_ITEM_POS4
	cpfseq 	MIOS_PARAMETER1 ;; EDITING MODE ITEM  = 4?

		;; NO
		;; SO QUIT HERE
		goto LABEL_MAIN_MENUE_SWITCH

		;; YES 
		rgoto 	LABEL_AY_SUB_MENU_C_MAIN_MENU5_TOGGLE_R_MODE_CH_C


LABEL_AY_SUB_MENU_C_MAIN_MENU5_TOGGLE_R_MODE_CH_C
	;; R_MODE = REGISTER MODE = ENVELOPE MODE
	;; TOGGLE CH C ON/OFF R.MODE @ MAIN MENU5 => ENV MENU
	;; ==> R.MODE => ENV IS CONTROLLED BY [AY REG 11,12,13]

	;; TOGGLE CH C ON/OFF R.MODE @ MAIN MENU5 => ENV MENU
	;; CH C BIT4 = 0 ==> R.Mode *OFF* 
	;; CH C BIT4 = 1 ==> R.Mode *ON* 
	;; BIT4 of AY_R10_CH_C_AMPLITUDE:
	;; IF BIT4 = 0 => TOGGLE BIT4 to 1
	;; IF BIT4 = 1 => TOGGLE BIT4 to 0

	;; BIT4 AY_R10_CH_C_AMPLITUDE TEST
	;; SKIP IF CLEAR
	;; IS BIT4 OF AY_R10_CH_C_AMPLITUDE = 0?  
	btfsc AY_R10_CH_C_AMPLITUDE, BIT4_ENVELOPE_ON_OFF
		
		;; NO - BIT4 = 1, SO CLEAR BIT4
		rgoto  LABEL_AY_SUB_MENU_C_MAIN_MENU5_CLR_BIT4
		
		
		;; YES BIT4 = 0, SO SET BIT4
		rgoto LABEL_AY_SUB_MENU_C_MAIN_MENU5_SET_BIT4
		

LABEL_AY_SUB_MENU_C_MAIN_MENU5_SET_BIT4
		;; SET BIT4
		bsf AY_R10_CH_C_AMPLITUDE, BIT4_ENVELOPE_ON_OFF
		;; CS LED
		call LED_EnvelopeModeC_on
			rgoto LABEL_AY_SUB_MENU_C_MAIN_MENU5_SEND_TO_AY_BIT4

LABEL_AY_SUB_MENU_C_MAIN_MENU5_CLR_BIT4
		;; CLEAR BIT4
		bcf AY_R10_CH_C_AMPLITUDE, BIT4_ENVELOPE_ON_OFF
		;; CS LED
		call LED_EnvelopeModeC_off
			

LABEL_AY_SUB_MENU_C_MAIN_MENU5_SEND_TO_AY_BIT4
			;; PREPARE ITEM DATA FOR TRANSFERE TO AY CHIP VIA ay_sr.inc
			;; --------------------------------------------------------
			;; WRITE AY REG *ADRESS* TO AY_REG_ADDRESS FOR => AY_SR_Write
			movlw AY_CHIP_ADR_10_TONE_C_VOLUME_ENV_MODE_ON_OFF
			movwf AY_REG_ADDRESS 		; ADDRESS FOR => AY_SR_Write
			;; WRITE AY REG *DATA* TO AY_REG_DATA FOR => AY_SR_Write
			movff AY_R10_CH_C_AMPLITUDE, AY_REG_DATA 
			;; 
			;; WRITING 8BIT DATA (AY_REG_ADDRESS, AY_REG_DATA)
			;; TO AY REG(X) ROUTINE
			;; @ay_sr.inc
			call LABEL_AY_SR_Write
			;; ---------------------------------------------------------------

				;; SUB ROUTINE IS DONE		
				;; JUMP TO MAIN MENU (REDRAW LCD MENU5)		
			
				;; => LABEL_MAIN_MENUE_SWITCH
				;; =>  @ main_menu_functions.inc	
				goto LABEL_MAIN_MENUE_SWITCH
		

;; -------------------------------------------------------------------------



;; --------------------------------------------------------------------------
;; -------------------------[END OF SUB MENU: C]----------------------------- 

