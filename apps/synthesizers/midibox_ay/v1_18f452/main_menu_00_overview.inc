;; main_menu_00_overview.inc

;; --[MB AY MAIN MENU 00: MENU OVERVIEW ]------ 
;; =======================> SHORTCUT: F1
LABEL_AY_MAIN_MENU_00_MENU_SWITCH
 
	;; SHOW MIDIBOX AY MENU SWITCH SCREEN
	call    MIOS_LCD_Clear
	
	;; LCD ROW 1 TO 4
   	TABLE_ADDR TEXT_AY_MB_AY_MENUE_SWITCH_ROW1
	call    MIOS_LCD_PrintString
	
	TABLE_ADDR TEXT_AY_MB_AY_MENUE_SWITCH_ROW2
	call    MIOS_LCD_PrintString
	
	TABLE_ADDR TEXT_AY_MB_AY_MENUE_SWITCH_ROW3
	call    MIOS_LCD_PrintString
	
	TABLE_ADDR TEXT_AY_MB_AY_MENUE_SWITCH_ROW4
	call    MIOS_LCD_PrintString

	

LABEL_AY_MAIN_MENU_00_MENU_SWITCH_DONE
	
		;; THE MAIN MENU ROUTINE HAS BEEN PERFORMED 
		
			;; MAIN MENU 0 ROUTINE END - SO RETURN
			return



