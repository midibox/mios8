;; sub_menu_key_down.inc

;; -------------------------------------------------------------------------
;; ----[SUB FUNCTIONS: DOWN ⇒ [CRSR DOWN] (or [RETURN]) HAS BEEN PRESSED]---
;; =======================> CHECK WHICH MAIN MENU IS ACTIVE

LABEL_AY_SUB_MENU_DOWN
	;; 1) CHECK WHICH MAIN MENU IS ACTIVATED
	;; ==> VIA CURRENT_MAIN_MENU
	;;
	;; 2) GOTO THE NEEDED SUB ROUTINE OF THE ACTIVATED
	;;    MAIN MENU
	
	;; JUMP TO KEY @ MENU X
	movf CURRENT_MAIN_MENU, W
	JUMPTABLE_2BYTES 9 ;; [MAIN MENU 0-8]
		rgoto        SUB_MENU_DOWN_MAIN_MENU0
		rgoto        SUB_MENU_DOWN_MAIN_MENU1
		rgoto        SUB_MENU_DOWN_MAIN_MENU2
		rgoto        SUB_MENU_DOWN_MAIN_MENU3
		rgoto        SUB_MENU_DOWN_MAIN_MENU4
		rgoto        SUB_MENU_DOWN_MAIN_MENU5
		rgoto        SUB_MENU_DOWN_MAIN_MENU6
		rgoto        SUB_MENU_DOWN_MAIN_MENU7
		rgoto        SUB_MENU_DOWN_MAIN_MENU8
		


;; -------[END OF: CHECK WHICH MAIN MENU IS ACTIVATED]---
;; ----------------------------------------------------------------

;; --------[RETURN @ MAIN MENU0]------------------
SUB_MENU_DOWN_MAIN_MENU0
	;; RETURN @ MENU SWITCH MENU - NO Function
	goto LABEL_MAIN_MENUE_SWITCH

	
;; --------[RETURN @ MAIN MENU1]------------------

SUB_MENU_DOWN_MAIN_MENU1
	;; MAIN MENU1 = PATCH INFO MENU
	;; RETURN IS NEEDED HERE TO:
	;; INCREMENT EDITING MODE POSITION => "*" (ITEM POS)
	;; IN PATCH INFO MENU
	
	;; ITEM POS +1	
	movff 	AY_LCD_COURSER_POS_MAIN_MENU_PATCH_INFO, MIOS_PARAMETER1
	incf 	MIOS_PARAMETER1, F
	movff 	MIOS_PARAMETER1, AY_LCD_COURSER_POS_MAIN_MENU_PATCH_INFO
	
	;; CHECK:
	;; AY_LCD_COURSER_POS_MAIN_MENU_PATCH_INFO IS NOT ALLOWED TO BE > 3
	movlw 	MENU_ITEM_POS3
	cpfsgt 	MIOS_PARAMETER1 ;; POS > 3?

				;; NO
				rgoto LABEL_AY_SUB_MENU_DOWN_MAIN_MENU1_DONE

		;; YES
		;; SWITCH POS BACK TO POS1
		;; -----------------------
		;; MENU ITEM > 3 SO 
		;; MENUE ITEM MUST BE SWITCHED BACK TO 1
		movlw 	MENU_ITEM_POS1
		movwf 	MIOS_PARAMETER1
		movff 	MIOS_PARAMETER1, AY_LCD_COURSER_POS_MAIN_MENU_PATCH_INFO
				rgoto    LABEL_AY_SUB_MENU_DOWN_MAIN_MENU1_DONE
			
LABEL_AY_SUB_MENU_DOWN_MAIN_MENU1_DONE
				;; SUB ROUTINE IS DONE		
				goto LABEL_AY_MAIN_MENU_01_PATCH_INFO


;; -----------------------------------------------
;; --------[RETURN @ MAIN MENU2]------------------
;; -----------------------------------------------

SUB_MENU_DOWN_MAIN_MENU2
	;; MAIN MENU2 = TUNE MENU
	;; INC POS +1
	;; RETURN IS NEEDED HERE TO:
	;; INC. AY_LCD_COURSER_POS_MAIN_MENU_ABC_TUNE
	;; => POS OF "*" = EDITING MODE
	
		
	;; INC ITEM POS +1
	movff 	AY_LCD_COURSER_POS_MAIN_MENU_ABC_TUNE, MIOS_PARAMETER1
	incf 	MIOS_PARAMETER1, F
	movff 	MIOS_PARAMETER1, AY_LCD_COURSER_POS_MAIN_MENU_ABC_TUNE
	
	;; CHECK:
	;; ITEM POS IS NOT ALLOWED TO BE >6
	;; IS ITEM POS > 6?
	movlw 	MENU_ITEM_POS6
	cpfsgt 	MIOS_PARAMETER1 ;; POS > 6?

		;; NO
		rgoto LABEL_AY_SUB_MENU_DOWN_MAIN_MENU2_DONE

		;; YES
		rgoto LABEL_AY_SUB_MENU_DOWN_MAIN_MENU2_BACK_POS1





LABEL_AY_SUB_MENU_DOWN_MAIN_MENU2_BACK_POS1
;; ITEM > 6 SO 
;; MENUE ITEM MUST BE SWITCHED BACK TO 1

		movlw 	MENU_ITEM_POS1
		movwf 	MIOS_PARAMETER1
		movff 	MIOS_PARAMETER1, AY_LCD_COURSER_POS_MAIN_MENU_ABC_TUNE

;; --------
			
LABEL_AY_SUB_MENU_DOWN_MAIN_MENU2_DONE
		;; SUB ROUTINE IS DONE		
		goto LABEL_MAIN_MENUE_SWITCH




;; -----------------------------------------------
;; --------[RETURN @ MAIN MENU3]------------------
;; -----------------------------------------------

SUB_MENU_DOWN_MAIN_MENU3
	;; MAIN MENU3 = MIXER MENU
	;; INC POS +1
	;; RETURN IS NEEDED HERE TO:
	;; INC. AY_LCD_COURSER_POS_MAIN_MENU_ABC_NOISE
	;; => POS OF "*" = EDITING MODE
		
	;; INC AY_LCD_COURSER_POS_MAIN_MENU_PATCH_INFO
	movff 	AY_LCD_COURSER_POS_MAIN_MENU_ABC_NOISE, MIOS_PARAMETER1
	incf 	MIOS_PARAMETER1, F
	movff 	MIOS_PARAMETER1, AY_LCD_COURSER_POS_MAIN_MENU_ABC_NOISE
	
	;; CHECK:
	;; EDITING POS. "*" IS NOT ALLOWED TO BE >4
	;; IS EDITING MODE POS "*" > 4?
	movlw 	MENU_ITEM_POS4
	cpfsgt 	MIOS_PARAMETER1 ;; POS > 4?

			;; NO
			rgoto LABEL_AY_SUB_MENU_DOWN_MAIN_MENU3_DONE

		;; YES
		;; POS > 3
		;; SWITCH POS BACK TO POS 1
		;; EDITING MODE "*" POS. SWITCHED TO 1
		movlw 	MENU_ITEM_POS1
		movwf 	MIOS_PARAMETER1
		movff 	MIOS_PARAMETER1, AY_LCD_COURSER_POS_MAIN_MENU_ABC_NOISE

LABEL_AY_SUB_MENU_DOWN_MAIN_MENU3_DONE
			;; SUB ROUTINE IS DONE		
			;; JUMP TO MAIN MENU (REDRAW LCD MENU3)	
			;; => LABEL_MAIN_MENUE_SWITCH
			;; =>  @ main_menu_functions.inc	
			goto LABEL_MAIN_MENUE_SWITCH
				


;; -----------------------------------------------
;; --------[RETURN @ MAIN MENU4]------------------
;; -----------------------------------------------

SUB_MENU_DOWN_MAIN_MENU4
	;; MAIN MENU4 = AMPLITUDE/VOLUME MENU
	;; INC POS +1
	;; RETURN IS NEEDED HERE TO:
	;; INC. AY_LCD_COURSER_POS_MAIN_MENU_ABC_NOISE
	;; => POS OF "*" = EDITING MODE
		
	;; INC AY_LCD_COURSER_POS_MAIN_MENU_PATCH_INFO
	movff 	AY_LCD_COURSER_POS_MAIN_MENU_AMPLITUDE, MIOS_PARAMETER1
	incf 	MIOS_PARAMETER1, F
	movff 	MIOS_PARAMETER1, AY_LCD_COURSER_POS_MAIN_MENU_AMPLITUDE
	
	;; CHECK:
	;; EDITING POS. "*" IS NOT ALLOWED TO BE >3
	;; IS EDITING MODE POS "*" > 3?
	movlw 	MENU_ITEM_POS3
	cpfsgt 	MIOS_PARAMETER1 ;; POS > 3?

		;; NO
		rgoto LABEL_AY_SUB_MENU_DOWN_MAIN_MENU4_DONE

		;; YES
		rgoto LABEL_AY_SUB_MENU_DOWN_MAIN_MENU4_BACK_POS1





LABEL_AY_SUB_MENU_DOWN_MAIN_MENU4_BACK_POS1
;; EDITING MODE "*" POS. SWITCHED TO 1
		movlw 	MENU_ITEM_POS1
		movwf 	MIOS_PARAMETER1
		movff 	MIOS_PARAMETER1, AY_LCD_COURSER_POS_MAIN_MENU_AMPLITUDE

;; --------
			
LABEL_AY_SUB_MENU_DOWN_MAIN_MENU4_DONE
		;; SUB ROUTINE IS DONE		
		goto LABEL_MAIN_MENUE_SWITCH



;; -----------------------------------------------
;; --------[RETURN @ MAIN MENU5]------------------
;; -----------------------------------------------

SUB_MENU_DOWN_MAIN_MENU5
	;; MAIN MENU5 = ENVELOPE MENU
	;; INC POS +1
	;; => POS OF "*" = EDITING MODE

	;; INC ITEM POS
	movff 	AY_LCD_COURSER_POS_MAIN_MENU_ENVELOPE, MIOS_PARAMETER1
	incf 	MIOS_PARAMETER1, F
	movff 	MIOS_PARAMETER1, AY_LCD_COURSER_POS_MAIN_MENU_ENVELOPE
	
	;; CHECK:
	;; EDITING POS. "*" IS NOT ALLOWED TO BE >4
	;; IS EDITING MODE POS "*" > 4?
	movlw 	MENU_ITEM_POS4
	cpfsgt 	MIOS_PARAMETER1 ;; POS > 4?

		;; NO
		rgoto LABEL_AY_SUB_MENU_DOWN_MAIN_MENU5_DONE

		;; YES
		rgoto LABEL_AY_SUB_MENU_DOWN_MAIN_MENU5_BACK_POS1


LABEL_AY_SUB_MENU_DOWN_MAIN_MENU5_BACK_POS1
;; EDITING MODE "*" POS. SWITCHED TO POS 1
		movlw 	MENU_ITEM_POS1
		movwf 	MIOS_PARAMETER1
		movff 	MIOS_PARAMETER1, AY_LCD_COURSER_POS_MAIN_MENU_ENVELOPE

;; --------
			
LABEL_AY_SUB_MENU_DOWN_MAIN_MENU5_DONE
		;; SUB ROUTINE IS DONE		
		goto LABEL_MAIN_MENUE_SWITCH


;; ---------------------------------------------------------
;; -------------[MAIN MENU 6]-------------------------------
;; ---------------------------------------------------------

SUB_MENU_DOWN_MAIN_MENU6
	;; MAIN MENU6 = TONE ABC MIDI-CHANNEL CONTROL
	;; INC POS +1
	;; PLUS / DOWN IS NEEDED HERE TO:
	;; INC EDITING MODE POSITION => "*" +1
	;; INC EDITING MODE POS "*" in MAIN MENU6
	;; INC POS +1
	movff 	AY_LCD_COURSER_POS_MAIN_MENU_MIDI_CONFIG, MIOS_PARAMETER1
	incf 	MIOS_PARAMETER1, F
	movff 	MIOS_PARAMETER1, AY_LCD_COURSER_POS_MAIN_MENU_MIDI_CONFIG   

	;; CHECK:
	;; EDITING MODE POS "*" in MAIN MENU6
	;; ITEM POS. OF "*" IS NOT ALLOWED TO BE = 4
	;; EDITING MODE POS "*" in MAIN MENU6 > 3?
	movlw 	MENU_ITEM_POS3
	cpfsgt 	MIOS_PARAMETER1 ;; POS > 3?

		;; NO - ALL RIGHT
		rgoto LABEL_AY_SUB_MENU_DOWN_MAIN_MENU6_DONE

		;; YES
		rgoto LABEL_AY_SUB_MENU_DOWN_MAIN_MENU6_BACK_START_POS

LABEL_AY_SUB_MENU_DOWN_MAIN_MENU6_BACK_START_POS
		;; EDITING MODE POS "*" > 3
		;; EDITING MODE POS "*" MUST BE SWITCHED TO 1 
		movlw 	MENU_ITEM_POS1
		movwf 	MIOS_PARAMETER1
		movff 	MIOS_PARAMETER1, AY_LCD_COURSER_POS_MAIN_MENU_MIDI_CONFIG
	
LABEL_AY_SUB_MENU_DOWN_MAIN_MENU6_DONE
		;; SUBROUTINE IS DONE 
		goto LABEL_MAIN_MENUE_SWITCH


;; ----------------------------------------------------------
;; --[INC POS MAIN MENU 7 - VELOCITY TO ABC + NOISE PERIOD]--
;; ----------------------------------------------------------

SUB_MENU_DOWN_MAIN_MENU7
	;; MAIN MENU7 = VELOCITY TO => A B C + NOISE PERIOD 
	;; INC POS +1
	;; RETURN AND [+] IS NEEDED HERE TO:
	;; INCREMENT EDITING MODE POSITION => "*"

	;; INC ITEM POS @ MAIN MENU 7
	movff 	AY_LCD_COURSER_POS_MAIN_MENU_VELOCITY_CONFIG, MIOS_PARAMETER1
	incf 	MIOS_PARAMETER1, F
	movff 	MIOS_PARAMETER1, AY_LCD_COURSER_POS_MAIN_MENU_VELOCITY_CONFIG
	
	;; CHECK:
	;; IT IS NOT VALID IF POS >4
	;; IS ITEM POS > 4?
	movlw 	MENU_ITEM_POS4
	cpfsgt 	MIOS_PARAMETER1 ;; POS > 4?

		;; NO
		rgoto LABEL_AY_SUB_MENU_DOWN_MAIN_MENU7_DONE

		;; YES
		rgoto LABEL_AY_SUB_MENU_DOWN_MAIN_MENU7_BACK_POS1

LABEL_AY_SUB_MENU_DOWN_MAIN_MENU7_BACK_POS1
		;; POS > 4 SO 
		;; ITEM POS MUST BE SWITCHED TO 1
		movlw 	MENU_ITEM_POS1
		movwf 	MIOS_PARAMETER1
		movff 	MIOS_PARAMETER1, AY_LCD_COURSER_POS_MAIN_MENU_VELOCITY_CONFIG
	
LABEL_AY_SUB_MENU_DOWN_MAIN_MENU7_DONE
		;; SUB ROUTINE IS DONE		
		goto LABEL_MAIN_MENUE_SWITCH


;; --------------------------------------------------------------------
;; --------[PLUS @ MAIN MENU 8]----------------------------------------
;; --------------------------------------------------------------------


SUB_MENU_DOWN_MAIN_MENU8
	;; INC POS +1
	;; RETURN IS NEEDED HERE TO:
	;; INC. POS => POS OF "*" = EDITING MODE
	movff 	AY_LCD_COURSER_POS_MAIN_MENU_FX, MIOS_PARAMETER1
	incf 	MIOS_PARAMETER1, F
	movff 	MIOS_PARAMETER1, AY_LCD_COURSER_POS_MAIN_MENU_FX
	
	;; CHECK:
	;; EDITING POS. "*" IS NOT ALLOWED TO BE >4
	;; IS EDITING MODE POS "*" > 4?
	movlw 	MENU_ITEM_POS4
	cpfsgt 	MIOS_PARAMETER1 ;; POS > 4?

		;; NO
		rgoto LABEL_AY_SUB_MENU_DOWN_MAIN_MENU8_DONE

		;; YES
		rgoto LABEL_AY_SUB_MENU_DOWN_MAIN_MENU8_BACK_POS1

LABEL_AY_SUB_MENU_DOWN_MAIN_MENU8_BACK_POS1
		;; EDITING MODE "*" POS. SWITCHED TO 1
		movlw 	MENU_ITEM_POS1
		movwf 	MIOS_PARAMETER1
		movff 	MIOS_PARAMETER1, AY_LCD_COURSER_POS_MAIN_MENU_FX
			
LABEL_AY_SUB_MENU_DOWN_MAIN_MENU8_DONE
		;; SUB ROUTINE IS DONE		
		;; JUMP TO MAIN MENU (REDRAW LCD MENU8)	
		;; => LABEL_MAIN_MENUE_SWITCH
		;; =>  @ main_menu_functions.inc	
		goto LABEL_MAIN_MENUE_SWITCH
				


;; --------[END OF KEY [RETURN] FUNCTIONS ]------------------

