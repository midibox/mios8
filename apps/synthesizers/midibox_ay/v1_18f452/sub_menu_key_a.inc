;; sub_menu_key_a.inc

;; ----------------------------------------------------------------------------
;; -------------------------[A]----------------------------- 
;; =======================> [A] HAD BEEN PRESSED

LABEL_AY_SUB_MENU_A



;; CHECK WHAT MAIN MENU IS ACTIVATED 
;; => VIA CURRENT_MAIN_MENU
LABEL_AY_SUB_MENU_A_CHK1
	
	movf CURRENT_MAIN_MENU, W
	JUMPTABLE_2BYTES 8
		rgoto        LABEL_AY_SUB_MENU_A_EXIT
		rgoto        LABEL_AY_SUB_MENU_A_EXIT
		rgoto        LABEL_AY_SUB_MENU_A_EXIT
		rgoto        LABEL_AY_SUB_MENU_A_MAIN_MENU3
		rgoto        LABEL_AY_SUB_MENU_A_EXIT
		rgoto        LABEL_AY_SUB_MENU_A_MAIN_MENU5
		rgoto        LABEL_AY_SUB_MENU_A_EXIT
		rgoto        LABEL_AY_SUB_MENU_A_EXIT
      		



;; -------[END OF: CHECK WHICH MAIN MENU IS ACTIVATED]---
;; ----------------------------------------------------------------

;; --------[A @ MAIN MENU0]------------------

LABEL_AY_SUB_MENU_A_EXIT
	;; MINUS HAS NO Function here so exit
	goto LABEL_MAIN_MENUE_SWITCH




;; --------[A @ MAIN MENU3]------------------
LABEL_AY_SUB_MENU_A_MAIN_MENU3
	;; MAIN MENU3 = MIXER FX, TONE ABC, NOISE ABC
	;; KEY [A] HAD BEEN PRESSED
	;;
	;; 1) CHECK WHICH ITEM (AY REG) IS 
	;; IN EDITING MODE "*"
	;; VIA AY_LCD_COURSER_POS_MAIN_MENU_ABC_NOISE
	;;
	;; 2) TOGGLE CH A ON/OFF

;; --[ 1) CHECK ITEM]-------

	;; CHECK LOCATION VIA EDITING MODE "*"
	;; COPY THE VALUE OF EDITING MODE TO  MIOS_PARAMETER1
	movff 	AY_LCD_COURSER_POS_MAIN_MENU_ABC_NOISE, MIOS_PARAMETER1

LABEL_AY_SUB_MENU_A_MAIN_MENU3_CHK_ITEM1	
	movlw 	MENU_ITEM_POS1
	cpfseq 	MIOS_PARAMETER1 ;; EDITING MODE ITEM  = 1?

		;; NO
		rgoto LABEL_AY_SUB_MENU_A_MAIN_MENU3_CHK_ITEM2

		;; YES
		rgoto LABEL_AY_SUB_MENU_A_MAIN_MENU3_TOGGLE_FX_A


LABEL_AY_SUB_MENU_A_MAIN_MENU3_CHK_ITEM2	
	movlw 	MENU_ITEM_POS2
	cpfseq 	MIOS_PARAMETER1 ;; EDITING MODE ITEM  = 2?

		;; NO
		rgoto LABEL_AY_SUB_MENU_A_MAIN_MENU3_CHK_ITEM3

		;; YES
		rgoto LABEL_AY_SUB_MENU_A_MAIN_MENU3_TOGGLE_CH_A

;; -------

LABEL_AY_SUB_MENU_A_MAIN_MENU3_CHK_ITEM3	
	movlw 	MENU_ITEM_POS3
	cpfseq 	MIOS_PARAMETER1 ;; EDITING MODE ITEM  = 3?

		;; NO
		;; KEY [A] is only needed @ ITEM 1,2,3
		;; SO EXIT HERE...
		goto LABEL_MAIN_MENUE_SWITCH

		;; YES
		goto LABEL_AY_SUB_MENU_A_MAIN_MENU3_TOGGLE_NOISE_A






;; ---------[MAIN MENU 3 @ ITEM1 - SUB-ROUTINE KEY [A] TOGGLE FX A ON/ OFF]---------------

LABEL_AY_SUB_MENU_A_MAIN_MENU3_TOGGLE_FX_A
	
	;; TOGGLE FX A ON/OFF
	;; BIT0 = 1 ==> FX CH A ON 
	;; BIT0 = 0 ==> FX CH A OFF 
	;; IF BIT0 = 0 => TOGGLE BIT0 to 1
	;; IF BIT0 = 1 => TOGGLE BIT0 to 0

	;; CHECK IS BIT0 = 0?  
	btfsc FX_USER_ON_OFF_ABC, BIT0_FX_ON_OFF_TONE_A ;; CHK BIT0
		
		;; NO - BIT0 = 1, SO CLEAR BIT0 TO 0
		goto  LABEL_AY_SUB_MENU_A_MAIN_MENU3_CLR_FX_A
		
		
		;; YES BIT0 = 0, SO SET BIT0 TO 1
		goto LABEL_AY_SUB_MENU_A_MAIN_MENU3_SET_FX_A
		

LABEL_AY_SUB_MENU_A_MAIN_MENU3_SET_FX_A
		;; SET BIT0
		bsf FX_USER_ON_OFF_ABC, BIT0_FX_ON_OFF_TONE_A
		;; CS LED
		call LED_Fx_A_on
			goto LABEL_MAIN_MENUE_SWITCH

LABEL_AY_SUB_MENU_A_MAIN_MENU3_CLR_FX_A
		;; CLEAR BIT0
		bcf FX_USER_ON_OFF_ABC, BIT0_FX_ON_OFF_TONE_A
		;; CS LED
		call LED_Fx_A_off
			goto LABEL_MAIN_MENUE_SWITCH
		

	


;; ---------------[END ITEM1 (FX)]------------------------


;; ---------[START: TOGGLE CH A ON/ OFF]---------------

LABEL_AY_SUB_MENU_A_MAIN_MENU3_TOGGLE_CH_A

	;; TOGGLE CH A ON/OFF
	;; BIT0 = 0 ==> TONE CH A *ON* (!)
	;; BIT0 = 1 ==> TONE CH A *OFF* (!)
	;; BIT0 of AY_TONE_NOISE_ABC_USER_ON_OFF_SWITCH:
	;; IF BIT0 = 0 => TOGGLE BIT0 to 1
	;; IF BIT0 = 1 => TOGGLE BIT0 to 0

	;; BIT0 AY_TONE_NOISE_ABC_USER_ON_OFF_SWITCH TEST
	;; SCIP IF CLEAR
	;; IS BIT0 OF AY_TONE_NOISE_ABC_USER_ON_OFF_SWITCH = 0?  
	btfsc AY_TONE_NOISE_ABC_USER_ON_OFF_SWITCH, 0 ;; CHK BIT0
		
		;; NO - BIT0 = 1, SO CLEAR BIT0
		rgoto  LABEL_AY_SUB_MENU_A_MAIN_MENU3_CLR_CHA
		
		
		;; YES BIT0 = 0, SO SET BIT0
		rgoto LABEL_AY_SUB_MENU_A_MAIN_MENU3_SET_CHA
		

LABEL_AY_SUB_MENU_A_MAIN_MENU3_SET_CHA
		;; SET BIT0
		bsf AY_TONE_NOISE_ABC_USER_ON_OFF_SWITCH, BIT0_TONE_A_ON_OFF
		;; CS LED
		call LED_ToneA_off
			goto LABEL_MAIN_MENUE_SWITCH
		
				

LABEL_AY_SUB_MENU_A_MAIN_MENU3_CLR_CHA
		;; CLEAR BIT0
		bcf AY_TONE_NOISE_ABC_USER_ON_OFF_SWITCH, BIT0_TONE_A_ON_OFF
		;; CS LED
		call LED_ToneA_on
			goto LABEL_MAIN_MENUE_SWITCH
		
		

;; ---------[END: TOGGLE CH A ON/ OFF]---------------




;; ---------[TOGGLE [ADD NOISE TO CH A] ON/ OFF]---------------

LABEL_AY_SUB_MENU_A_MAIN_MENU3_TOGGLE_NOISE_A
	
	;; TOGGLE NOISE CH A ON/OFF
	
	;; BIT3 of AY_TONE_NOISE_ABC_USER_ON_OFF_SWITCH:
	;; IF BIT3 = 0 => TOGGLE BIT3 to 1
	;; IF BIT3 = 1 => TOGGLE BIT3 to 0

	;; BIT3 AY_TONE_NOISE_ABC_USER_ON_OFF_SWITCH TEST
	;; SKIP IF CLEAR
	;; IS BIT3 OF AY_TONE_NOISE_ABC_USER_ON_OFF_SWITCH = 0?  
	btfsc AY_TONE_NOISE_ABC_USER_ON_OFF_SWITCH, BIT3_NOISE_A_ON_OFF ;; CHK BIT3
		
		;; NO - BIT3 = 1, SO CLEAR BIT3
		rgoto  	LABEL_AY_SUB_MENU_A_MAIN_MENU3_CLR_B3_NOISE_A
		
		
		;; YES BIT3 = 0, SO SET BIT3
		rgoto 	LABEL_AY_SUB_MENU_A_MAIN_MENU3_SET_B3_NOISE_A
		

LABEL_AY_SUB_MENU_A_MAIN_MENU3_SET_B3_NOISE_A
		;; SET BIT3
		bsf AY_TONE_NOISE_ABC_USER_ON_OFF_SWITCH, BIT3_NOISE_A_ON_OFF
		;; CS LED
		call LED_NoiseA_off
			goto LABEL_MAIN_MENUE_SWITCH

LABEL_AY_SUB_MENU_A_MAIN_MENU3_CLR_B3_NOISE_A
		;; CLEAR BIT3
		bcf AY_TONE_NOISE_ABC_USER_ON_OFF_SWITCH, BIT3_NOISE_A_ON_OFF
		;; CS LED
		call LED_NoiseA_on
			goto LABEL_MAIN_MENUE_SWITCH




;; ---------[END: TOGGLE NOISE CH A ON/ OFF]---------------



;; --------[A @ MAIN MENU5]------------------
LABEL_AY_SUB_MENU_A_MAIN_MENU5

	;; MAIN MENU5 = ENVELOPE CONTROL
	;; KEY [A] HAD BEEN PRESSED
	;;
	;; 1) CHECK WHICH ITEM (AY REG) IS 
	;; IN EDITING MODE "*"
	;; VIA AY_LCD_COURSER_POS_MAIN_MENU_ENVELOPE
	;;
	;; 2) TOGGLE CH A ON/OFF R.MODE
	;; ==> R.MODE => AY REG 11,12,13 MODE
	;; ==> R.MODE ON: ENV IS CONTROLLED BY AY REG 12,12,13

;; --[ 1) CHECK ITEM]-------

	;; CHECK LOCATION VIA EDITING MODE "*"
	;; COPY THE VALUE OF EDITING MODE TO  MIOS_PARAMETER1
	movff 	AY_LCD_COURSER_POS_MAIN_MENU_ENVELOPE, MIOS_PARAMETER1

LABEL_AY_SUB_MENU_A_MAIN_MENU5_CHK_ITEM4	
	;; POS4 IS THE ONLY POS WHRE KEY [A] IS IN USE @ MAIN MENU5
	;; SO JUST CHECK POS4...
	movlw 	MENU_ITEM_POS4
	cpfseq 	MIOS_PARAMETER1 ;; EDITING MODE ITEM  = 4?

		;; NO
		;; SO QUIT HERE
		goto LABEL_MAIN_MENUE_SWITCH

		;; YES 
		rgoto 	LABEL_AY_SUB_MENU_A_MAIN_MENU5_TOGGLE_R_MODE_CH_A


LABEL_AY_SUB_MENU_A_MAIN_MENU5_TOGGLE_R_MODE_CH_A
	;; R_MODE = REGISTER MODE = ENVELOPE MODE
	;; TOGGLE CH A ON/OFF ENVELOPE MODE @ MAIN MENU5 => ENV MENU
	;; ==> ENVELOPE MODE = ENV TONE A IS CONTROLLED BY [AY REG 11,12,13]

	;; TOGGLE CH A ON/OFF R.MODE @ MAIN MENU5 => ENV MENU
	;; CH A BIT4 = 0 ==> R.Mode *OFF* 
	;; CH A BIT4 = 1 ==> R.Mode *ON* 
	;; BIT4 of AY_R8_CH_A_AMPLITUDE:
	;; IF BIT4 = 0 => TOGGLE BIT4 to 1
	;; IF BIT4 = 1 => TOGGLE BIT4 to 0

	;; BIT4 AY_R8_CH_A_AMPLITUDE TEST
	;; SKIP IF CLEAR
	;; IS BIT4 OF AY_R8_CH_A_AMPLITUDE = 0?  
	btfsc AY_R8_CH_A_AMPLITUDE, BIT4_ENVELOPE_ON_OFF ;; CHK BIT4
		
		;; NO - BIT4 = 1, SO CLEAR BIT4
		rgoto  LABEL_AY_SUB_MENU_A_MAIN_MENU5_CLR_BIT4
		
		
		;; YES BIT4 = 0, SO SET BIT4
		rgoto LABEL_AY_SUB_MENU_A_MAIN_MENU5_SET_BIT4
		

LABEL_AY_SUB_MENU_A_MAIN_MENU5_SET_BIT4
		;; SET BIT4
		bsf AY_R8_CH_A_AMPLITUDE, BIT4_ENVELOPE_ON_OFF
		;; CS LED
		call LED_EnvelopeModeA_on
			rgoto LABEL_AY_SUB_MENU_A_MAIN_MENU5_SEND_TO_AY_BIT4

LABEL_AY_SUB_MENU_A_MAIN_MENU5_CLR_BIT4
		;; CLEAR BIT4
		bcf AY_R8_CH_A_AMPLITUDE, BIT4_ENVELOPE_ON_OFF
		;; CS LED
		call LED_EnvelopeModeA_off


LABEL_AY_SUB_MENU_A_MAIN_MENU5_SEND_TO_AY_BIT4
			;; PREPARE ITEM DATA FOR TRANSFERE TO AY CHIP VIA ay_sr.inc
			;; --------------------------------------------------------
			;; WRITE AY REG *ADRESS* TO AY_REG_ADDRESS FOR => AY_SR_Write
			movlw AY_CHIP_ADR_08_TONE_A_VOLUME_ENV_MODE_ON_OFF 
			movwf AY_REG_ADDRESS 		; ADDRESS FOR => AY_SR_Write
			;; WRITE AY REG *DATA* TO AY_REG_DATA FOR => AY_SR_Write
			movff AY_R8_CH_A_AMPLITUDE, AY_REG_DATA 
			;; 
			;; WRITING 8BIT DATA (AY_REG_ADDRESS, AY_REG_DATA)
			;; TO AY REG(X) ROUTINE
			;; @ay_sr.inc
			call LABEL_AY_SR_Write
			;; ---------------------------------------------------------------

				;; SUB ROUTINE IS DONE		
				;; JUMP TO MAIN MENU (REDRAW LCD MENU5)		
				;; => LABEL_MAIN_MENUE_SWITCH
				;; =>  @ main_menu_functions.inc	
				goto LABEL_MAIN_MENUE_SWITCH
		



;; -------------------------[END OF SUB MENU: A]----------------------------- 


