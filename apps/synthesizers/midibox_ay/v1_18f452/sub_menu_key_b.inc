;; sub_menu_key_b.inc



;; ---------------------------------------------------------
;; -------------------------[B]----------------------------- 
;; =======================> [B] HAD BEEN PRESSED

LABEL_AY_SUB_MENU_B

	;; CHECK WHAT MAIN MENU IS ACTIVATED 
	;; => VIA CURRENT_MAIN_MENU
	movf CURRENT_MAIN_MENU, W
	JUMPTABLE_2BYTES 7
		rgoto        LABEL_AY_SUB_MENU_B_EXIT
		rgoto        LABEL_AY_SUB_MENU_B_EXIT
        	rgoto        LABEL_AY_SUB_MENU_B_EXIT
        	rgoto        LABEL_AY_SUB_MENU_B_MAIN_MENU3
        	rgoto        LABEL_AY_SUB_MENU_B_EXIT
        	rgoto        LABEL_AY_SUB_MENU_B_MAIN_MENU5
        	rgoto        LABEL_AY_SUB_MENU_B_EXIT



;; -------[END OF: CHECK WHICH MAIN MENU IS ACTIVATED]---
;; ----------------------------------------------------------------


;; --------[B - NO FUNCTION HERE]------------------
LABEL_AY_SUB_MENU_B_EXIT
	;; Exit here
	goto LABEL_MAIN_MENUE_SWITCH



;; --------[B @ MAIN MENU3]------------------
LABEL_AY_SUB_MENU_B_MAIN_MENU3

	;; MAIN MENU3 = MIXER CH ABC +NOISE
	;; KEY B HAD BEEN PRESSED
	;;
	;; 1) CHECK WHICH ITEM (AY REG) IS 
	;; IN EDITING MODE "*"
	;; VIA AY_LCD_COURSER_POS_MAIN_MENU_ABC_NOISE
	;;
	;; 2) TOGGLE CH A ON/OFF

;; --[ 1) CHECK ITEM]-------

	;; CHECK LOCATION VIA EDITING MODE "*"
	;; COPY THE VALUE OF EDITING MODE TO  MIOS_PARAMETER1
	movff 	AY_LCD_COURSER_POS_MAIN_MENU_ABC_NOISE, MIOS_PARAMETER1

LABEL_AY_SUB_MENU_B_MAIN_MENU3_CHK_ITEM1	
	movlw 	MENU_ITEM_POS1
	cpfseq 	MIOS_PARAMETER1 ;; EDITING MODE ITEM  = 1?

		;; NO
		rgoto LABEL_AY_SUB_MENU_B_MAIN_MENU3_CHK_ITEM2

		;; YES
		rgoto LABEL_AY_SUB_MENU_B_MAIN_MENU3_TOGGLE_FX_B



LABEL_AY_SUB_MENU_B_MAIN_MENU3_CHK_ITEM2	
	movlw 	MENU_ITEM_POS2
	cpfseq 	MIOS_PARAMETER1 ;; EDITING MODE ITEM  = 2?

		;; NO
		rgoto LABEL_AY_SUB_MENU_B_MAIN_MENU3_CHK_ITEM3

		;; YES
		rgoto LABEL_AY_SUB_MENU_B_MAIN_MENU3_TOGGLE_CH_B

;; -------

LABEL_AY_SUB_MENU_B_MAIN_MENU3_CHK_ITEM3	
	movlw 	MENU_ITEM_POS3
	cpfseq 	MIOS_PARAMETER1 ;; EDITING MODE ITEM  = 3?

		;; NO
		;; KEY [A] IS NEEDED JUST FOR EDITING POS 2 + 3
		;; SO EXIT HERE...
		goto LABEL_MAIN_MENUE_SWITCH

		;; YES
		rgoto LABEL_AY_SUB_MENU_B_MAIN_MENU3_TOGGLE_NOISE_B




;; ---------[MAIN MENU 3 @ ITEM1 - SUB-ROUTINE KEY [B] TOGGLE FX A ON/ OFF]---------------

LABEL_AY_SUB_MENU_B_MAIN_MENU3_TOGGLE_FX_B
	
	;; TOGGLE FX B ON/OFF
	;; BIT1 = 1 ==> FX B ON 
	;; BIT1 = 0 ==> FX B OFF 
	;; IF BIT1 = 0 => TOGGLE BIT1 to 1
	;; IF BIT1 = 1 => TOGGLE BIT1 to 0

	;; CHECK IS BIT1 = 0?  
	btfsc FX_USER_ON_OFF_ABC, 1 ;; CHK BIT1
		
		;; NO - BIT1 = 1, SO CLEAR BIT1 TO 0
		rgoto  LABEL_AY_SUB_MENU_B_MAIN_MENU3_CLR_FX_B
		
		
		;; YES BIT0 = 0, SO SET BIT0 TO 1
		rgoto LABEL_AY_SUB_MENU_B_MAIN_MENU3_SET_FX_B
		

LABEL_AY_SUB_MENU_B_MAIN_MENU3_SET_FX_B
		;; SET BIT1
		bsf FX_USER_ON_OFF_ABC, BIT1_FX_ON_OFF_TONE_B
		;; CS LED
		call LED_Fx_B_on
			goto LABEL_MAIN_MENUE_SWITCH

LABEL_AY_SUB_MENU_B_MAIN_MENU3_CLR_FX_B
		;; CLEAR BIT1
		bcf FX_USER_ON_OFF_ABC, BIT1_FX_ON_OFF_TONE_B
		;; CS LED
		call LED_Fx_B_off
			goto LABEL_MAIN_MENUE_SWITCH



;;--------------------[END ITEM1 - FX]-----------------------------



LABEL_AY_SUB_MENU_B_MAIN_MENU3_TOGGLE_CH_B

;; ---------[TOGGLE CH B ON/ OFF]---------------

	;; TOGGLE CH B ON/OFF
	;; BIT1 = 0 ==> TONE CH B *ON* (!)
	;; BIT1 = 1 ==> TONE CH B *OFF* (!)
	;; BIT1 of AY_TONE_NOISE_ABC_USER_ON_OFF_SWITCH:
	;; IF BIT1 = 0 => TOGGLE BIT1 to 1
	;; IF BIT1 = 1 => TOGGLE BIT1 to 0

	;; BIT1 AY_TONE_NOISE_ABC_USER_ON_OFF_SWITCH TEST
	;; SCIP IF CLEAR
	;; IS BIT1 OF AY_TONE_NOISE_ABC_USER_ON_OFF_SWITCH = 0?  
	btfsc AY_TONE_NOISE_ABC_USER_ON_OFF_SWITCH, BIT1_TONE_B_ON_OFF ;; CHK BIT1
		
		;; NO - BIT1 = 1, SO CLEAR BIT1
		rgoto  LABEL_AY_SUB_MENU_B_MAIN_MENU3_CLR_CHB
		
		
		;; YES BIT1 = 0, SO SET BIT1
		rgoto LABEL_AY_SUB_MENU_B_MAIN_MENU3_SET_CHB
		

LABEL_AY_SUB_MENU_B_MAIN_MENU3_SET_CHB
		;; SET BIT1
		bsf AY_TONE_NOISE_ABC_USER_ON_OFF_SWITCH, BIT1_TONE_B_ON_OFF
		;; CS LED
		call LED_ToneB_off
			goto LABEL_MAIN_MENUE_SWITCH

LABEL_AY_SUB_MENU_B_MAIN_MENU3_CLR_CHB
		;; CLEAR BIT1
		bcf AY_TONE_NOISE_ABC_USER_ON_OFF_SWITCH, BIT1_TONE_B_ON_OFF
		;; CS LED
		call LED_ToneB_on
			goto LABEL_MAIN_MENUE_SWITCH


		

;; ---------[END: TOGGLE CH B ON/ OFF]---------------



;; ---------[TOGGLE [ADD *NOISE* TO CH B] ON/ OFF]---------------
LABEL_AY_SUB_MENU_B_MAIN_MENU3_TOGGLE_NOISE_B
	
	;; TOGGLE NOISE CH B ON/OFF
	
	;; BIT4 of AY_TONE_NOISE_ABC_USER_ON_OFF_SWITCH:
	;; IF BIT4 = 0 => TOGGLE BIT4 to 1
	;; IF BIT4 = 1 => TOGGLE BIT4 to 0

	;; BIT4 AY_TONE_NOISE_ABC_USER_ON_OFF_SWITCH TEST
	;; SKIP IF CLEAR
	;; IS BIT4 OF AY_TONE_NOISE_ABC_USER_ON_OFF_SWITCH = 0?  
	btfsc AY_TONE_NOISE_ABC_USER_ON_OFF_SWITCH, BIT4_NOISE_B_ON_OFF ;; CHK BIT4
		
		;; NO - BIT4 = 1, SO CLEAR BIT4
		rgoto  	LABEL_AY_SUB_MENU_B_MAIN_MENU3_CLR_B4_NOISE_B
		
		
		;; YES BIT4 = 0, SO SET BIT4
		rgoto 	LABEL_AY_SUB_MENU_B_MAIN_MENU3_SET_B4_NOISE_B
		

LABEL_AY_SUB_MENU_B_MAIN_MENU3_SET_B4_NOISE_B
		;; SET BIT4
		bsf AY_TONE_NOISE_ABC_USER_ON_OFF_SWITCH, BIT4_NOISE_B_ON_OFF
		;; CS LED
		call LED_NoiseB_off
			goto LABEL_MAIN_MENUE_SWITCH

LABEL_AY_SUB_MENU_B_MAIN_MENU3_CLR_B4_NOISE_B
		;; CLEAR BIT4
		bcf AY_TONE_NOISE_ABC_USER_ON_OFF_SWITCH, BIT4_NOISE_B_ON_OFF
		;; CS LED
		call LED_NoiseB_on
			goto LABEL_MAIN_MENUE_SWITCH

;; ---------[END: TOGGLE NOISE CH A ON/ OFF]---------------




;; --------[B @ MAIN MENU5]------------------
LABEL_AY_SUB_MENU_B_MAIN_MENU5

	;; MAIN MENU5 = ENVELOPE CONTROL
	;; KEY [B] HAD BEEN PRESSED
	;;
	;; 1) CHECK WHICH ITEM (AY REG) IS 
	;; IN EDITING MODE "*"
	;; VIA AY_LCD_COURSER_POS_MAIN_MENU_ENVELOPE
	;;
	;; 2) TOGGLE CH B ON/OFF R.MODE
	;; ==> R.MODE => AY REG 11,12,13 MODE
	;; ==> R.MODE ON: ENV IS CONTROLLED BY AY REG 12,12,13

;; --[ 1) CHECK ITEM]-------

	;; CHECK LOCATION VIA EDITING MODE "*"
	;; COPY THE VALUE OF EDITING MODE TO  MIOS_PARAMETER1
	movff 	AY_LCD_COURSER_POS_MAIN_MENU_ENVELOPE, MIOS_PARAMETER1

LABEL_AY_SUB_MENU_B_MAIN_MENU5_CHK_ITEM4	
	;; POS4 IS THE ONLY ITEM POS WHRE KEY [B] IS IN USE @ MAIN MENU5
	;; SO JUST CHECK POS4...
	movlw 	MENU_ITEM_POS4
	cpfseq 	MIOS_PARAMETER1 ;; EDITING MODE ITEM  = 4?

		;; NO
		;; SO QUIT HERE
		goto LABEL_MAIN_MENUE_SWITCH

		;; YES 
		rgoto 	LABEL_AY_SUB_MENU_B_MAIN_MENU5_TOGGLE_R_MODE_CH_B


LABEL_AY_SUB_MENU_B_MAIN_MENU5_TOGGLE_R_MODE_CH_B
	;; ENVELOPE MODE ON / OFF:
	;; R_MODE = REGISTER MODE = ENVELOPE MODE
	;; TOGGLE CH B ON/OFF R.MODE @ MAIN MENU5 => ENV MENU
	;; ==> R.MODE => ENV IS CONTROLLED BY [AY REG 11,12,13]

	;; TOGGLE CH B ON/OFF R.MODE @ MAIN MENU5 => ENV MENU
	;; CH B BIT4 = 0 ==> ENVELOPE MODE / R.Mode *OFF* 
	;; CH B BIT4 = 1 ==> ENVELOPE MODE / R.Mode *ON* 
	;; BIT4 of AY_R9_CH_B_AMPLITUDE:
	;; IF BIT4 = 0 => TOGGLE BIT4 to 1
	;; IF BIT4 = 1 => TOGGLE BIT4 to 0

	;; BIT4 AY_R8_CH_A_AMPLITUDE TEST
	;; SKIP IF CLEAR
	;; IS BIT4 OF AY_R8_CH_A_AMPLITUDE = 0?  
	btfsc AY_R9_CH_B_AMPLITUDE, BIT4_ENVELOPE_ON_OFF ;; CHK BIT4
		
		;; NO - BIT4 = 1, SO CLEAR BIT4
		rgoto  LABEL_AY_SUB_MENU_B_MAIN_MENU5_CLR_BIT4
		
		
		;; YES BIT4 = 0, SO SET BIT4
		rgoto LABEL_AY_SUB_MENU_B_MAIN_MENU5_SET_BIT4
		

LABEL_AY_SUB_MENU_B_MAIN_MENU5_SET_BIT4
		;; ENVELOPE MODE ON
		;; SET BIT4
		bsf AY_R9_CH_B_AMPLITUDE, BIT4_ENVELOPE_ON_OFF
		;; CS LED
		call LED_EnvelopeModeB_on

			rgoto LABEL_AY_SUB_MENU_B_MAIN_MENU5_SEND_TO_AY_BIT4

LABEL_AY_SUB_MENU_B_MAIN_MENU5_CLR_BIT4
		;; ENVELOPE MODE OFF
		;; CLEAR BIT4
		bcf AY_R9_CH_B_AMPLITUDE, BIT4_ENVELOPE_ON_OFF
		;; CS LED
		call LED_EnvelopeModeB_off

LABEL_AY_SUB_MENU_B_MAIN_MENU5_SEND_TO_AY_BIT4
			;; PREPARE ITEM DATA FOR TRANSFERE TO AY CHIP VIA ay_sr.inc
			;; --------------------------------------------------------
			;; WRITE AY REG *ADRESS* TO AY_REG_ADDRESS FOR => AY_SR_Write
			movlw AY_CHIP_ADR_09_TONE_B_VOLUME_ENV_MODE_ON_OFF
			movwf AY_REG_ADDRESS 		; ADDRESS FOR => AY_SR_Write
			;; WRITE AY REG *DATA* TO AY_REG_DATA FOR => AY_SR_Write
			movff AY_R9_CH_B_AMPLITUDE, AY_REG_DATA 
			;; 
			;; WRITING 8BIT DATA (AY_REG_ADDRESS, AY_REG_DATA)
			;; TO AY REG(X) ROUTINE
			;; @ay_sr.inc
			call LABEL_AY_SR_Write
			;; ---------------------------------------------------------------

					;; SUB ROUTINE IS DONE		
					;; JUMP TO MAIN MENU (REDRAW LCD MENU5)		
					;; =>  @ main_menu_functions.inc
					goto LABEL_MAIN_MENUE_SWITCH
			

;; -------------------------[END OF SUB MENU: B]----------------------------- 
