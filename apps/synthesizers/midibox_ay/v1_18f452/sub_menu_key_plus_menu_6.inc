;; sub_menu_key_plus_menu_6.inc

;; ------------[MENU 6 - MIDI CH TONE A B C]------------------------------
PLUS_KEY_SUBROUTINE_AT_MAIN_MENU6
;; jump in here from sub_menu_key_plus.inc
	;; INC MIDI CHANNEL
	
	;; 1) CHECK WHICH ITEM IS 
	;; IN EDITING MODE "*"
	
	;; 2) INC ITEM 

	;; --[ 1) CHECK ITEM]-------

	;; CHECK LOCATION VIA EDITING MODE "*"
	;; COPY THE VALUE OF EDITING MODE TO  MIOS_PARAMETER1
	movff 	AY_LCD_COURSER_POS_MAIN_MENU_MIDI_CONFIG, MIOS_PARAMETER1

LABEL_AY_SUB_MENU_PLUS_MAIN_MENU6_CHK_ITEM1	
	movlw 	MENU_ITEM_POS1
	cpfseq 	MIOS_PARAMETER1 ;; EDITING MODE ITEM  = 1?

		;; NO
		rgoto LABEL_AY_SUB_MENU_PLUS_MAIN_MENU6_CHK_ITEM2

		;; YES
		rgoto LABEL_AY_SUB_MENU_PLUS_MAIN_MENU6_INC_ITEM1
	

LABEL_AY_SUB_MENU_PLUS_MAIN_MENU6_CHK_ITEM2

	movlw 	MENU_ITEM_POS2
	cpfseq 	MIOS_PARAMETER1 ;; EDITING MODE ITEM  = 2?

		;; NO
		rgoto LABEL_AY_SUB_MENU_PLUS_MAIN_MENU6_CHK_ITEM3

		;; YES
		rgoto LABEL_AY_SUB_MENU_PLUS_MAIN_MENU6_INC_ITEM2	


LABEL_AY_SUB_MENU_PLUS_MAIN_MENU6_CHK_ITEM3
	
	movlw 	MENU_ITEM_POS3
	cpfseq 	MIOS_PARAMETER1 ;; EDITING MODE ITEM  = 3?

		;; NO? - No Item Left Over - So Quit Here
		goto LABEL_MAIN_MENUE_SWITCH

		;; YES
		rgoto LABEL_AY_SUB_MENU_PLUS_MAIN_MENU6_INC_ITEM3	




;;---[ 2) INC ITEM [MAIN MENU6 - [MIDI CH TONE A]]]--------

LABEL_AY_SUB_MENU_PLUS_MAIN_MENU6_INC_ITEM1
	;; INC ITEM1 - MIDI CH TONE A
	;; => RANGE 0-15 DEC. / LCD 1 - 16
	;; => RANGE 0x00-0x0F  HEX

		;; CHEK ITEM VALUE 
		;; ITEM1 = 4BIT = 0x0F = 15 DEC
		;; compare f with WREG, skip >
		;; JUST TAKE A THE LO NIBBLE
		movlw	0x0F
		andwf	AY_TONE_A_MIDI_CHANNEL_USER,W
		movwf	MIOS_PARAMETER1 ;; LOW NIBBLE OF AY_TONE_A_MIDI_CHANNEL_USER (0x00 - 0x0F)
		
		movlw	0x0E
		cpfsgt 	MIOS_PARAMETER1 ;; IS LOW NIBBLE OF AY_R8_CH_A_AMPLITUDE
					;; > 14 DEC. ? 
		
			;; NO
			rgoto LABEL_AY_SUB_MENU_PLUS_MAIN_MENU6_INC_ITEM1_OK

			;; YES - LOW NIBBLE OF AY_R8_CH_A_AMPLITUDE = 15 DEC.
			;; QUIT HERE
			goto LABEL_MAIN_MENUE_SWITCH



LABEL_AY_SUB_MENU_PLUS_MAIN_MENU6_INC_ITEM1_OK
	;; ITEM = ITEM +1 => MIDI CH A +1 
	incf AY_TONE_A_MIDI_CHANNEL_USER, F
	        
	        ;; GO BACK TO MAIN MENU
	        goto LABEL_MAIN_MENUE_SWITCH

	

;;---[ 2) INC ITEM2 [MAIN MENU6 / MIDI CH TONE B]--------

LABEL_AY_SUB_MENU_PLUS_MAIN_MENU6_INC_ITEM2
	;; INC ITEM2
	;; => RANGE 0-15 DEC.
	;; => RANGE 0-F  HEX
		;; CHEK ITEM VALUE 
		;; ITEM2 = LOW NIBBLE (4BIT)
		;; 0x00 - 0x0F HEX = 0 - 15 DEC
		;; compare f with WREG, skip >
		;; JUST TAKE A THE LO NIBBLE
		movlw	0x0F
		andwf	AY_TONE_B_MIDI_CHANNEL_USER,W
		movwf	MIOS_PARAMETER1 ;; LOW NIBBLE OF AY_TONE_B_MIDI_CHANNEL_USER (0x00 - 0x0F)
		
		movlw	0x0E
		cpfsgt 	MIOS_PARAMETER1 ;; IS LOW NIBBLE OF AY_TONE_B_MIDI_CHANNEL_USER
					;; > 14 DEC. ? 
		
			;; NO
			rgoto LABEL_AY_SUB_MENU_PLUS_MAIN_MENU6_INC_ITEM2_OK

			;; YES - LOW NIBBLE OF AY_TONE_B_MIDI_CHANNEL_USER = 15 DEC.
			;; SO QUIT HERE
			goto LABEL_MAIN_MENUE_SWITCH



LABEL_AY_SUB_MENU_PLUS_MAIN_MENU6_INC_ITEM2_OK
	;; ITEM = ITEM +1
	incf AY_TONE_B_MIDI_CHANNEL_USER, F

		;; SWITCH MAIN MENU TO: MAIN MENU 6
		goto LABEL_MAIN_MENUE_SWITCH





;;---[ 2) INC ITEM3 [MAIN MENU6 / MIDI CH TONE C]--------

LABEL_AY_SUB_MENU_PLUS_MAIN_MENU6_INC_ITEM3
	;; INC ITEM3
	;; => RANGE 0-15 DEC.
	;; => RANGE 0-F  HEX

		;; CHEK ITEM VALUE 
		;; ITEM1 = 4BIT LOW NIBBLE => 0x00 - 0x0F = 0 - 15 DEC
		;; compare f with WREG, skip >
		;; JUST TAKE A THE LO NIBBLE
		movlw	0x0F
		andwf	AY_TONE_C_MIDI_CHANNEL_USER,W
		movwf	MIOS_PARAMETER1 ;; LOW NIBBLE OF AY_TONE_C_MIDI_CHANNEL_USER (0x00 - 0x0F)
		
		movlw	0x0E
		cpfsgt 	MIOS_PARAMETER1 ;; IS LOW NIBBLE OF AY_TONE_C_MIDI_CHANNEL_USER
					;; > 14 DEC. ? 
		
			;; NO
			rgoto LABEL_AY_SUB_MENU_PLUS_MAIN_MENU6_INC_ITEM3_OK

			;; YES - AY_TONE_C_MIDI_CHANNEL_USER = 15 DEC.
			;; QUIT HERE
			goto LABEL_MAIN_MENUE_SWITCH



LABEL_AY_SUB_MENU_PLUS_MAIN_MENU6_INC_ITEM3_OK
	;; ITEM = ITEM +1
	incf AY_TONE_C_MIDI_CHANNEL_USER, F
				
		;; GOTO MAIN MENU SWITCH
		goto LABEL_MAIN_MENUE_SWITCH
