; $Id$
;
; MIOS system font for graphical displays
;
; ==========================================================================
;
;  Copyright 1998-2006 Thorsten Klose (tk@midibox.org)
;  Licensed for personal non-commercial use only.
;  All other rights reserved.
; 
; ==========================================================================

	;; don't change the address!
	org	0x7cfc
MIOS_GLCD_FONT
	FONT_ENTRY 6, 1, 0, 6

;; converted with 'convpix mios_glcd_font.xpm'
	da b'1000000000000000'
	da b'1000000010000000'
	da b'1000000010000000'
	da b'1100000000000000'
	da b'1100000011000000'
	da b'1100000011000000'
	da b'1110000000000000'
	da b'1110000011100000'
	da b'1110000011100000'
	da b'1111000000000000'
	da b'1111000011110000'
	da b'1111000011110000'
	da b'1111100000000000'
	da b'1111100011111000'
	da b'1111100011111000'
	da b'1111110000000000'
	da b'1111110011111100'
	da b'1111110011111100'
	da b'1111111000000000'
	da b'1111111011111110'
	da b'1111111011111110'
	da b'1111111100000000'
	da b'1111111111111111'
	da b'1111111111111111'
	da b'0001100000000000'
	da b'0111111000111100'
	da b'0000000011111111'
	da b'1111111100000000'
	da b'0011110001111110'
	da b'0000000000011000'
	da b'0000000000000000'
	da b'0000000000000000'
	da b'0000000000000000'
	da b'0000000000000000'
	da b'0000000000000000'
	da b'0000000000000000'
	da b'0000000000000000'
	da b'0000000000000000'
	da b'0000000000000000'
	da b'0000000000000000'
	da b'0000000000000000'
	da b'0000000000000000'
	da b'0000000000000000'
	da b'0000000000000000'
	da b'0000000000000000'
	da b'0000000000000000'
	da b'0000000000000000'
	da b'0000000000000000'


	da b'0000000000000000'
	da b'0000000000000000'
	da b'0000000000000000'
	da b'0000000000000000'
	da b'0000000000000000'
	da b'0000000000000000'
	da b'0000000000000000'
	da b'0000000000000000'
	da b'0000000000000000'
	da b'0000000000000000'
	da b'0000000000000000'
	da b'0000000000000000'
	da b'0000000000000000'
	da b'0000000000000000'
	da b'0000000000000000'
	da b'0000000000000000'
	da b'0000000000000000'
	da b'0000000000000000'
	da b'0000000000000000'
	da b'0000000000000000'
	da b'0000000000000000'
	da b'0000000000000000'
	da b'0000000000000000'
	da b'0000000000000000'
	da b'0000000000000000'
	da b'0000000000000000'
	da b'0000000000000000'
	da b'0000000000000000'
	da b'0000000000000000'
	da b'0000000000000000'
	da b'0000000000000000'
	da b'0000000000000000'
	da b'0000000000000000'
	da b'0000000000000000'
	da b'0000000000000000'
	da b'0000000000000000'
	da b'0000000000000000'
	da b'0000000000000000'
	da b'0000000000000000'
	da b'0000000000000000'
	da b'0000000000000000'
	da b'0000000000000000'
	da b'0000000000000000'
	da b'0000000000000000'
	da b'0000000000000000'
	da b'0000000000000000'
	da b'0000000000000000'
	da b'0000000000000000'


	da b'0000000000000000'
	da b'0000000000000000'
	da b'0000000000000000'
	da b'0000000000000000'
	da b'0100111100000000'
	da b'0000000000000000'
	da b'0000000000000000'
	da b'0000000000000111'
	da b'0000000000000111'
	da b'0001010000000000'
	da b'0001010001111111'
	da b'0001010001111111'
	da b'0010010000000000'
	da b'0111111100101010'
	da b'0001001000101010'
	da b'0010001100000000'
	da b'0000100000010011'
	da b'0110001001100100'
	da b'0011011000000000'
	da b'0101010101001001'
	da b'0101000000100010'
	da b'0000000000000000'
	da b'0000001100000101'
	da b'0000000000000000'
	da b'0000000000000000'
	da b'0010001000011100'
	da b'0000000001000001'
	da b'0000000000000000'
	da b'0010001001000001'
	da b'0000000000011100'
	da b'0001010000000000'
	da b'0011111000001000'
	da b'0001010000001000'
	da b'0000100000000000'
	da b'0011111000001000'
	da b'0000100000001000'
	da b'0000000000000000'
	da b'0101000000000000'
	da b'0000000000110000'
	da b'0000100000000000'
	da b'0000100000001000'
	da b'0000100000001000'
	da b'0000000000000000'
	da b'0011000000110000'
	da b'0000000000000000'
	da b'0010000000000000'
	da b'0000100000010000'
	da b'0000001000000100'


	da b'0011111000000000'
	da b'0100100101010001'
	da b'0011111001000101'
	da b'0000000000000000'
	da b'0111111101000010'
	da b'0000000001000000'
	da b'0100001000000000'
	da b'0101000101100001'
	da b'0100011001001001'
	da b'0010000100000000'
	da b'0100010101000001'
	da b'0011000101001011'
	da b'0001100000000000'
	da b'0001001000010100'
	da b'0001000001111111'
	da b'0010011100000000'
	da b'0100010101000101'
	da b'0011100101000101'
	da b'0011110000000000'
	da b'0100100101001010'
	da b'0011000001001001'
	da b'0000000100000000'
	da b'0000100101110001'
	da b'0000001100000101'
	da b'0011011000000000'
	da b'0100100101001001'
	da b'0011011001001001'
	da b'0000011000000000'
	da b'0100100101001001'
	da b'0001111000101001'
	da b'0000000000000000'
	da b'0011011000000000'
	da b'0000000000110110'
	da b'0000000000000000'
	da b'0101011000000000'
	da b'0000000000110110'
	da b'0000100000000000'
	da b'0010001000010100'
	da b'0000000001000001'
	da b'0001010000000000'
	da b'0001010000010100'
	da b'0001010000010100'
	da b'0000000000000000'
	da b'0010001001000001'
	da b'0000100000010100'
	da b'0000001000000000'
	da b'0101000100000001'
	da b'0000011000001001'


	da b'0011001000000000'
	da b'0111100101001001'
	da b'0011111001000001'
	da b'0111111000000000'
	da b'0001000100010001'
	da b'0111111000010001'
	da b'0111111100000000'
	da b'0100100101001001'
	da b'0011011001001001'
	da b'0011111000000000'
	da b'0100000101000001'
	da b'0010001001000001'
	da b'0111111100000000'
	da b'0100000101000001'
	da b'0001110000100010'
	da b'0111111100000000'
	da b'0100100101001001'
	da b'0100000101001001'
	da b'0111111100000000'
	da b'0000100100001001'
	da b'0000000100001001'
	da b'0011111000000000'
	da b'0100100101000001'
	da b'0111101001001001'
	da b'0111111100000000'
	da b'0000100000001000'
	da b'0111111100001000'
	da b'0000000000000000'
	da b'0111111101000001'
	da b'0000000001000001'
	da b'0010000000000000'
	da b'0100000101000000'
	da b'0000000100111111'
	da b'0111111100000000'
	da b'0001010000001000'
	da b'0100000100100010'
	da b'0111111100000000'
	da b'0100000001000000'
	da b'0100000001000000'
	da b'0111111100000000'
	da b'0000110000000010'
	da b'0111111100000010'
	da b'0111111100000000'
	da b'0000100000000100'
	da b'0111111100010000'
	da b'0011111000000000'
	da b'0100000101000001'
	da b'0011111001000001'


	da b'0111111100000000'
	da b'0000100100001001'
	da b'0000011000001001'
	da b'0011111000000000'
	da b'0101000101000001'
	da b'0101111000100001'
	da b'0111111100000000'
	da b'0001100100001001'
	da b'0100011000101001'
	da b'0100011000000000'
	da b'0100100101001001'
	da b'0011000101001001'
	da b'0000000100000000'
	da b'0111111100000001'
	da b'0000000100000001'
	da b'0011111100000000'
	da b'0100000001000000'
	da b'0011111101000000'
	da b'0001111100000000'
	da b'0100000000100000'
	da b'0001111100100000'
	da b'0011111100000000'
	da b'0011100001000000'
	da b'0011111101000000'
	da b'0110001100000000'
	da b'0000100000010100'
	da b'0110001100010100'
	da b'0000011100000000'
	da b'0111000000001000'
	da b'0000011100001000'
	da b'0110000100000000'
	da b'0100100101010001'
	da b'0100001101000101'
	da b'0000000000000000'
	da b'0100000101111111'
	da b'0000000001000001'
	da b'0000001000000000'
	da b'0000100000000100'
	da b'0010000000010000'
	da b'0000000000000000'
	da b'0100000101000001'
	da b'0000000001111111'
	da b'0000010000000000'
	da b'0000000100000010'
	da b'0000010000000010'
	da b'0100000000000000'
	da b'0100000001000000'
	da b'0100000001000000'


	da b'0000000000000000'
	da b'0000001000000001'
	da b'0000000000000100'
	da b'0010000000000000'
	da b'0101010001010100'
	da b'0111100001010100'
	da b'0111111100000000'
	da b'0100010001001000'
	da b'0011100001000100'
	da b'0011100000000000'
	da b'0100010001000100'
	da b'0010000001000100'
	da b'0011100000000000'
	da b'0100010001000100'
	da b'0111111101001000'
	da b'0011100000000000'
	da b'0101010001010100'
	da b'0001100001010100'
	da b'0000100000000000'
	da b'0000100101111110'
	da b'0000001000000001'
	da b'0000110000000000'
	da b'0101001001010010'
	da b'0011111001010010'
	da b'0111111100000000'
	da b'0000010000001000'
	da b'0111100000000100'
	da b'0000000000000000'
	da b'0111110101000100'
	da b'0000000001000000'
	da b'0010000000000000'
	da b'0100010001000000'
	da b'0000000000111101'
	da b'0111111100000000'
	da b'0010100000010000'
	da b'0000000001000100'
	da b'0000000000000000'
	da b'0111111101000001'
	da b'0000000001000000'
	da b'0111110000000000'
	da b'0001100000000100'
	da b'0111100000000100'
	da b'0111110000000000'
	da b'0000010000001000'
	da b'0111100000000100'
	da b'0011100000000000'
	da b'0100010001000100'
	da b'0011100001000100'


	da b'0111110000000000'
	da b'0001010000010100'
	da b'0000100000010100'
	da b'0000100000000000'
	da b'0001010000010100'
	da b'0111110000011000'
	da b'0111110000000000'
	da b'0000010000001000'
	da b'0000100000000100'
	da b'0100100000000000'
	da b'0101010001010100'
	da b'0010000001010100'
	da b'0000100000000000'
	da b'0100100000111110'
	da b'0010000001000000'
	da b'0011110000000000'
	da b'0100000001000000'
	da b'0111110000100000'
	da b'0001110000000000'
	da b'0100000000100000'
	da b'0001110000100000'
	da b'0011110000000000'
	da b'0011000001000000'
	da b'0011110001000000'
	da b'0100010000000000'
	da b'0001000000101000'
	da b'0100010000101000'
	da b'0000110000000000'
	da b'0101000001010000'
	da b'0011110001010000'
	da b'0100010000000000'
	da b'0101010001100100'
	da b'0100010001001100'
	da b'0000000000000000'
	da b'0011011000001000'
	da b'0000000001000001'
	da b'0000000000000000'
	da b'0111111100000000'
	da b'0000000000000000'
	da b'0000000000000000'
	da b'0100000100000000'
	da b'0000100000110110'
	da b'0000001000000000'
	da b'0000001000000001'
	da b'0000000000000001'
	da b'0000000000000000'
	da b'0000000000000000'
	da b'0000000000000000'


